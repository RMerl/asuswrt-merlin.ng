## release/src-rt-5.02axhnd/kernel/linux-4.1/drivers/tee/Kconfig
```kconfig
if BCM_KF_OPTEE_414_BACKPORTS
# Generic Trusted Execution Environment Configuration
config HAVE_ARM_SMCCC
	bool "SMC Call Support"
	def_bool n
	depends on BCM_KF_OPTEE

config TEE
	tristate "Trusted Execution Environment support"
	depends on COMPILE_TEST || BCM_KF_OPTEE
	select DMA_SHARED_BUFFER
	select GENERIC_ALLOCATOR
	select HAVE_ARM_SMCCC
	help
	  This implements a generic interface towards a Trusted Execution
	  Environment (TEE).

if TEE

menu "TEE drivers"

source "drivers/tee/optee/Kconfig"

endmenu

endif
endif # BCM_KF_OPTEE_414_BACKPORTS
```

## release/src-rt-5.02axhnd/kernel/linux-4.1/sound/soc/bcm/Kconfig
```kconfig
config SND_BCM2835_SOC_I2S
	tristate "SoC Audio support for the Broadcom BCM2835 I2S module"
	depends on ARCH_BCM2835 || COMPILE_TEST
	select SND_SOC_GENERIC_DMAENGINE_PCM
	select REGMAP_MMIO
	help
	  Say Y or M if you want to add support for codecs attached to
	  the BCM2835 I2S interface. You will also need
	  to select the audio interfaces to support below.

config SND_BCM6856_SOC_I2S
	bool "SoC Audio Broadcom BCM6856 I2S module"
	select REGMAP_MMIO
	select SND_BCM63xx_SOC_I2S_ENG
	depends on BCM_KF_ASOC_AUDIO
	help
	  Say Y if you want to add support for SoC audio on
	  BCM6856.

config SND_BCM63158_SOC_I2S
	bool "SoC Audio Broadcom BCM63158 I2S module"
	select REGMAP_MMIO
	select SND_BCM63xx_SOC_I2S_ENG
	depends on BCM_KF_ASOC_AUDIO
	help
	  Say Y if you want to add support for SoC audio on
	  BCM63158.

config SND_BCM63148_SOC_I2S
	bool "SoC Audio Broadcom BCM63138/148 I2S module"
	select REGMAP_MMIO
	select SND_BCM63xx_SOC_I2S_ENG
	depends on BCM_KF_ASOC_AUDIO
	help
	  Say Y if you want to add support for SoC audio on
	  BCM63138/148.
	  
config SND_BCM63xx_SOC_I2S_ENG
	bool
	depends on BCM_KF_ASOC_AUDIO
```

## release/src-rt-5.02hnd/bcmdrivers/opensource/char/pdc/Kconfig.autodetect
```kconfig
config BCM_PDC
	tristate "Support for PDC"
	depends on BCM_SPU
	depends on BCM94908
	default m

config BCM_PDC_IMPL
	int "Implementation index for PDC"
	depends on BCM_PDC
	default 1
```

## release/src-rt-5.02hnd/kernel/linux-4.1/drivers/mtd/brcmnand/Kconfig
```kconfig
#
# linux/drivers/mtd/brcmnand/Kconfig
#

config MTD_BRCMNAND
	tristate "Broadcom NAND controller support"
	depends on BCM_KF_MTD_BCMNAND
	select BRCMNAND_MTD_EXTENSION
	default n
	help
	  Say Y to enable the onchip NAND controller.

config BRCMNAND_MTD_EXTENSION
	bool "Enable Broadcom NAND controller extension"
	depends on BCM_KF_MTD_BCMNAND
	depends on MTD_BRCMNAND
	default y
	help
	  Say Y to enable Broadcom NAND extension in order to support
	  27Byte Spare Area and 8KB page NAND flashes.

config MTD_BRCMNAND_VERIFY_WRITE
	bool "Verify Broadcom NAND page writes"
	default n
	depends on BCM_KF_MTD_BCMNAND
	depends on MTD_BRCMNAND
	help
	  This adds an extra check when data is written to the flash. The
	  Broadcom NAND flash device internally checks only bits transitioning
	  from 1 to 0. There is a rare possibility that even though the
	  device thinks the write was successful, a bit could have been
	  flipped accidentally due to device wear or something else.

config MTD_BRCMNAND_CORRECTABLE_ERR_HANDLING
	bool "Refresh a block on a one bit correctable ECC error"
	default n
	depends on BCM_KF_MTD_BCMNAND
	depends on MTD_BRCMNAND
	help
	  If there is a 1-bit correctable error detected during NAND flash
	  read, the Broadcom NAND flash driver can refresh the corresponding
	  NAND flash block.  Refreshing implies a sequence of
	  read->erase->write. Refreshing the block drastically reduces the
	  probability of occurance of a similar (correctable) error.

	  Default is N because this is normally handled by UBI.

config MTD_BRCMNAND_EDU
	bool "Enable Broadcom NAND DMA (EDU)"
	default y
	select MTD_BRCMNAND_USE_ISR
	select MTD_BRCMNAND_ISR_QUEUE
	depends on BCM_KF_MTD_BCMNAND
	depends on MTD_BRCMNAND && BRCM_HAS_EDU
	help
	  Say Y to enable the EBI DMA unit for NAND flash transfers.
	  Say N to use PIO transfers.

config BRCMNAND_MAJOR_VERS
	int "Broadcom NAND Major Version"
    default 2
	depends on BCM_KF_MTD_BCMNAND
	depends on MTD_BRCMNAND
	help
      NAND controller major version.

config BRCMNAND_MINOR_VERS
	int "Broadcom NAND Minor Version"
    default 1
	depends on BCM_KF_MTD_BCMNAND
	depends on MTD_BRCMNAND
	help
      NAND controller minor version.
```

## release/src-rt-5.02p1axhnd.675x/bcmdrivers/broadcom/char/buzzz/Kconfig.autodetect
```kconfig
menu "Broadcom BUZZZ Tool"

config BUZZZ
	bool "Broadcom BUZZZ Tool Framework"
	depends on BCM_KF_BUZZZ
	default n
	help
	  Enable kernel tools framework: event/performance/function call tracing

config BUZZZ_FUNC
	bool "Broadcom BUZZZ Func Tool"
	depends on BUZZZ
	default n
	help
	  Enable Function tracing tool

config BUZZZ_PMON
	bool "Broadcom BUZZZ PMON Tool"
	depends on BUZZZ
	default n
	help
	  Enable performance monitoring tool

config BUZZZ_KEVT
	bool "Broadcom BUZZZ Kernel Event Tracing Tool"
	depends on BUZZZ
	default n
	help
	  Enable Kernel Event Tracing tool

endmenu
```

## release/src-rt-5.02p1axhnd.675x/bcmdrivers/broadcom/char/cleds/Kconfig.autodetect
```kconfig
config BCM_CLEDS_PROC_DRIVER
	tristate "Broadcom CLED  Proc Driver"
	default n

config BCM_CLEDS_PROC_DRIVER_IMPL
	int "Implementation index for Broadcom CLED Proc driver"
	depends on BCM_CLEDS_PROC_DRIVER
	default 1 
```
