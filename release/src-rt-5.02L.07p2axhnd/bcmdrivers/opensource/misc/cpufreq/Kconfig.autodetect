## release/src-rt-5.02L.07p2axhnd/bcmdrivers/opensource/misc/cpufreq/Kconfig.autodetect
```kconfig
config BCM_CPUFREQ
	tristate "BCM63XX CPUfreq driver"
	depends on BCM_COMMON_CLK
	default n
	help
	  This add the CPUFreq driver support for BCM63XX SOCs.

config BCM_CPUFREQ_IMPL
	int "Implementation index for CPUFreq driver"
	depends on BCM_CPUFREQ
	default 1
```

## release/src-rt-5.02L.07p2axhnd/bcmdrivers/opensource/misc/sound/asoc/Kconfig.autodetect
```kconfig
config BCM_SOUND
	bool "Broadcom 63xx sound support"
	default n
	help
	  Enable ALSA framework for Broadcom 63xx SoCs

config BCM_SOUND_IMPL
	int "Implementation index for sound driver"
	depends on BCM_SOUND
	default 1

config SND_BCM63xx_I2S_WHISTLER
	bool "SoC Audio Broadcom WHISTLER I2S module"
	help
	  Say Y if you want to add support for SoC audio on
	  I2S WHISTLER.

config SND_BCM63xx_SOC_I2S_ENG
	bool "SoC Audio Broadcom BLACKCOMB I2S module"
	help
	  Say Y if you want to add support for SoC audio on
	  I2S Blackcomb module.

config SND_BCM63XX_SOC_I2S_MACH
	bool "SoC Audio Broadcom BCM63158/178/47622 I2S machine"
	select REGMAP_MMIO
	help
	  Say Y if you want to add support for SoC audio on
	  BCM63158/178/47622.

config SND_BCM6856_SOC_I2S
	bool "SoC Audio Broadcom BCM6856 I2S module"
	select REGMAP_MMIO
	select SND_BCM63xx_SOC_I2S_ENG
	help
	  Say Y if you want to add support for SoC audio on
	  BCM6856.

config SND_BCM63148_SOC_I2S
	bool "SoC Audio Broadcom BCM63138/148 I2S module"
	select REGMAP_MMIO
	select SND_BCM63xx_SOC_I2S_ENG
	help
	  Say Y if you want to add support for SoC audio on
	  BCM63138/148.
	  
```

## release/src-rt-5.02L.07p2axhnd/bcmdrivers/opensource/misc/sound/codecs/Kconfig.autodetect
```kconfig
config BCM_SOUND
	bool "Broadcom 63xx sound support"
	default n
	help
	  Enable ALSA framework for Broadcom 63xx SoCs

config BCM_SOUND_IMPL
	int "Implementation index for sound driver"
	depends on BCM_SOUND
	default 1

config SND_SOC_MAPLELEAF
	bool "TI TLV320DAC3203 TLV320ADC3101 CODECS"
	help
	  Say Y if you want to add support for codecs attached to
	  the  I2S interface. You will also need
	  to select the audio interfaces to support it.

config SND_SOC_CS4345
	bool "Cirrus Logic CS4345 CODEC"
	help
	  Say Y if you want to add support for codecs attached to
	  the  I2S interface. You will also need
	  to select the audio interfaces to support it.

config SND_SOC_PCM5100
	bool "Cirrus Logic CS4345 CODEC"
	help
	  Say Y if you want to add support for codecs attached to
	  the  I2S interface. You will also need
	  to select the audio interfaces to support it.
```

## release/src-rt-5.02L.07p2axhnd/kernel/linux-4.1/arch/arm/plat-bcm63xx/Kconfig
```kconfig
if (BCM_KF_ARM_BCM963XX)
# Broadcom platforms selection

config PLAT_CA7_MPCORE
	bool "ARM Cortex A7 MPCORE architecture support"
    select CPU_V7
	select ARM_GIC
	select ARM_L1_CACHE_SHIFT_6
	select HAVE_CLK
	select COMMON_CLK
	select CLKDEV_LOOKUP
	select CLKSRC_OF
	select HAVE_ARM_ARCH_TIMER
    select SPARSE_IRQ
	help
	 Support for ARM A7 MPCORE subsystem
	  
config PLAT_CA7_SMP
    bool "Enable SMP on ARM Cortex A7 MPCORE"
	select HAVE_SMP
	select SMP
	select SMP_ON_UP
    select HOTPLUG_CPU
	select HAVE_ARM_SCU
	select PLAT_CA7_MPCORE
	help 
		 Support for ARM A7 SMP

config PLAT_CA9_MPCORE
	bool "ARM Cortex A9 MPCORE architecture support"
	select CPU_V7
	select ARM_GIC
	select HAVE_CLK
	select CLKDEV_LOOKUP
	select CLKSRC_OF
	select COMMON_CLK
	select GENERIC_CLOCKEVENTS_BUILD
	select GENERIC_CLOCKEVENTS
	select NEED_MACH_MEMORY_H
	select ARM_ERRATA_764369 if SMP && PLAT_BCM63138
#	select ARM_GLOBAL_TIMER
#	select CONSTRUCTORS
	help
	  Support for ARM A9 MPCORE subsystem

config PLAT_CA9_SMP
	bool "Enable SMP on ARM Cortex A9 MPCORE"
	select HAVE_SMP
	select SMP
	select SMP_ON_UP
	select HOTPLUG_CPU
	select HAVE_ARM_SCU

config PLAT_CA9_MPCORE_TIMER
	bool "Enable ARM Cortex A9 MPcore Timer for Clock event"
	select HAVE_ARM_TWD if PLAT_CA9_SMP
	select LOCAL_TIMERS if PLAT_CA9_SMP
	depends on PLAT_CA9_MPCORE

config PLAT_B15_CORE
	bool "Broadcom ARM based on Cortex A15 architecture support"
	select CPU_V7
	select ARM_GIC
	select HAVE_CLK
	select CLKDEV_LOOKUP
	select CLKSRC_OF
	select COMMON_CLK
	select GENERIC_CLOCKEVENTS_BUILD
	select GENERIC_CLOCKEVENTS
	select NEED_MACH_MEMORY_H
	help
	  Support for Broadcom's ARMv7 processr based on ARM Cortex A15

config PLAT_B15_SMP
	bool "Enable SMP on Broadcom ARMv7 core"
	select HAVE_SMP
	select SMP
	select SMP_ON_UP
	select HOTPLUG_CPU
	select HAVE_ARM_TWD
	select HAVE_ARM_SCU
	select LOCAL_TIMERS

config PLAT_B15_MPCORE_TIMER
	bool "Enable Broadcom B15 MPcore Timer for Clock event"
	select HAVE_ARM_TWD if PLAT_B15_SMP
	select LOCAL_TIMERS if PLAT_B15_SMP
	depends on PLAT_B15_CORE

config CACHE_L310 
	bool "PL310 Level-2 Cache Controller"
        select OUTER_CACHE
        select OUTER_CACHE_SYNC
	depends on PLAT_CA9_MPCORE

config PLAT_BCM63XX_AMBA_PL011
	bool "Enable AMBA PL011 Serial console"
	select ARM_AMBA
	select SERIAL_AMBA_PL011
	select SERIAL_AMBA_PL011_CONSOLE
	depends on PLAT_BCM63138

config PLAT_BCM63XX_AMBA_PL081
	bool "Enable AMBA PL081 DMAC"
	select DMADEVICES
	select ARM_AMBA
	select AMBA_PL08X
	depends on PLAT_BCM63138

config PLAT_BCM63XX_EMMC
	bool "Enable Broadcom EMMC support"
	select MMC
	select MMC_BLOCK
	select MMC_SDHCI
	select MMC_SDHCI_PLTFM
	select MMC_SDHCI_IO_ACCESSORS
	select MMC_SDHCI_BCM63xx
	depends on PLAT_BCM63138

config PLAT_BCM63XX_UART
	bool "Enable Broadcom Serial console"

config PLAT_BCM63XX_EXT_TIMER
	bool "Enable Broadcom External Timer for Clockevent"
	depends on BCM_EXT_TIMER

config PLAT_BCM63XX_ACP
	bool "Enable ARM ACP"
	default n
	select BCM_ZONE_ACP
	depends on PLAT_BCM63138 && PLAT_CA9_SMP

config PLAT_BCM63138
	bool "Broadcom BCM63138 SoC support"
# Based on ARM Cortex-A9 r4p1 and L310 r3p3
#	select PLAT_CA9_SMP		# will be chosen by BRCM_SMP_EN
	select ARM_ERRATA_754322
	select CACHE_L2X0
	select CACHE_PL310
	select EARLY_PRINTK
 	select PLAT_BCM63XX_EXT_TIMER
#	select PLAT_CA9_MPCORE_TIMER
#	select PLAT_BCM63XX_AMBA_PL011
	select PLAT_BCM63XX_UART
#	select MIGHT_HAVE_PCI
#	select HAVE_PWM			# kona has it, Do we?
	select ZONE_DMA
	select ARCH_SUPPORTS_MSI
	select CONFIG_ARCH_HAS_BARRIERS
	select HARDEN_BRANCH_PREDICTOR
	depends on PLAT_CA9_MPCORE

config PLAT_BCM63148
	bool "Broadcom BCM63148 SoC support"
# Based on ARM Cortex-A15 r3p2
	select ARM_L1_CACHE_SHIFT_6	# B15 L1 cache line size is 64 bytes
#	select PLAT_B15_SMP		# will be chosen by BRCM_SMP_EN
	select EARLY_PRINTK
 	select PLAT_BCM63XX_EXT_TIMER
	select PLAT_BCM63XX_UART
	select ARM_ERRATA_798181 if SMP
	select ZONE_DMA
	select ARCH_SUPPORTS_MSI
	select BCM_B15_MEGA_BARRIER
	select CONFIG_ARCH_HAS_BARRIERS
	select HARDEN_BRANCH_PREDICTOR
	depends on PLAT_B15_CORE

config BCM_PCIE_PLATFORM
	tristate "PCI Express repower module"

#Apply the mega-barrier prior to DMA operations to work around issue noted
#in HW7445-1301
config BCM_B15_MEGA_BARRIER
	depends on PLAT_B15_CORE
	bool

config HARDEN_BRANCH_PREDICTOR
	depends on PLAT_B15_CORE || PLAT_CA9_MPCORE
	bool

endif # BCM_KF_ARM_BCM963XX
```

## release/src-rt-5.02L.07p2axhnd/kernel/linux-4.1/net/mptcp/Kconfig
```kconfig
#if defined(CONFIG_BCM_MPTCP) && defined(CONFIG_BCM_KF_MPTCP)
#
# MPTCP configuration
#
config MPTCP
        bool "MPTCP protocol"
        depends on (IPV6=y || IPV6=n)
        ---help---
          This replaces the normal TCP stack with a Multipath TCP stack,
          able to use several paths at once.

menuconfig MPTCP_PM_ADVANCED
	bool "MPTCP: advanced path-manager control"
	depends on MPTCP=y
	---help---
	  Support for selection of different path-managers. You should choose 'Y' here,
	  because otherwise you will not actively create new MPTCP-subflows.

if MPTCP_PM_ADVANCED

config MPTCP_FULLMESH
	tristate "MPTCP Full-Mesh Path-Manager"
	depends on MPTCP=y
	---help---
	  This path-management module will create a full-mesh among all IP-addresses.

config MPTCP_NDIFFPORTS
	tristate "MPTCP ndiff-ports"
	depends on MPTCP=y
	---help---
	  This path-management module will create multiple subflows between the same
	  pair of IP-addresses, modifying the source-port. You can set the number
	  of subflows via the mptcp_ndiffports-sysctl.

config MPTCP_BINDER
	tristate "MPTCP Binder"
	depends on (MPTCP=y)
	---help---
	  This path-management module works like ndiffports, and adds the sysctl
	  option to set the gateway (and/or path to) per each additional subflow
	  via Loose Source Routing (IPv4 only).

choice
	prompt "Default MPTCP Path-Manager"
	default DEFAULT
	help
	  Select the Path-Manager of your choice

	config DEFAULT_FULLMESH
		bool "Full mesh" if MPTCP_FULLMESH=y

	config DEFAULT_NDIFFPORTS
		bool "ndiff-ports" if MPTCP_NDIFFPORTS=y

	config DEFAULT_BINDER
		bool "binder" if MPTCP_BINDER=y

	config DEFAULT_DUMMY
		bool "Default"

endchoice

endif

config DEFAULT_MPTCP_PM
	string
	default "default" if DEFAULT_DUMMY
	default "fullmesh" if DEFAULT_FULLMESH 
	default "ndiffports" if DEFAULT_NDIFFPORTS
	default "binder" if DEFAULT_BINDER
	default "default"

menuconfig MPTCP_SCHED_ADVANCED
	bool "MPTCP: advanced scheduler control"
	depends on MPTCP=y
	---help---
	  Support for selection of different schedulers. You should choose 'Y' here,
	  if you want to choose a different scheduler than the default one.

if MPTCP_SCHED_ADVANCED

config MPTCP_ROUNDROBIN
	tristate "MPTCP Round-Robin"
	depends on (MPTCP=y)
	---help---
	  This is a very simple round-robin scheduler. Probably has bad performance
	  but might be interesting for researchers.

config MPTCP_REDUNDANT
	tristate "MPTCP Redundant"
	depends on (MPTCP=y)
	---help---
	  This scheduler sends all packets redundantly over all subflows to decreases
	  latency and jitter on the cost of lower throughput.

choice
	prompt "Default MPTCP Scheduler"
	default DEFAULT
	help
	  Select the Scheduler of your choice

	config DEFAULT_SCHEDULER
		bool "Default"
		---help---
		  This is the default scheduler, sending first on the subflow
		  with the lowest RTT.

	config DEFAULT_ROUNDROBIN
		bool "Round-Robin" if MPTCP_ROUNDROBIN=y
		---help---
		  This is the round-rob scheduler, sending in a round-robin
		  fashion..

	config DEFAULT_REDUNDANT
		bool "Redundant" if MPTCP_REDUNDANT=y
		---help---
		  This is the redundant scheduler, sending packets redundantly over
		  all the subflows.

endchoice
endif

config DEFAULT_MPTCP_SCHED
	string
	depends on (MPTCP=y)
	default "default" if DEFAULT_SCHEDULER
	default "roundrobin" if DEFAULT_ROUNDROBIN
	default "redundant" if DEFAULT_REDUNDANT
	default "default"

#endif
```

## release/src-rt-5.02axhnd.675x/bcmdrivers/opensource/char/mcast/Kconfig.autodetect
```kconfig
config BCM_MCAST
	tristate "Support for Broadcom Multicast features"
	depends on BRIDGE
	depends on INET
	default n

config BCM_MCAST_IMPL
	int "Implementation index for Broadcom Multicast features"
	depends on BCM_MCAST
	default 1

config BR_IGMP_SNOOP
	bool "IGMP Snooping"
	depends on BCM_MCAST
	default n

config BR_MLD_SNOOP
	bool "MLD Snooping"
	depends on BCM_MCAST
	default n
```

## release/src-rt-5.02axhnd.675x/bcmdrivers/opensource/char/pdc/Kconfig.autodetect
```kconfig
config BCM_PDC
	tristate "Support for PDC"
	depends on BCM_SPU
	depends on BCM94908 || BCM963158 || BCM96858 || BCM947622
	default m

config BCM_PDC_IMPL
	int "Implementation index for PDC"
	depends on BCM_PDC
	default 1
```

## release/src-rt-5.02axhnd.675x/bcmdrivers/opensource/char/spudd/Kconfig.autodetect
```kconfig
config BCM_SPU
	tristate "Support for Crypto SPU"
	default n
	
config BCM_SPU_IMPL
	int "Implementation index for Crypto SPU"
	depends on BCM_SPU
	default 2 if BCM963268
	default 3 if BCM963138 || BCM963148
	default 4 if BCM94908 || BCM963158 || BCM96858 || BCM947622
```

## release/src-rt-5.02axhnd.675x/bcmdrivers/opensource/misc/clk/Kconfig.autodetect
```kconfig
config BCM_COMMON_CLK
	bool "Broadcom 63xx common clock support"
	select MFD_SYSCON
	select COMMON_CLK
	default n
	help
	  Enable common clock framework support for Broadcom 63xx SoCs

config BCM_COMMON_CLK_IMPL
	int "Implementation index for common clock driver"
	depends on BCM_COMMON_CLK
	default 1

config BCM_COMMON_CLK_I2S
	bool "Broadcom 63xx i2s common clock support"
	select MFD_SYSCON
	select COMMON_CLK
	help
	  Enable common clock framework support for Broadcom 63xx SoCs
```

## release/src-rt-5.02axhnd.675x/kernel/linux-4.1/Kconfig
```kconfig
#
# For a description of the syntax of this configuration file,
# see Documentation/kbuild/kconfig-language.txt.
#
mainmenu "Linux/$ARCH $KERNELVERSION Kernel Configuration"

config SRCARCH
	string
	option env="SRCARCH"

source "arch/$SRCARCH/Kconfig"

#IGNORE_BCM_KF_EXCEPTION

menu "Broadcom Specific Configurations"

source "Kconfig.bcm_kf"
source "Kconfig.bcm"

endmenu

config BCM_IN_KERNEL
	bool
	default y

source "Kconfig.asus"
```

## release/src-rt-5.02axhnd.675x/kernel/linux-4.1/Kconfig.asus
```kconfig
menu "ASUSWRT"

choice
	prompt "Choose Product"
	depends on BT
	help
	   Choose product

config RTAX95Q
	bool "RTAX95Q"
	default n

config RTAX56_XD4
	bool "RTAX56_XD4"
	default n

endchoice

endmenu # "ASUSWRT"
```

## release/src-rt-5.02axhnd.675x/kernel/linux-4.1/drivers/tee/optee/Kconfig
```kconfig
if BCM_KF_OPTEE_414_BACKPORTS
# OP-TEE Trusted Execution Environment Configuration
config OPTEE
	tristate "OP-TEE"
	depends on HAVE_ARM_SMCCC || BCM_KF_OPTEE
	help
	  This implements the OP-TEE Trusted Execution Environment (TEE)
	  driver.
endif # BCM_KF_OPTEE_414_BACKPORTS
```

## release/src-rt-5.02axhnd.675x/kernel/linux-4.1/net/phonet/Kconfig
```kconfig
#
# Phonet protocol
#

config PHONET
	tristate "Phonet protocols family"
	help
	  The Phone Network protocol (PhoNet) is a packet-oriented
	  communication protocol developed by Nokia for use with its modems.

	  This is required for Maemo to use cellular data connectivity (if
	  supported). It can also be used to control Nokia phones
	  from a Linux computer, although AT commands may be easier to use.

	  To compile this driver as a module, choose M here: the module
	  will be called phonet. If unsure, say N.
if BCM_KF_PHONET
if PHONET
config LD_PHONET
	tristate "Line Discipline for Phonet"
	help
	  Line discipline for transmitting and receiving phonet packet to modem
	  via TTY device

config LD_TMODEM
	tristate "Line Discipline for Thin Modem"
	help
	  Line discipline for transmitting and receiving thin modem packet to
	  modem via TTY device

config PHONET_DEBUG
	boolean "Debug support for PHONET drivers"
	depends on DEBUG_KERNEL
	help
          Say "yes" to enable phonet debug messaging

	  Activate Phonet header logging

	  Activate Phonet data logging
endif
endif
```
