## release/src-rt-5.02p1axhnd.675x/bcmdrivers/broadcom/char/pon_drv/Kconfig.autodetect
```kconfig
config BCM_PON_DRV
	tristate "Support for Broadcom Pon Drv features"
	depends on !BRCM_IKOS
	default m if BCM_PON_XRDP
	default m if BCM963158
	default n

config BCM_PON_DRV_IMPL
	int "Implementation index for Broadcom Pon Drv features"
	depends on BCM_PON_DRV
	default 1
```

## release/src-rt-5.04axhnd.675x/bcmdrivers/broadcom/char/lport_serdes/Kconfig.autodetect
```kconfig
config BCM_LPORT_SERDES
	tristate "Support for Broadcom Lport Serdes features"
	default n if BCM96858
    default n if BCM96838
	default n

config BCM_LPORT_SERDES_IMPL
	int "Implementation index for Broadcom Lport Serdes features"
	depends on BCM_LPORT_SERDES
	default 1
```

## release/src-rt-5.04axhnd.675x/bcmdrivers/broadcom/net/wl/impl87/main/components/rdk/develop/meta-rdk-broadcom-generic-rdk/meta-brcm-broadband/conf/machine/include/brcm-wifi-develop-tarball.inc
```bitbake
# Broadcom WiFi driver configuration
RDKB_WIFI_PROVIDER ?= "broadcom"
BRCM_WIFI_DRIVER_VER ?= "develop"

PREFERRED_PROVIDER_hal-wifi = "hal-wifi-broadcom"
MACHINE_EXTRA_RDEPENDS += "broadcom-wifi"
MACHINE_EXTRA_RDEPENDS += "broadcom-lattice-wifi"

# WIFI package server
# By default, BRCM_WIFI_PACKAGE_SERVER is defined as "file://".
# So you'll need to copy all WiFi packages to downloads/ directory manually.
# But if you have a local file server, you can use your server.
# For example,
#   BRCM_WIFI_PACKAGE_SERVER = "http://your_server.com/wifi_pkg/"
BRCM_WIFI_PACKAGE_SERVER ?= "file://"

BRCM_WIFI_DRIVER_BASE_DIR ?= "wl"
BRCM_WIFI_DRIVER_SRC_URI ?= "${BRCM_WIFI_PACKAGE_SERVER}wifi_src.tgz;subdir=${BRCM_WIFI_DRIVER_BASE_DIR};name=wifidrv"

BRCM_WIFI_RDK_SRC_URI ?= "${BRCM_WIFI_PACKAGE_SERVER}wifi_src_rdk.tgz;subdir=${BRCM_WIFI_DRIVER_BASE_DIR};name=wifirdk"

BRCM_WIFI_LATTICE_SRC_URI ?= "${BRCM_WIFI_PACKAGE_SERVER}lattice_wifi.tgz;subdir=git;name=wlanlattice"

BRCM_WIFI_CCSP_HAL_SRC_URI ?= "${BRCM_WIFI_PACKAGE_SERVER}wifi_src_rdk.tgz;subdir=git;name=wlanhal"
```

## release/src-rt-5.04axhnd.675x/bcmdrivers/opensource/bus/usb/Kconfig.autodetect
```kconfig
config BCM_BCA_USB
	tristate "Broadcom BCA USB Host Driver"
	depends on BCM_BCA_PINCTRL
	default n
	help
	  Add the BCM BCA USB host support.

config BCM_BCA_USB_IMPL
	int "Implementation index for BCA USB module"
	depends on BCM_BCA_USB
	default 1
```

## release/src-rt-5.04axhnd.675x/bcmdrivers/opensource/char/bcmspidev/Kconfig.autodetect
```kconfig
config BCM_SPIDEV_REV2
	bool "rev2 SPI device driver"
    #depends on BCM_HS_SPI 
    #depends on BCM_FTTDP_G9991
	help
	  Add the BCM BCA External Interrup support.

config BCM_SPIDEV_REV2_IMPL
	int "Implementation index for rev2 SPI device driver"
	depends on BCM_SPIDEV_REV2
	default 1
```

## release/src-rt-5.04axhnd.675x/bcmdrivers/opensource/char/cryptodev/Kconfig.autodetect
```kconfig
config BCM_CRYPTODEV
	tristate "Cyrptodev Linux module"
	default n

config BCM_CRYPTODEV_IMPL
	int "Implementation index for Cryptodev Linux"
	depends on BCM_CRYPTODEV
	default 1
```

## release/src-rt-5.04axhnd.675x/bcmdrivers/opensource/misc/bca_legacy_led/Kconfig.autodetect
```kconfig
config BCM_BCA_LEGACY_LED_API
	bool "Broadcom BCA Legacy LED API"
	depends on BCM_BCA_LED
	default n
	help
	  Add the BCM BCA Legacy LED support.

config BCM_BCA_LEGACY_LED_API_IMPL
	int "Implementation index for BCA Legacy LED module"
	depends on BCM_BCA_LEGACY_LED_API
	default 1
```

## release/src-rt-5.04axhnd.675x/bcmdrivers/opensource/misc/bca_pinctrl/Kconfig.autodetect
```kconfig
config BCM_BCA_PINCTRL
	bool "Broadcom BCA pin mux control"
	select PINCTRL
	select PINMUX
	default y
	help
	  Add the BCM BCA PINCTRL support.

config BCM_BCA_PINCTRL_IMPL
	int "Implementation index for BCA PINCTRL module"
	depends on BCM_BCA_PINCTRL
	default 1
```

## release/src-rt-5.04axhnd.675x/bcmdrivers/opensource/misc/button/Kconfig.autodetect
```kconfig
config BCM_BUTTON
	bool "Broadcom BCA Board Button driver"
	depends on BCM_BCA_EXTINTR
	default n
	help
	  Add the BCM BCA External Interrup support.

config BCM_BUTTON_IMPL
	int "Implementation index for BCA Board Button module"
	depends on BCM_BUTTON
	default 1
```

## release/src-rt-5.04axhnd.675x/bcmdrivers/opensource/misc/clk/Kconfig.autodetect
```kconfig
config BCM_COMMON_CLK
	bool "Broadcom 63xx common clock support"
	select MFD_SYSCON
	select COMMON_CLK
	default n
	help
	  Enable common clock framework support for Broadcom 63xx SoCs

config BCM_COMMON_CLK_IMPL
	int "Implementation index for common clock driver"
	depends on BCM_COMMON_CLK
	default 1

config BCM_COMMON_CLK_I2S
	bool "Broadcom 63xx i2s common clock support"
	select MFD_SYSCON
	select COMMON_CLK
	help
	  Enable I2S common clock framework support for Broadcom 63xx SoCs

config BCM_COMMON_CLK_I2S_TDM
	bool "Broadcom 63xx Merritt i2s/tdm common clock support"
	select MFD_SYSCON
	select COMMON_CLK
	help
	  Enable Merritt I2S common clock framework support for Broadcom 63xx SoCs

config BCM_COMMON_CLK_PCM
	bool "Broadcom 63xx PCM common clock support"
	select MFD_SYSCON
	select COMMON_CLK
	help
	  Enable PCM common clock framework support for Broadcom 63xx SoCs
```

## release/src-rt-5.04axhnd.675x/bcmdrivers/opensource/misc/pmc/Kconfig.autodetect
```kconfig
config BCM_PMC
	bool "Broadcom 63xx PMC driver"
	default n

config BCM_PMC_IMPL
	int "Implementation index for PMC driver"
	depends on BCM_PMC
	default 1
```

## release/src-rt-5.04axhnd.675x/bcmdrivers/opensource/misc/reset_button/Kconfig.autodetect
```kconfig
config BCM_RESET_BUTTON
	bool "Broadcom BCA Board Button driver"
	depends on BCM_BUTTON
	default n
	help
	  Add the BCM BCA External Interrup support.

config BCM_RESET_BUTTON_IMPL
	int "Implementation index for BCA Board Button module"
	depends on BCM_RESET_BUTTON
	default 1
```

## release/src-rt-5.04axhnd.675x/bcmdrivers/opensource/misc/voice/board_params/Kconfig.autodetect
```kconfig
config BCM_VOICE_PARAMS
	bool "Broadcom voice board params support"
	default n
	help
	  Enable board params for Broadcom dsl/pon SoCs

config BCM_VOICE_PARAMS_IMPL
	int "Implementation index for board params driver"
	depends on BCM_VOICE_PARAMS
	default 1
	
```

## release/src-rt-5.04axhnd.675x/bcmdrivers/opensource/misc/vregsync/Kconfig.autodetect
```kconfig
config BCM_BCA_VREG_SYNC
	bool "Broadcom BCA Vreg Sync driver"
	default n
	depends on BCM963158 || BCM963178 || BCM94912 || BCM963146 || BCM963138 || BCM963148
	help
	  Add the BCM BCA Vreg Sync Driver

config BCM_BCA_VREG_SYNC_IMPL
	int "Implementation index for BCA Vreg Sync module"
	depends on BCM_BCA_VREG_SYNC
	default 1
```

## release/src-rt-5.04axhnd.675x/bcmdrivers/opensource/misc/wantypedet/Kconfig.autodetect
```kconfig
config BCM_PON_WAN_TYPE_AUTO_DETECT
    tristate "Support for WAN type auto-detection"
    depends on BCM_I2C_CHIP && BCM_GPON
    default n

config BCM_PON_WAN_TYPE_AUTO_DETECT_IMPL
    int "Implementation index for BRCM WAN type auto-detection"
    depends on BCM_PON_WAN_TYPE_AUTO_DETECT
    default 1
```

## release/src-rt-5.04axhnd.675x/bootloaders/build/work/brcm_simple_aarch64_atf.its
```
/*
 * Copyright (C) 2017 Rockchip Electronic Co.,Ltd
 *
 * Simple U-boot fit source file containing U-Boot, dtb and optee
 */

/dts-v1/;

/ {
	description = "Simple image with ATF and OP-TEE support";
	#address-cells = <1>;

	images {
		atf {
			description = "ATF";
			data = /incbin/("../../obj/atf/armtf.bin");
			type = "firmware";
			arch = "arm64";
			os = "arm-trusted-firmware";
			compression = "none";
			load = <0x4000>;
			entry = <0x4000>;
			hash-1 {
				algo = "sha256";
			};
		};
		uboot {
			description = "U-Boot";
			data = /incbin/("../../obj/uboot/u-boot-nodtb.bin");
			os = "U-Boot";
			arch = "arm64";
			compression = "none";
			load = <0x01000000>;
			entry = <0x01000000>;
			hash-1 {
				algo = "sha256";
			};
		};
		fdt_uboot {
			description = "dtb";
			data = /incbin/("../../obj/uboot/dts/dt.dtb");
			type = "flat_dt";
			compression = "none";
			hash-1 {
				algo = "sha256";
			};
		};
	};

	configurations {
		default = "conf_uboot";
		conf_uboot {
			description = "BRCM 63xxx with ATF and uboot";
			fdt = "fdt_uboot";
			loadables = "atf", "uboot";
		};
	};
};
```

## release/src-rt-5.04axhnd.675x/bootloaders/build/work/brcm_simple_arm.its
```
/*
 * Copyright (C) 2017 Rockchip Electronic Co.,Ltd
 *
 * Simple U-boot fit source file containing U-Boot, dtb and optee
 */

/dts-v1/;

/ {
	description = "Simple image with ATF and OP-TEE support";
	#address-cells = <1>;

	images {
		uboot {
			description = "U-Boot";
			data = /incbin/("../../obj/uboot/u-boot-nodtb.bin");
			type = "firmware";
			os = "U-Boot";
			arch = "arm";
			compression = "none";
			load = <0x01000000>;
			hash-1 {
				algo = "sha256";
			};
		};
		fdt_uboot {
			description = "dtb";
			data = /incbin/("../../obj/uboot/dts/dt.dtb");
			type = "flat_dt";
			compression = "none";
			hash-1 {
				algo = "sha256";
			};
		};
	};

	configurations {
		default = "conf_uboot";
		conf_uboot {
			description = "BRCM 63xxx with uboot";
			fdt = "fdt_uboot";
			loadables = "uboot";
		};
	};
};
```

## release/src-rt-5.04axhnd.675x/bootloaders/build/work/delg_package.BM68.10001/10001_sec_policy.its
```
/dts-v1/;
/ {
security_policy {
	delegate_id = <10001>;
	min_tpl_compatibility = <0x2>;
	key-aes {
		description = "Encrypted AES key - Mandatory Node";
		data = < 0xFB3840E6 0x8BD9A677 0x35654EEA 0xB57FB892 0x42A6D652 0x52C60F7F 0x8D1DBC4A 0xB41E3801 0x3A6D3BB7 0x5CDAB7F4 0xFD58C5DC 0x7A208309>;
		algo = "aes-cbc-128";
	};
	sec_restriction {
		description = "Security Restrictions xxx - Optional Node";
		sw_restriction {
			status = "disabled";
			required_images {
				// Order of images is important

				// image1 {
				// 	//Name of the FIT node for this binary
				// 	node_name = "atf";
				// 	load_addr = <0x>;
				// 	start_addr = <0x>;
				// 	// Size of binary
				// 	size = <>;
				// 	// Output of sha256sum <binary>
				// 	sha256 = [];
				// };

				// image2 {
				//  	node_name = "optee";
				//  	load_addr = <0x>;
				//  	start_addr = <0x>;
				//  	size = <>;
				//  	sha256 = [];
				// };
			};
		};
		sec_exports {
			status = "enabled";
			allowed_exports = "SEC_ITEM_KEY_DEV_SPECIFIC,SEC_ITEM_SER_NUM";
		};
		hw_state {
 			// all    - Blocks access for all masters 
			// none   - Unlocks access for all masters
			// nonsec - Blocks access for nonsecure masters only.
			// prov   - unlock access for nonsecure provisioning by 
			//          locking populated data only (sotp)
			sotp-lock = "none";
			rng-lock = "none";
		};
	};
	anti-rollback {
		status = "disabled";
		description = "Anti-rollback update - Optional Node";
		new_antirollback = <1>;
		antirollback_limit = <64>;
	};
};

};
```

## release/src-rt-5.04axhnd.675x/bootloaders/build/work/delg_package.BR63.10001/10001_sec_policy.its
```
/dts-v1/;
/ {
security_policy {
	delegate_id = <10001>;
	min_tpl_compatibility = <0x2>;
	key-aes {
		description = "Encrypted AES key - Mandatory Node";
		data = < 0x6F44925B 0x4B748D39 0x89096BCB 0x1C49E52A 0xA7FE8477 0x6452F88A 0x1BE11EC3 0xF68BA1A3 0xD2CA6367 0xB2D40451 0x259DACA9 0x8E30E6D6>;
		algo = "aes-cbc-128";
	};
	sec_restriction {
		description = "Security Restrictions xxx - Optional Node";
		sw_restriction {
			status = "disabled";
			required_images {
				// Order of images is important

				// image1 {
				// 	//Name of the FIT node for this binary
				// 	node_name = "atf";
				// 	load_addr = <0x>;
				// 	start_addr = <0x>;
				// 	// Size of binary
				// 	size = <>;
				// 	// Output of sha256sum <binary>
				// 	sha256 = [];
				// };

				// image2 {
				//  	node_name = "optee";
				//  	load_addr = <0x>;
				//  	start_addr = <0x>;
				//  	size = <>;
				//  	sha256 = [];
				// };
			};
		};
		sec_exports {
			status = "enabled";
			allowed_exports = "SEC_ITEM_KEY_DEV_SPECIFIC,SEC_ITEM_SER_NUM";
		};
		hw_state {
 			// all    - Blocks access for all masters 
			// none   - Unlocks access for all masters
			// nonsec - Blocks access for nonsecure masters only.
			// prov   - unlock access for nonsecure provisioning by 
			//          locking populated data only (sotp)
			sotp-lock = "none";
			rng-lock = "none";
		};
	};
	anti-rollback {
		status = "disabled";
		description = "Anti-rollback update - Optional Node";
		new_antirollback = <1>;
		antirollback_limit = <64>;
	};
};

};
```

## release/src-rt-5.04axhnd.675x/bootloaders/build/work/delg_package.EBA63.10001/10001_sec_policy.its
```
/dts-v1/;
/ {
security_policy {
	delegate_id = <10001>;
	min_tpl_compatibility = <0x2>;
	key-aes {
		description = "Encrypted AES key - Mandatory Node";
		data = < 0x75AEC543 0x34545E22 0x8E40C290 0xF331874C 0x7EB87E33 0xF60974FE 0x2FEC8715 0x6D4B30B0 0xD3FE1E53 0x20C19612 0x6FF8E49B 0x7DA1CAD2>;
		algo = "aes-cbc-128";
	};
	sec_restriction {
		description = "Security Restrictions xxx - Optional Node";
		sw_restriction {
			status = "disabled";
			required_images {
				// Order of images is important

				// image1 {
				// 	//Name of the FIT node for this binary
				// 	node_name = "atf";
				// 	load_addr = <0x>;
				// 	start_addr = <0x>;
				// 	// Size of binary
				// 	size = <>;
				// 	// Output of sha256sum <binary>
				// 	sha256 = [];
				// };

				// image2 {
				//  	node_name = "optee";
				//  	load_addr = <0x>;
				//  	start_addr = <0x>;
				//  	size = <>;
				//  	sha256 = [];
				// };
			};
		};
		sec_exports {
			status = "enabled";
			allowed_exports = "SEC_ITEM_KEY_DEV_SPECIFIC,SEC_ITEM_SER_NUM";
		};
		hw_state {
 			// all    - Blocks access for all masters 
			// none   - Unlocks access for all masters
			// nonsec - Blocks access for nonsecure masters only.
			// prov   - unlock access for nonsecure provisioning by 
			//          locking populated data only (sotp)
			sotp-lock = "none";
			rng-lock = "none";
		};
	};
	anti-rollback {
		status = "disabled";
		description = "Anti-rollback update - Optional Node";
		new_antirollback = <1>;
		antirollback_limit = <64>;
	};
};

};
```

## release/src-rt-5.04axhnd.675x/bootloaders/build/work/delg_package/12345_sec_policy.its
```
/dts-v1/;
/ {
security_policy {
	delegate_id = <12345>;
	min_tpl_compatibility = <0x2>;
	key-aes {
		description = "Encrypted AES key - Mandatory Node";
		data = < 0xD9B06EEC 0xF0CCFA82 0xE629721 0x88970D9C 0x92F973B2 0x2B5FA3EA 0x2759D8FE 0x66590FD 0x3CDAF958 0xC6FBC5A7 0x19CD2C77 0xCE9DBD3F>;
		algo = "aes-cbc-128";
	};
	sec_restriction {
		description = "Security Restrictions xxx - Optional Node";
		sw_restriction {
			status = "disabled";
			required_images {
				// Order of images is important

				// image1 {
				// 	//Name of the FIT node for this binary
				// 	node_name = "atf";
				// 	load_addr = <0x>;
				// 	start_addr = <0x>;
				// 	// Size of binary
				// 	size = <>;
				// 	// Output of sha256sum <binary>
				// 	sha256 = [];
				// };

				// image2 {
				//  	node_name = "optee";
				//  	load_addr = <0x>;
				//  	start_addr = <0x>;
				//  	size = <>;
				//  	sha256 = [];
				// };
			};
		};
		sec_exports {
			status = "enabled";
			allowed_exports = "SEC_ITEM_KEY_DEV_SPECIFIC,SEC_ITEM_SER_NUM";
		};
		hw_state {
 			// all    - Blocks access for all masters 
			// none   - Unlocks access for all masters
			// nonsec - Blocks access for nonsecure masters only.
			// prov   - unlock access for nonsecure provisioning by 
			//          locking populated data only (sotp)
			sotp-lock = "prov";
			rng-lock = "none";
		};
	};
	anti-rollback {
		status = "disabled";
		description = "Anti-rollback update - Optional Node";
		new_antirollback = <10>;
		antirollback_limit = <2>;
	};
};

};
```

## release/src-rt-5.04axhnd.675x/bootloaders/u-boot-2019.07/api/Kconfig
```kconfig
menu "API"

config API
	bool "Enable U-Boot API"
	default n
	help
	  This option enables the U-Boot API. See api/README for more information.

endmenu
```
