## release/src-rt-5.04axhnd.675x/bootloaders/u-boot-2019.07/arch/arm/mach-bcmbca/bcmbca_dpfe/Kconfig
```kconfig
# SPDX-License-Identifier: GPL-2.0+
#
# (C) Copyright 2019 Broadcom Ltd
#

config MHS_VER
	string "MHS version"
	default "2p2" if BCM47622
	default "4p3" if BCM63146
	default "5p3" if BCM4912 || BCM6813

config DPFE_SEGSIZE
	hex "dpfe segment size"
	default 0x500c

config MEMC_VER
	string "MEMC version"
	default "4p50" if BCM47622
	default "5p1" if BCM63146
	default "5p3" if BCM4912 || BCM6813

config MEMC_PHY_WIDTH
	int "MEMC PHY width"
	default 32 if BCM47622 || BCM4912 || BCM6813
	default 16 if BCM63146
```

## release/src-rt-5.04axhnd.675x/bootloaders/u-boot-2019.07/arch/arm/mach-highbank/Kconfig
```kconfig
if ARCH_HIGHBANK

config SYS_BOARD
	default "highbank"

config SYS_SOC
	default "highbank"

config SYS_CONFIG_NAME
	default "highbank"

endif
```

## release/src-rt-5.04axhnd.675x/bootloaders/u-boot-2019.07/arch/arm/mach-imx/Kconfig
```kconfig
config HAS_CAAM
	bool

config IMX_CONFIG
	string

config ROM_UNIFIED_SECTIONS
	bool

config SYSCOUNTER_TIMER
	bool

config GPT_TIMER
	bool

config IMX_RDC
	bool "i.MX Resource domain controller driver"
	depends on ARCH_MX6 || ARCH_MX7
	help
	  i.MX Resource domain controller is used to assign masters
	  and peripherals to differet domains. This can be used to
	  isolate resources.

config IMX_BOOTAUX
	bool "Support boot auxiliary core"
	depends on ARCH_MX7 || ARCH_MX6 || ARCH_VF610
	help
	  bootaux [addr] to boot auxiliary core.

config USE_IMXIMG_PLUGIN
	bool "Use imximage plugin code"
	depends on ARCH_MX7 || ARCH_MX6 || ARCH_MX7ULP
	help
	  i.MX6/7 supports DCD and Plugin. Enable this configuration
	  to use Plugin, otherwise DCD will be used.

config SECURE_BOOT
	bool "Support i.MX HAB features"
	depends on ARCH_MX7 || ARCH_MX6 || ARCH_MX5
	select FSL_CAAM if HAS_CAAM
	imply CMD_DEKBLOB
	help
	  This option enables the support for secure boot (HAB).
	  See doc/README.mxc_hab for more details.

config CMD_BMODE
	bool "Support the 'bmode' command"
	default y
	depends on ARCH_MX6 || ARCH_MX5
	help
	  This enables the 'bmode' (bootmode) command for forcing
	  a boot from specific media.

	  This is useful for forcing the ROM's usb downloader to
	  activate upon a watchdog reset which is nice when iterating
	  on U-Boot.  Using the reset button or running bmode normal
	  will set it back to normal.  This command currently
	  supports i.MX53 and i.MX6.

config CMD_DEKBLOB
	bool "Support the 'dek_blob' command"
	help
	  This enables the 'dek_blob' command which is used with the
	  Freescale secure boot mechanism. This command encapsulates and
	  creates a blob of data. See also CMD_BLOB and doc/README.mxc_hab for
	  more information.

config CMD_HDMIDETECT
	bool "Support the 'hdmidet' command"
	help
	  This enables the 'hdmidet' command which detects if an HDMI monitor
	  is connected.

config NXP_BOARD_REVISION
	bool "Read NXP board revision from fuses"
	depends on ARCH_MX6 || ARCH_MX7
	help
	  NXP boards based on i.MX6/7 contain the board revision information
	  stored in the fuses. Select this option if you want to be able to
	  retrieve the board revision information.

config DDRMC_VF610_CALIBRATION
	bool "Enable DDRMC (DDR3) on-chip calibration"
	depends on ARCH_VF610
	help
	  Vybrid (vf610) SoC provides some on-chip facility to tune the DDR3
	  memory parameters. Select this option if you want to calculate them
	  at boot time.
	  NOTE:
	  NXP does NOT recommend to perform this calibration at each boot. One
	  shall perform it on a new PCB and then use those values to program
	  the ddrmc_cr_setting on relevant board file.
```

## release/src-rt-5.04axhnd.675x/bootloaders/u-boot-2019.07/arch/arm/mach-imx/imx8m/Kconfig
```kconfig
if ARCH_IMX8M

config IMX8M
	bool
	select ROM_UNIFIED_SECTIONS

config SYS_SOC
	default "imx8m"

choice
	prompt  "NXP i.MX8M board select"
	optional

config TARGET_IMX8MQ_EVK
	bool "imx8mq_evk"
	select IMX8M
	select IMX8M_LPDDR4

endchoice

source "board/freescale/imx8mq_evk/Kconfig"

endif
```

## release/src-rt-5.04axhnd.675x/bootloaders/u-boot-2019.07/arch/arm/mach-imx/mx5/Kconfig
```kconfig
if ARCH_MX5

config MX5
	bool
	default y
	select GPT_TIMER

config MX51
	bool
	select ARM_CORTEX_A8_CVE_2017_5715
	select SYS_FSL_ERRATUM_ESDHC_A001

config MX53
	bool
	select ARM_CORTEX_A8_CVE_2017_5715

choice
	prompt "MX5 board select"
	optional

config TARGET_KP_IMX53
	bool "Support K+P imx53 board"
	select BOARD_LATE_INIT
	select DM
	select DM_ETH
	select DM_GPIO
	select DM_I2C
	select DM_PMIC
	select DM_SERIAL
	select DM_MMC
	select BLK
	select DM_USB
	select DM_REGULATOR
	select MX53
	imply CMD_DM

config TARGET_M53MENLO
	bool "Support m53menlo"
	select MX53
	select SUPPORT_SPL

config TARGET_MX51EVK
	bool "Support mx51evk"
	select BOARD_LATE_INIT
	select MX51

config TARGET_MX53ARD
	bool "Support mx53ard"
	select MX53

config TARGET_MX53CX9020
	bool "Support CX9020"
	select BOARD_LATE_INIT
	select DM
	select DM_SERIAL
	select MX53
	imply CMD_DM

config TARGET_MX53EVK
	bool "Support mx53evk"
	select BOARD_LATE_INIT
	select MX53

config TARGET_MX53LOCO
	bool "Support mx53loco"
	select BOARD_LATE_INIT
	select MX53

config TARGET_MX53PPD
	bool "Support mx53ppd"
	select MX53
	help
	  Enable support for the GE Healthcare PPD.

config TARGET_MX53SMD
	bool "Support mx53smd"
	select MX53

config TARGET_TS4800
	bool "Support TS4800"
	select MX51

config TARGET_USBARMORY
	bool "Support USB armory"
	select MX53

endchoice

config SYS_SOC
	default "mx5"

source "board/beckhoff/mx53cx9020/Kconfig"
source "board/freescale/mx51evk/Kconfig"
source "board/freescale/mx53ard/Kconfig"
source "board/freescale/mx53evk/Kconfig"
source "board/freescale/mx53loco/Kconfig"
source "board/freescale/mx53smd/Kconfig"
source "board/ge/mx53ppd/Kconfig"
source "board/inversepath/usbarmory/Kconfig"
source "board/k+p/kp_imx53/Kconfig"
source "board/menlo/m53menlo/Kconfig"
source "board/technologic/ts4800/Kconfig"

endif
```
