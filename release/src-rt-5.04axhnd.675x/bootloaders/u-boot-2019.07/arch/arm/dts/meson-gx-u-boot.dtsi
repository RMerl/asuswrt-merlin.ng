// SPDX-License-Identifier: (GPL-2.0+ OR MIT)
/*
 * Copyright (c) 2019 BayLibre, SAS.
 * Author: Maxime Jourdan <mjourdan@baylibre.com>
 */

/ {
	soc {
		u-boot,dm-pre-reloc;
	};
};

&vpu {
	u-boot,dm-pre-reloc;
};

&hdmi_tx {
	reg = <0x0 0xc883a000 0x0 0x1c>,
	      <0x0 0xc883c000 0x0 0x1000>;
	reg-names = "hdmitx", "hhi";
};
