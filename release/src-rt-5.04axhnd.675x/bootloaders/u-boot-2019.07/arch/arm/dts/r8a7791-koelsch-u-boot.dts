// SPDX-License-Identifier: GPL-2.0
/*
 * Device Tree Source extras for U-Boot for the Koelsch board
 *
 * Copyright (C) 2018 Marek Vasut <marek.vasut@gmail.com>
 */

#include "r8a7791-koelsch.dts"
#include "r8a7791-u-boot.dtsi"

&scif0 {
	u-boot,dm-pre-reloc;
};

&qspi {
	flash@0 {
		spi-tx-bus-width = <1>;
		spi-rx-bus-width = <1>;
	};
};
