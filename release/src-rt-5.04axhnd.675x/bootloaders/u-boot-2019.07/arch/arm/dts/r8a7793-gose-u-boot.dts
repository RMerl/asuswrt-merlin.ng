// SPDX-License-Identifier: GPL-2.0
/*
 * Device Tree Source extras for U-Boot for the Gose board
 *
 * Copyright (C) 2018 Marek Vasut <marek.vasut@gmail.com>
 */

#include "r8a7793-gose.dts"
#include "r8a7793-u-boot.dtsi"

&scif0 {
	u-boot,dm-pre-reloc;
};

&qspi {
	flash@0 {
		spi-tx-bus-width = <1>;
		spi-rx-bus-width = <1>;
	};
};
