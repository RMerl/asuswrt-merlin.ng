// SPDX-License-Identifier: GPL-2.0
/*
 * Copyright (C) 2018, STMicroelectronics - All Rights Reserved
 * Author(s): Patrice Chotard, <patrice.chotard@st.com> for STMicroelectronics.
 *
 */

/{
	soc {
		st_dwc3: dwc3@8f94000 {
			dwc3: dwc3@9900000 {
				phys = <&usb2_picophy0>;
			};
		};
	};
};
