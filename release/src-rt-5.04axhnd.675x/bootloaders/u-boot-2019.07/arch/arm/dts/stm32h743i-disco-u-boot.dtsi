// SPDX-License-Identifier: GPL-2.0+

#include <stm32h7-u-boot.dtsi>

&sdmmc1 {
	status = "okay";
	pinctrl-0 = <&sdmmc1_pins>;
	pinctrl-names = "default";
	bus-width = <4>;
	cd-gpios = <&gpioi 8 1>;
};
