// SPDX-License-Identifier: GPL-2.0+ OR X11
/*
 * Copyright 2015 Hans de Goede <hdegoede@redhat.com>
 *
 * Minimal dts file for the Yones Toptech BD1078 for u-boot only
 */

/dts-v1/;
#include "sun7i-a20.dtsi"

/ {
	model = "Yones Toptech BD1078";
	compatible = "yones,toptech-bd1078", "allwinner,sun7i-a20";

	aliases {
		serial0 = &uart0;
	};

	chosen {
		stdout-path = "serial0:115200n8";
	};
};

&uart0 {
	pinctrl-names = "default";
	pinctrl-0 = <&uart0_pb_pins>;
	status = "okay";
};
