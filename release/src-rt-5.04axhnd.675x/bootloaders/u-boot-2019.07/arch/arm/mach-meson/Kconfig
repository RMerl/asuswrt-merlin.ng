## release/src-rt-5.04axhnd.675x/bootloaders/u-boot-2019.07/arch/arm/mach-stm32/Kconfig
```kconfig
if STM32

config STM32F4
	bool "stm32f4 family"
	select CLK
	select DM_GPIO
	select DM_RESET
	select MISC
	select PINCTRL
	select PINCTRL_STM32
	select RAM
	select STM32_RCC
	select STM32_RESET
	select STM32_SDRAM
	select STM32_SERIAL
	select STM32_TIMER
	select TIMER

config STM32F7
	bool "stm32f7 family"
	select CLK
	select DM_GPIO
	select DM_RESET
	select MISC
	select PINCTRL
	select PINCTRL_STM32
	select RAM
	select SPL
	select SPL_BOARD_INIT
	select SPL_CLK
	select SPL_DM
	select SPL_DM_RESET
	select SPL_DM_SEQ_ALIAS
	select SPL_DRIVERS_MISC_SUPPORT
	select SPL_GPIO_SUPPORT
	select SPL_LIBCOMMON_SUPPORT
	select SPL_LIBGENERIC_SUPPORT
	select SPL_MTD_SUPPORT
	select SPL_OF_CONTROL
	select SPL_OF_LIBFDT
	select SPL_OF_TRANSLATE
	select SPL_PINCTRL
	select SPL_RAM
	select SPL_SERIAL_SUPPORT
	select SPL_SYS_MALLOC_SIMPLE
	select SPL_TIMER
	select SPL_XIP_SUPPORT
	select STM32_RCC
	select STM32_RESET
	select STM32_SDRAM
	select STM32_SERIAL
	select STM32_TIMER
	select SUPPORT_SPL
	select TIMER
	imply SPL_OS_BOOT

config STM32H7
	bool "stm32h7 family"
	select CLK
	select DM_GPIO
	select DM_RESET
	select MISC
	select PINCTRL
	select PINCTRL_STM32
	select RAM
	select REGMAP
	select STM32_RCC
	select STM32_RESET
	select STM32_SDRAM
	select STM32_SERIAL
	select STM32_TIMER
	select SYSCON
	select TIMER

source "arch/arm/mach-stm32/stm32f4/Kconfig"
source "arch/arm/mach-stm32/stm32f7/Kconfig"
source "arch/arm/mach-stm32/stm32h7/Kconfig"

endif
```

## release/src-rt-5.04axhnd.675x/bootloaders/u-boot-2019.07/arch/arm/mach-tegra/Kconfig
```kconfig
if TEGRA

config SPL_GPIO_SUPPORT
	default y

config SPL_LIBCOMMON_SUPPORT
	default y

config SPL_LIBGENERIC_SUPPORT
	default y

config SPL_SERIAL_SUPPORT
	default y

config TEGRA_CLKRST
	bool

config TEGRA_GP_PADCTRL
	bool

config TEGRA_IVC
	bool "Tegra IVC protocol"
	help
	  IVC (Inter-VM Communication) protocol is a Tegra-specific IPC
	  (Inter Processor Communication) framework. Within the context of
	  U-Boot, it is typically used for communication between the main CPU
	  and various auxiliary processors.

config TEGRA_MC
	bool

config TEGRA_PINCTRL
	bool

config TEGRA_PMC
	bool

config TEGRA_PMC_SECURE
	bool
	depends on TEGRA_PMC

config TEGRA_COMMON
	bool "Tegra common options"
	select BINMAN
	select BOARD_EARLY_INIT_F
	select CLK
	select DM
	select DM_ETH
	select DM_GPIO
	select DM_I2C
	select DM_KEYBOARD
	select DM_MMC
	select DM_PWM
	select DM_RESET
	select DM_SERIAL
	select DM_SPI
	select DM_SPI_FLASH
	select MISC
	select OF_CONTROL
	select SPI
	select VIDCONSOLE_AS_LCD if DM_VIDEO
	imply CMD_DM
	imply CRC32_VERIFY

config TEGRA_NO_BPMP
	bool "Tegra common options for SoCs without BPMP"
	select TEGRA_CAR
	select TEGRA_CAR_CLOCK
	select TEGRA_CAR_RESET

config TEGRA_ARMV7_COMMON
	bool "Tegra 32-bit common options"
	select CPU_V7A
	select SPL
	select SPL_BOARD_INIT if SPL
	select SUPPORT_SPL
	select TEGRA_CLKRST
	select TEGRA_COMMON
	select TEGRA_GPIO
	select TEGRA_GP_PADCTRL
	select TEGRA_MC
	select TEGRA_NO_BPMP
	select TEGRA_PINCTRL
	select TEGRA_PMC

config TEGRA_ARMV8_COMMON
	bool "Tegra 64-bit common options"
	select ARM64
	select LINUX_KERNEL_IMAGE_HEADER
	select POSITION_INDEPENDENT
	select TEGRA_COMMON

if TEGRA_ARMV8_COMMON
config LNX_KRNL_IMG_TEXT_OFFSET_BASE
	default 0x80000000
endif

choice
	prompt "Tegra SoC select"
	optional

config TEGRA20
	bool "Tegra20 family"
	select ARM_ERRATA_716044
	select ARM_ERRATA_742230
	select ARM_ERRATA_751472
	select TEGRA_ARMV7_COMMON

config TEGRA30
	bool "Tegra30 family"
	select ARM_ERRATA_743622
	select ARM_ERRATA_751472
	select TEGRA_ARMV7_COMMON

config TEGRA114
	bool "Tegra114 family"
	select TEGRA_ARMV7_COMMON

config TEGRA124
	bool "Tegra124 family"
	select TEGRA_ARMV7_COMMON
	imply REGMAP
	imply SYSCON

config TEGRA210
	bool "Tegra210 family"
	select TEGRA_ARMV8_COMMON
	select TEGRA_CLKRST
	select TEGRA_GPIO
	select TEGRA_GP_PADCTRL
	select TEGRA_MC
	select TEGRA_NO_BPMP
	select TEGRA_PINCTRL
	select TEGRA_PMC
	select TEGRA_PMC_SECURE

config TEGRA186
	bool "Tegra186 family"
	select DM_MAILBOX
	select TEGRA186_BPMP
	select TEGRA186_CLOCK
	select TEGRA186_GPIO
	select TEGRA186_RESET
	select TEGRA_ARMV8_COMMON
	select TEGRA_HSP
	select TEGRA_IVC

endchoice

config TEGRA_DISCONNECT_UDC_ON_BOOT
	bool "Disconnect USB device mode controller on boot"
	depends on CI_UDC
	default y
	help
	  When loading U-Boot into RAM over USB protocols using tools such as
	  tegrarcm or L4T's exec-uboot.sh/tegraflash.py, Tegra's USB device
	  mode controller is initialized and enumerated by the host PC running
	  the tool. Unfortunately, these tools do not shut down the USB
	  controller before executing the downloaded code, and so the host PC
	  does not "de-enumerate" the USB device. This option shuts down the
	  USB controller when U-Boot boots to avoid leaving a stale USB device
	  present.

config SYS_MALLOC_F_LEN
	default 0x1800

source "arch/arm/mach-tegra/tegra20/Kconfig"
source "arch/arm/mach-tegra/tegra30/Kconfig"
source "arch/arm/mach-tegra/tegra114/Kconfig"
source "arch/arm/mach-tegra/tegra124/Kconfig"
source "arch/arm/mach-tegra/tegra210/Kconfig"
source "arch/arm/mach-tegra/tegra186/Kconfig"

config CMD_ENTERRCM
	bool "Enable 'enterrcm' command"
	default y
	help
	  Tegra's boot ROM supports a mode whereby code may be downloaded and
	  flash-programmed over a USB connection. On dev boards, this is
	  typically entered by holding down a "force recovery" button and
	  resetting the CPU. However, not all boards have such a button (one
	  example is the Compulab Trimslice), so a method to enter RCM from
	  software is useful.

	  Even on boards other than Trimslice, controlling this over a UART
	  may be useful, e.g. to allow simple remote control without the need
	  for mechanical button actuators, or hooking up relays/... to the
	  button.

endif
```

## release/src-rt-5.04axhnd.675x/bootloaders/u-boot-2019.07/arch/arm/mach-tegra/tegra186/Kconfig
```kconfig
# Copyright (c) 2016, NVIDIA CORPORATION.
#
# SPDX-License-Identifier: GPL-2.0

if TEGRA186

choice
	prompt "Tegra186 board select"

config TARGET_P2771_0000
	bool "NVIDIA Tegra186 P2771-0000 board"
	select BOARD_LATE_INIT
	help
	  P2771-0000 is a P3310 CPU board married to a P2597 I/O board. The
	  combination contains SoC, DRAM, eMMC, SD card slot, HDMI, USB
	  micro-B port, Ethernet, USB3 host port, SATA, PCIe, and two GPIO
	  expansion headers.

endchoice

config SYS_SOC
	default "tegra186"

config SYS_INIT_SP_BSS_OFFSET
	default 524288

source "board/nvidia/p2771-0000/Kconfig"

endif
```

## release/src-rt-5.04axhnd.675x/bootloaders/u-boot-2019.07/arch/arm/mach-tegra/tegra20/Kconfig
```kconfig
if TEGRA20

choice
	prompt "Tegra20 board select"
	optional

config TARGET_HARMONY
	bool "NVIDIA Tegra20 Harmony evaluation board"
	select BOARD_LATE_INIT

config TARGET_MEDCOM_WIDE
	bool "Avionic Design Medcom-Wide board"
	select BOARD_LATE_INIT

config TARGET_PAZ00
	bool "Paz00 board"
	select BOARD_LATE_INIT

config TARGET_PLUTUX
	bool "Avionic Design Plutux board"
	select BOARD_LATE_INIT

config TARGET_SEABOARD
	bool "NVIDIA Seaboard"
	select BOARD_LATE_INIT

config TARGET_TEC
	bool "Avionic Design Tamonten Evaluation Carrier"
	select BOARD_LATE_INIT

config TARGET_TRIMSLICE
	bool "Compulab TrimSlice board"
	select BOARD_LATE_INIT

config TARGET_VENTANA
	bool "NVIDIA Tegra20 Ventana evaluation board"
	select BOARD_LATE_INIT

config TARGET_COLIBRI_T20
	bool "Toradex Colibri T20 board"
	select BOARD_LATE_INIT

endchoice

config SYS_SOC
	default "tegra20"

source "board/nvidia/harmony/Kconfig"
source "board/avionic-design/medcom-wide/Kconfig"
source "board/compal/paz00/Kconfig"
source "board/avionic-design/plutux/Kconfig"
source "board/nvidia/seaboard/Kconfig"
source "board/avionic-design/tec/Kconfig"
source "board/compulab/trimslice/Kconfig"
source "board/nvidia/ventana/Kconfig"
source "board/toradex/colibri_t20/Kconfig"

endif
```

## release/src-rt-5.04axhnd.675x/bootloaders/u-boot-2019.07/arch/arm/mach-versal/Kconfig
```kconfig
# SPDX-License-Identifier: GPL-2.0+

if ARCH_VERSAL

config SYS_BOARD
	string "Board name"
	default "versal"

config SYS_VENDOR
	string "Vendor name"
	default "xilinx"

config SYS_SOC
	default "versal"

config SYS_CONFIG_NAME
	string "Board configuration name"
	default "xilinx_versal"
	help
	  This option contains information about board configuration name.
	  Based on this option include/configs/<CONFIG_SYS_CONFIG_NAME>.h header
	  will be used for board configuration.

config GICV3
	def_bool y

config SYS_MALLOC_LEN
	default 0x2000000

config COUNTER_FREQUENCY
	int "Timer clock frequency"
	default 0
	help
	  Setup time clock frequency for certain platform

config ZYNQ_SDHCI_MAX_FREQ
	default 200000000

config VERSAL_OF_BOARD_DTB_ADDR
	hex
	default 0x1000
	depends on OF_BOARD

config IOU_SWITCH_DIVISOR0
	hex "IOU switch divisor0"
	default 0x20
	help
	  Setup time clock divisor for input clock.

config SYS_MEM_RSVD_FOR_MMU
	bool "Reserve memory for MMU Table"
	help
	  If defined this option is used to setup different space for
	  MMU table than the one which will be allocated during
	  relocation.

endif
```

## release/src-rt-5.04axhnd.675x/bootloaders/u-boot-2019.07/arch/arm/mach-zynqmp/Kconfig
```kconfig
if ARCH_ZYNQMP

config SPL_FS_FAT
	default y

config SPL_LIBCOMMON_SUPPORT
	default y

config SPL_LIBDISK_SUPPORT
	default y

config SPL_LIBGENERIC_SUPPORT
	default y

config SPL_MMC_SUPPORT
	default y if MMC_SDHCI_ZYNQ

config SPL_SERIAL_SUPPORT
	default y

config SPL_SPI_FLASH_SUPPORT
	default y if ZYNQ_QSPI

config SPL_SPI_SUPPORT
	default y if ZYNQ_QSPI

config SYS_BOARD
	default "zynqmp"

config SYS_VENDOR
	string "Vendor name"
	default "xilinx"

config SYS_SOC
	default "zynqmp"

config SYS_CONFIG_NAME
	string "Board configuration name"
	default "xilinx_zynqmp"
	help
	  This option contains information about board configuration name.
	  Based on this option include/configs/<CONFIG_SYS_CONFIG_NAME>.h header
	  will be used for board configuration.

config SYS_MEM_RSVD_FOR_MMU
	bool "Reserve memory for MMU Table"
	help
	  If defined this option is used to setup different space for
	  MMU table than the one which will be allocated during
	  relocation.

config BOOT_INIT_FILE
	string "boot.bin init register filename"
	depends on SPL
	default ""
	help
	  Add register writes to boot.bin format (max 256 pairs).
	  Expect a table of register-value pairs, e.g. "0x12345678 0x4321"

config PMUFW_INIT_FILE
	string "PMU firmware"
	depends on SPL
	default ""
	help
	  Include external PMUFW (Platform Management Unit FirmWare) to
	  a Xilinx bootable image (boot.bin).

config ZYNQMP_USB
	bool "Configure ZynqMP USB"

config ZYNQMP_NO_DDR
	bool "Disable DDR MMU mapping"
	help
	  This option configures MMU with no DDR to avoid speculative
	  access to DDR memory where DDR is not present.

config SYS_MALLOC_F_LEN
	default 0x600

config DEFINE_TCM_OCM_MMAP
	bool "Define TCM and OCM memory in MMU Table"
	default y if MP
	help
	  This option if enabled defines the TCM and OCM memory and its
	  memory attributes in MMU table entry.

config ZYNQMP_PSU_INIT_ENABLED
	bool "Include psu_init"
	help
	  Include psu_init to full u-boot. SPL include psu_init by default.

config SPL_ZYNQMP_ALT_BOOTMODE_ENABLED
	bool "Overwrite SPL bootmode"
	depends on SPL
	help
	  Overwrite bootmode selected via boot mode pins to tell SPL what should
	  be the next boot device.

config ZYNQ_SDHCI_MAX_FREQ
	default 200000000

config SPL_ZYNQMP_TWO_SDHCI
	bool "Enable booting from both SDHCIs"
	depends on SPL
	help
	  This option reflects that board has two SDHCI controllers which
	  platform can use as boot device. This option ensures that SPL will
	  setup BOOT_DEVICE_MMC2 for SDHCI1 controller and BOOT_DEVICE_MMC1 for
	  SDHCI0 controller. Platforms which have only one SDHCI controller
	  shouldn't enable this option because it for software SDHCI0 or SDHCI1
	  are both covered by BOOT_DEVICE_MMC1.

config SPL_ZYNQMP_ALT_BOOTMODE
	hex
	default 0x0 if JTAG_MODE
	default 0x1 if QSPI_MODE_24BIT
	default 0x2 if QSPI_MODE_32BIT
	default 0x3 if SD_MODE
	default 0x4 if NAND_MODE
	default 0x5 if SD_MODE1
	default 0x6 if EMMC_MODE
	default 0x7 if USB_MODE
	default 0xa if SW_USBHOST_MODE
	default 0xb if SW_SATA_MODE
	default 0xe if SD1_LSHFT_MODE

choice
	prompt "Boot mode"
	depends on SPL_ZYNQMP_ALT_BOOTMODE_ENABLED
	default JTAG_MODE

config JTAG_MODE
	bool "JTAG_MODE"

config QSPI_MODE_24BIT
	bool "QSPI_MODE_24BIT"

config QSPI_MODE_32BIT
	bool "QSPI_MODE_32BIT"

config SD_MODE
	bool "SD_MODE"

config SD_MODE1
	bool "SD_MODE1"

config NAND_MODE
	bool "NAND_MODE"

config EMMC_MODE
	bool "EMMC_MODE"

config USB_MODE
	bool "USB"

config SW_USBHOST_MODE
	bool "SW USBHOST_MODE"

config SW_SATA_MODE
	bool "SW SATA_MODE"

config SD1_LSHFT_MODE
	bool "SD1_LSHFT_MODE"

endchoice

endif
```
