## release/src-rt-5.04axhnd.675x/bootloaders/u-boot-2019.07/arch/arm/mach-meson/Kconfig
```kconfig
if ARCH_MESON

config MESON64_COMMON
	bool
	select ARM64
	select CLK
	select DM
	select DM_SERIAL
	select SYSCON
	select REGMAP
	select BOARD_LATE_INIT
	imply CMD_DM

config MESON_GX
	bool
	select MESON64_COMMON

choice
	prompt "Platform select"
	default MESON_GXBB

config MESON_GXBB
	bool "GXBB"
	select MESON_GX
	help
	  Select this if your SoC is an S905

config MESON_GXL
	bool "GXL"
	select MESON_GX
	help
	  Select this if your SoC is an S905X/D or S805X

config MESON_GXM
	bool "GXM"
	select MESON_GX
	help
	  Select this if your SoC is an S912

config MESON_AXG
	bool "AXG"
	select MESON64_COMMON
	help
	  Select this if your SoC is an A113X/D

config MESON_G12A
	bool "G12A"
	select MESON64_COMMON
	help
	  Select this if your SoC is an S905X/D2

endchoice

config SYS_SOC
	default "meson"

config SYS_MALLOC_F_LEN
	default 0x1000

config SYS_VENDOR
	string "Vendor name"
	default "amlogic"
	help
	  This option contains information about board name.
	  Based on this option board/<CONFIG_SYS_VENDOR>/<CONFIG_SYS_BOARD> will
	  be used.

config SYS_BOARD
	string "Board name"
	default "p200" if MESON_GXBB
	default "p212" if MESON_GXL
	default "q200" if MESON_GXM
	default "s400" if MESON_AXG
	default "u200" if MESON_G12A
	default ""
	help
	  This option contains information about board name.
	  Based on this option board/<CONFIG_SYS_VENDOR>/<CONFIG_SYS_BOARD> will
	  be used.

config SYS_CONFIG_NAME
	string "Board configuration name"
	default "meson64"
	help
	  This option contains information about board configuration name.
	  Based on this option include/configs/<CONFIG_SYS_CONFIG_NAME>.h header
	  will be used for board configuration.

endif
```

## release/src-rt-5.04axhnd.675x/bootloaders/u-boot-2019.07/arch/arm/mach-omap2/am33xx/Kconfig
```kconfig
if TI816X

config TARGET_TI816X_EVM
	bool "Support ti816x_evm"
	help
	  This option specifies support for the TI8168 EVM development platform
	  with PG2.0 silicon and DDR3 DRAM.

endif

if TI814X

config TARGET_TI814X_EVM
	bool "Support ti814x_evm"
	help
	  This option specifies support for the TI8148
	  EVM development platform.

endif

if AM33XX

config AM33XX_CHILISOM
	bool
	select SUPPORT_SPL

choice
	prompt "AM33xx board select"

config TARGET_AM335X_EVM
	bool "Support am335x_evm"
	select BOARD_LATE_INIT
	select DM
	select DM_GPIO
	select DM_SERIAL
	select TI_I2C_BOARD_DETECT
	imply CMD_DM
	imply SPL_DM
	imply SPL_DM_SEQ_ALIAS
	imply SPL_ENV_SUPPORT
	imply SPL_FS_EXT4
	imply SPL_FS_FAT
	imply SPL_GPIO_SUPPORT
	imply SPL_I2C_SUPPORT
	imply SPL_LIBCOMMON_SUPPORT
	imply SPL_LIBDISK_SUPPORT
	imply SPL_LIBGENERIC_SUPPORT
	imply SPL_MMC_SUPPORT
	imply SPL_NAND_SUPPORT
	imply SPL_OF_LIBFDT
	imply SPL_POWER_SUPPORT
	imply SPL_SEPARATE_BSS
	imply SPL_SERIAL_SUPPORT
	imply SPL_SYS_MALLOC_SIMPLE
	imply SPL_WATCHDOG_SUPPORT
	imply SPL_YMODEM_SUPPORT
	help
	  This option specifies support for the AM335x
	  GP and HS EVM development platforms. The AM335x
	  GP EVM is a standalone test, development, and
	  evaluation module system that enables developers
	  to write software and develop hardware around
	  an AM335x processor subsystem.

config TARGET_AM335X_BALTOS
	bool "Support am335x_baltos"
	select BOARD_LATE_INIT
	select DM
	select DM_GPIO
	select DM_SERIAL
	imply CMD_DM

config TARGET_AM335X_IGEP003X
	bool "Support am335x_igep003x"
	select BOARD_LATE_INIT
	select DM
	select DM_GPIO
	select DM_SERIAL
	imply CMD_DM

config TARGET_AM335X_SHC
	bool "Support am335x based shc board from bosch"
	select BOARD_LATE_INIT
	select DM
	select DM_GPIO
	select DM_SERIAL
	imply CMD_DM
	imply CMD_SPL

config TARGET_AM335X_GUARDIAN
	bool "Support am335x based guardian board from bosch"
	select DM
	select DM_SERIAL
	select DM_GPIO
	select DM_USB

config TARGET_AM335X_SL50
	bool "Support am335x_sl50"
	select BOARD_LATE_INIT
	select DM
	select DM_GPIO
	select DM_SERIAL
	imply CMD_DM

config TARGET_BAV335X
	bool "Support bav335x"
	select BOARD_LATE_INIT
	select DM
	select DM_SERIAL
	imply CMD_DM
	help
	  The BAV335x OEM Network Processor integrates all the functions of an
	  embedded network computer in a small, easy to use SODIMM module which
	  incorporates the popular Texas Instruments Sitara 32bit ARM Coretex-A8
	  processor, with fast DDR3 512MB SDRAM, 4GB of embedded MMC and a Gigabit
	  ethernet with simple connection to external connectors.

	  For more information, visit: http://birdland.com/oem

config TARGET_BRXRE1
	bool "Support BRXRE1"
	select BOARD_LATE_INIT

config TARGET_BRPPT1
	bool "Support BRPPT1"
	select BOARD_LATE_INIT

config TARGET_CHILIBOARD
	bool "Grinn chiliBoard"
	select AM33XX_CHILISOM
	select BOARD_LATE_INIT
	select DM
	select DM_SERIAL
	imply CMD_DM

config TARGET_CM_T335
	bool "Support cm_t335"
	select DM
	select DM_GPIO
	select DM_SERIAL
	imply CMD_DM

config TARGET_DRACO
	bool "Support draco"
	select BOARD_LATE_INIT
	select DM
	select DM_GPIO
	select DM_SERIAL
	imply CMD_DM

config TARGET_ETAMIN
	bool "Support etamin"
	select BOARD_LATE_INIT
	select DM
	select DM_GPIO
	select DM_SERIAL
	imply CMD_DM

config TARGET_PCM051
	bool "Support pcm051"
	select DM
	select DM_GPIO
	select DM_SERIAL
	imply CMD_DM

config TARGET_PENGWYN
	bool "Support pengwyn"
	select DM
	select DM_GPIO
	select DM_SERIAL
	imply CMD_DM

config TARGET_PEPPER
	bool "Support pepper"
	select DM
	select DM_GPIO
	select DM_SERIAL
	imply CMD_DM

config TARGET_PXM2
	bool "Support pxm2"
	select BOARD_LATE_INIT
	select DM
	select DM_GPIO
	select DM_SERIAL
	imply CMD_DM

config TARGET_RASTABAN
	bool "Support rastaban"
	select BOARD_LATE_INIT
	select DM
	select DM_GPIO
	select DM_SERIAL
	imply CMD_DM

config TARGET_RUT
	bool "Support rut"
	select BOARD_LATE_INIT
	select DM
	select DM_GPIO
	select DM_SERIAL
	imply CMD_DM

config TARGET_THUBAN
	bool "Support thuban"
	select BOARD_LATE_INIT
	select DM
	select DM_GPIO
	select DM_SERIAL
	imply CMD_DM

config TARGET_PDU001
	bool "Support PDU001"
	select DM
	select DM_SERIAL
	imply SPL_SEPARATE_BSS
	imply CMD_DM
	help
	  Support for PDU001 platform developed by EETS GmbH.
	  The PDU001 is a processor and display unit developed around
	  the Computing-Module m2 from bytes at work AG.

endchoice

endif

if AM43XX

choice
	prompt "AM43xx board select"

config TARGET_AM43XX_EVM
	bool "Support am43xx_evm"
	select BOARD_LATE_INIT
	select TI_I2C_BOARD_DETECT
	imply DM_ETH
	imply DM_I2C
	imply DM_SPI
	imply DM_SPI_FLASH
	imply SPL_ENV_SUPPORT
	imply SPL_FS_EXT4
	imply SPL_FS_FAT
	imply SPL_GPIO_SUPPORT
	imply SPL_I2C_SUPPORT
	imply SPL_LIBCOMMON_SUPPORT
	imply SPL_LIBDISK_SUPPORT
	imply SPL_LIBGENERIC_SUPPORT
	imply SPL_MMC_SUPPORT
	imply SPL_NAND_SUPPORT
	imply SPL_POWER_SUPPORT
	imply SPL_SERIAL_SUPPORT
	imply SPL_WATCHDOG_SUPPORT
	imply SPL_YMODEM_SUPPORT
	help
	  This option specifies support for the AM43xx
	  GP and HS EVM development platforms.The AM437x
	  GP EVM is a standalone test, development, and
	  evaluation module system that enables developers
	  to write software and develop hardware around
	  an AM43xx processor subsystem.

config TARGET_CM_T43
	bool "Support cm_t43"

endchoice

config SPL_RTC_DDR_SUPPORT
	bool
	depends on SPL
	prompt "Enable RTC-DDR ONLY Support"
	help
	  If you want RTC-DDR ONLY Support, say Y. RTC Only with DDR in
	  self-refresh mode is a special power saving mode where in all
	  the other voltages are turned off apart from the RTC domain and DDR.
	  So only RTC is alive and ticking and one can program it to wake
	  up after a predetermined period. Once RTC alarm fires, the PMIC
	  powers up all the voltage domains. U-Boot takes a special path
	  as the DDR has contents is in self-refresh and restore path is
	  followed.

endif

if AM43XX || AM33XX
config PUB_ROM_DATA_SIZE
	hex "Size in bytes of the L3 SRAM reserved by ROM to store data"
	default 0x8400
	help
	  During the device boot, the public ROM uses the top of
	  the public L3 OCMC RAM to store r/w data like stack,
	  heap, globals etc. When the ROM is copying the boot
	  image from the boot media into memory, the image must
	  not spill over into this area. This value can be used
	  during compile time to determine the maximum size of a
	  boot image. Once the ROM transfers control to the boot
	  image, this area is no longer used, and can be reclaimed
	  for run time use by the boot image.
endif
```

## release/src-rt-5.04axhnd.675x/bootloaders/u-boot-2019.07/arch/arm/mach-omap2/omap5/Kconfig
```kconfig
if OMAP54XX

config DRA7XX
	bool
	help
	  DRA7xx is an OMAP based SOC with Dual Core A-15s.

choice
	prompt "OMAP5 board select"
	optional

config TARGET_CM_T54
	bool "CompuLab CM-T54"

config TARGET_OMAP5_UEVM
	bool "TI OMAP5 uEVM board"

config TARGET_DRA7XX_EVM
	bool "TI DRA7XX"
	select BOARD_LATE_INIT
	select DRA7XX
	select PHYS_64BIT
	select TI_I2C_BOARD_DETECT
	imply DM_PMIC
	imply DM_REGULATOR
	imply DM_REGULATOR_LP87565
	imply DM_THERMAL
	imply PMIC_LP87565
	imply SCSI
	imply SPL_THERMAL
	imply TI_DRA7_THERMAL

config TARGET_AM57XX_EVM
	bool "AM57XX"
	select BOARD_LATE_INIT
	select CMD_DDR3
	select DRA7XX
	select TI_I2C_BOARD_DETECT
	imply DM_THERMAL
	imply SCSI
	imply SPL_THERMAL
	imply TI_DRA7_THERMAL

endchoice

config SYS_SOC
	default "omap5"

config OMAP_PLATFORM_RESET_TIME_MAX_USEC
	int "Something"
	range 0  31219
	default 31219
	help
	  Most OMAPs' provide a way to specify the time for which the reset
	  should be held low while the voltages and Oscillator outputs
	  stabilize.
	  This time is mostly board and PMIC dependent. Hence the boards are
	  expected to specify a pre-computed time using the above option.
	  This value can be computed using a summation of the below 3
	  parameters
	  1: Time taken by the Osciallator to stop and restart
	  2: PMIC OTP time
	  3: Voltage ramp time, which can be derived using the PMIC slew rate
	     and value of voltage ramp needed.

if TARGET_DRA7XX_EVM || TARGET_AM57XX_EVM
menu "Voltage Domain OPP selections"

choice
	prompt "MPU Voltage Domain"
	default DRA7_MPU_OPP_NOM
        help
	  Select the Operating Performance Point(OPP) for the MPU voltage
	  domain on DRA7xx & AM57xx SoCs.

config DRA7_MPU_OPP_NOM
	bool "OPP NOM"
	help
	  This config option enables Normal OPP for MPU. This is the safest
	  option for booting.

endchoice

choice
	prompt "DSPEVE Voltage Domain"
        help
	  Select the Operating Performance Point(OPP) for the DSPEVE voltage
	  domain on DRA7xx & AM57xx SoCs.

config DRA7_DSPEVE_OPP_NOM
	bool "OPP NOM"
	help
	  This config option enables Normal OPP for DSPEVE. This is the safest
	  option for booting and choose this when unsure about other OPPs .

config DRA7_DSPEVE_OPP_OD
	bool "OPP OD"
	help
	  This config option enables Over drive OPP for DSPEVE.

config DRA7_DSPEVE_OPP_HIGH
	bool "OPP HIGH"
	help
	  This config option enables High OPP for DSPEVE.

endchoice

choice
	prompt "IVA Voltage Domain"
        help
	  Select the Operating Performance Point(OPP) for the IVA voltage
	  domain on DRA7xx & AM57xx SoCs.

config DRA7_IVA_OPP_NOM
	bool "OPP NOM"
	help
	  This config option enables Normal OPP for IVA. This is the safest
	  option for booting and choose this when unsure about other OPPs .

config DRA7_IVA_OPP_OD
	bool "OPP OD"
	help
	  This config option enables Over drive OPP for IVA.

config DRA7_IVA_OPP_HIGH
	bool "OPP HIGH"
	help
	  This config option enables High OPP for IVA.

endchoice

choice
	prompt "GPU Voltage Domain"
        help
	  Select the Operating Performance Point(OPP) for the GPU voltage
	  domain on DRA7xx & AM57xx SoCs.

config DRA7_GPU_OPP_NOM
	bool "OPP NOM"
	help
	  This config option enables Normal OPP for GPU. This is the safest
	  option for booting and choose this when unsure about other OPPs .

config DRA7_GPU_OPP_OD
	bool "OPP OD"
	help
	  This config option enables Over drive OPP for GPU.

config DRA7_GPU_OPP_HIGH
	bool "OPP HIGH"
	help
	  This config option enables High OPP for GPU.

endchoice

endmenu
endif

source "board/compulab/cm_t54/Kconfig"
source "board/ti/omap5_uevm/Kconfig"
source "board/ti/dra7xx/Kconfig"
source "board/ti/am57xx/Kconfig"

endif
```

## release/src-rt-5.04axhnd.675x/bootloaders/u-boot-2019.07/arch/arm/mach-qemu/Kconfig
```kconfig
if ARCH_QEMU

config SYS_VENDOR
	default "emulation"

config SYS_BOARD
	default "qemu-arm"

config SYS_CONFIG_NAME
	default "qemu-arm"

endif

config TARGET_QEMU_ARM_32BIT
	bool "Support qemu_arm"
	depends on ARCH_QEMU
	select ARCH_SUPPORT_PSCI
	select CPU_V7A
	select SYS_ARCH_TIMER

config TARGET_QEMU_ARM_64BIT
	bool "Support qemu_arm64"
	depends on ARCH_QEMU
	select ARM64
```

## release/src-rt-5.04axhnd.675x/bootloaders/u-boot-2019.07/arch/arm/mach-rmobile/Kconfig.64
```kconfig
if RCAR_GEN3

menu "Select Target SoC"

config R8A7795
	bool "Renesas SoC R8A7795"
	imply CLK_R8A7795
	imply PINCTRL_PFC_R8A7795

config R8A7796
	bool "Renesas SoC R8A7796"
	imply CLK_R8A7796
	imply PINCTRL_PFC_R8A7796

config R8A77965
	bool "Renesas SoC R8A77965"
	imply CLK_R8A77965
	imply PINCTRL_PFC_R8A77965

config R8A77970
	bool "Renesas SoC R8A77970"
	imply CLK_R8A77970
	imply PINCTRL_PFC_R8A77970

config R8A77990
	bool "Renesas SoC R8A77990"
	imply CLK_R8A77990
	imply PINCTRL_PFC_R8A77990

config R8A77995
	bool "Renesas SoC R8A77995"
	imply CLK_R8A77995
	imply PINCTRL_PFC_R8A77995

endmenu

choice
	prompt "Renesas ARM64 SoCs board select"
	optional

config TARGET_DRAAK
	bool "Draak board"
	imply R8A77995
	help
          Support for Renesas R-Car Gen3 Draak platform

config TARGET_EAGLE
	bool "Eagle board"
	imply R8A77970
	help
          Support for Renesas R-Car Gen3 Eagle platform

config TARGET_EBISU
	bool "Ebisu board"
	imply R8A77990
	help
          Support for Renesas R-Car Gen3 Ebisu platform

config TARGET_SALVATOR_X
	bool "Salvator-X board"
	imply R8A7795
	imply R8A7796
	imply R8A77965
	imply SYS_MALLOC_F
	imply MULTI_DTB_FIT
	imply MULTI_DTB_FIT_USER_DEFINED_AREA
	help
          Support for Renesas R-Car Gen3 platform

config TARGET_ULCB
	bool "ULCB board"
	imply R8A7795
	imply R8A7796
	imply R8A77965
	imply SYS_MALLOC_F
	imply MULTI_DTB_FIT
	imply MULTI_DTB_FIT_USER_DEFINED_AREA
	help
          Support for Renesas R-Car Gen3 ULCB platform

endchoice

config SYS_SOC
	default "rmobile"

source "board/renesas/draak/Kconfig"
source "board/renesas/eagle/Kconfig"
source "board/renesas/ebisu/Kconfig"
source "board/renesas/salvator-x/Kconfig"
source "board/renesas/ulcb/Kconfig"

config MULTI_DTB_FIT_UNCOMPRESS_SZ
	default 0x80000 if TARGET_SALVATOR_X
	default 0x80000 if TARGET_ULCB

config MULTI_DTB_FIT_USER_DEF_ADDR
	default 0x49000000 if TARGET_SALVATOR_X
	default 0x49000000 if TARGET_ULCB

config SYS_MALLOC_F_LEN
	default 0x8000 if RCAR_GEN3

endif
```

## release/src-rt-5.04axhnd.675x/bootloaders/u-boot-2019.07/arch/arm/mach-rmobile/Kconfig.rza1
```kconfig
if RZA1

# required by the Ethernet driver
config R7S72100
	bool
	default y

# required by serial and usb driver
config CPU_RZA1
	bool
	default y

choice
	prompt "Renesas RZ/A1 board select"

# Renesas Supported Boards
config TARGET_GRPEACH
	bool "GR-PEACH board"

endchoice

config SYS_SOC
	default "rmobile"

# Renesas Supported Boards
source "board/renesas/grpeach/Kconfig"

endif
```
