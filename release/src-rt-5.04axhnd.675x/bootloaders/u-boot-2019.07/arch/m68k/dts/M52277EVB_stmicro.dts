// SPDX-License-Identifier: GPL-2.0+
/*
 * Copyright (C) 2018 Angelo Dureghello <angelo@sysam.it>
 */

/dts-v1/;
/include/ "mcf5227x.dtsi"

/ {
	model = "Freescale M52277_stmicro";
	compatible = "fsl,M52277_stmicro";

	chosen {
		stdout-path = "serial0:115200n8";
	};
};

&uart0 {
	u-boot,dm-pre-reloc;
	status = "okay";
};

