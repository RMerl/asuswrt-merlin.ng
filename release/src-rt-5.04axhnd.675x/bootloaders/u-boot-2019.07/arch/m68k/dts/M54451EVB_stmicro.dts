// SPDX-License-Identifier: GPL-2.0+
/*
 * Copyright (C) 2018 Angelo Dureghello <angelo@sysam.it>
 */

/dts-v1/;
/include/ "mcf5445x.dtsi"

/ {
	model = "Freescale M54451EVB_stmicro";
	compatible = "fsl,M54451EVB";

	chosen {
		stdout-path = "serial0:115200n8";
	};
};

&uart0 {
	u-boot,dm-pre-reloc;
	status = "okay";
};

&dspi0 {
	status = "okay";
};
