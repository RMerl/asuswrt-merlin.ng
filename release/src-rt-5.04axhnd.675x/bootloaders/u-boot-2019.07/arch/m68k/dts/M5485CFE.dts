// SPDX-License-Identifier: GPL-2.0+
/*
 * Copyright (C) 2018 Angelo Dureghello <angelo@sysam.it>
 */

/dts-v1/;
/include/ "mcf54xx.dtsi"

/ {
	model = "Freescale M5485CFE";
	compatible = "fsl,M5485CFE";

	chosen {
		stdout-path = "serial0:115200n8";
	};
};

