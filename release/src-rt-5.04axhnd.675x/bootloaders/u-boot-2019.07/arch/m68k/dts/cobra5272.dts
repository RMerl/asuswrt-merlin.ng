// SPDX-License-Identifier: GPL-2.0+
/*
 * Copyright (C) 2018 Angelo Dureghello <angelo@sysam.it>
 */

/dts-v1/;
/include/ "mcf5272.dtsi"

/ {
	model = "Cobra 5272";
	compatible = "cobra,M5272";

	chosen {
		stdout-path = "serial0:115200n8";
	};
};

&uart0 {
	u-boot,dm-pre-reloc;
	status = "okay";
};

