## release/src-rt-5.04axhnd.675x/bootloaders/u-boot-2019.07/arch/mips/mach-mscc/Kconfig
```kconfig
# SPDX-License-Identifier: (GPL-2.0+ OR MIT)

menu "MSCC VCore-III platforms"
	depends on ARCH_MSCC

config SOC_VCOREIII
	select MIPS_TUNE_24KC
	select ROM_EXCEPTION_VECTORS
	select SUPPORTS_BIG_ENDIAN
	select SUPPORTS_CPU_MIPS32_R1
	select SUPPORTS_CPU_MIPS32_R2
	select SUPPORTS_LITTLE_ENDIAN
	bool

config SYS_SOC
	default "mscc"

choice

	prompt "SOC Family Variant"

config SOC_OCELOT
	bool "Ocelot SOC Family"
	select SOC_VCOREIII
	select DESIGNWARE_SPI
	help
	  This supports MSCC Ocelot family of SOCs.

config SOC_LUTON
	bool "Luton SOC Family"
	select SOC_VCOREIII
	help
	  This supports MSCC Luton family of SOCs.

config SOC_JR2
	bool "Jaguar2 SOC Family"
	select SOC_VCOREIII
	select DESIGNWARE_SPI
	help
	  This supports MSCC Jaguar2 family of SOCs.

config SOC_SERVALT
	bool "Servalt SOC Family"
	select SOC_VCOREIII
	select MSCC_BB_SPI
	help
	  This supports MSCC Servalt family of SOCs.

config SOC_SERVAL
	bool "Serval SOC Family"
	select SOC_VCOREIII
	select MSCC_BB_SPI
	help
	  This supports MSCC Serval family of SOCs.

endchoice

config SYS_CONFIG_NAME
	default "vcoreiii"

choice
	prompt "DDR type"

config DDRTYPE_H5TQ4G63MFR
	bool "Hynix H5TQ4G63MFR-PBC (4Gbit, DDR3-800, 256Mbitx16)"

config DDRTYPE_MT41K256M16
	bool "Micron MT41K256M16 (4Gbit, DDR3L-800, 256Mbitx16)"

config DDRTYPE_H5TQ1G63BFA
	bool "Hynix H5TQ1G63BFA (1Gbit DDR3, x16)"

config DDRTYPE_MT41J128M16HA
	bool "Micron MT41J128M16HA-15E:D (2Gbit DDR3, x16)"

config DDRTYPE_MT41K128M16JT
	bool "Micron MT41K128M16JT-125 (2Gbit DDR3L, 128Mbitx16)"

config DDRTYPE_MT47H128M8HQ
	bool "Micron MT47H128M8-3 (1Gbit, DDR-533@CL4 @ 4.80ns 16Mbisx8x8)"

endchoice

source "board/mscc/ocelot/Kconfig"

source "board/mscc/luton/Kconfig"

source "board/mscc/jr2/Kconfig"

source "board/mscc/servalt/Kconfig"

source "board/mscc/serval/Kconfig"
endmenu
```

## release/src-rt-5.04axhnd.675x/bootloaders/u-boot-2019.07/arch/mips/mach-mtmips/Kconfig
```kconfig
menu "MediaTek MIPS platforms"
	depends on ARCH_MTMIPS

config SYS_MALLOC_F_LEN
	default 0x1000

config SYS_SOC
	default "mt7628" if SOC_MT7628

choice
	prompt "MediaTek MIPS SoC select"

config SOC_MT7628
	bool "MT7628"
	select MIPS_L1_CACHE_SHIFT_5
	help
	  This supports MediaTek MT7628/MT7688.

endchoice

choice
	prompt "Board select"

config BOARD_GARDENA_SMART_GATEWAY_MT7688
	bool "GARDENA smart Gateway"
	depends on SOC_MT7628
	select BOARD_LATE_INIT
	select SUPPORTS_BOOT_RAM
	help
	  GARDENA smart Gateway boards have a MT7688 SoC with 128 MiB of RAM
	  and 8 MiB of flash (SPI NOR) and additional SPI NAND storage.

config BOARD_LINKIT_SMART_7688
	bool "LinkIt Smart 7688"
	depends on SOC_MT7628
	select SUPPORTS_BOOT_RAM
	help
	  Seeed LinkIt Smart 7688 boards have a MT7688 SoC with 128 MiB of RAM
	  and 32 MiB of flash (SPI).
	  Between its different peripherals there's an integrated switch with 4
	  ethernet ports, 1 USB port, 1 UART, GPIO buttons and LEDs, and
	  a MT7688 (PCIe).

endchoice

choice
	prompt "Boot mode"

config BOOT_RAM
	bool "RAM boot"
	depends on SUPPORTS_BOOT_RAM
	help
	  This builds an image that is linked to a RAM address. It can be used
	  for booting from CFE via TFTP using an ELF image, but it can also be
	  booted from RAM by other bootloaders using a BIN image.

config BOOT_ROM
	bool "ROM boot"
	depends on SUPPORTS_BOOT_RAM
	help
	  This builds an image that is linked to a ROM address. It can be
	  used as main bootloader image which is programmed onto the onboard
	  flash storage (SPI NOR).

endchoice

choice
	prompt "DDR2 size"

config ONBOARD_DDR2_SIZE_256MBIT
	bool "256MBit (32MByte) total size"
	depends on BOOT_ROM
	help
	  Use 256MBit (32MByte) of DDR total size

config ONBOARD_DDR2_SIZE_512MBIT
	bool "512MBit (64MByte) total size"
	depends on BOOT_ROM
	help
	  Use 512MBit (64MByte) of DDR total size

config ONBOARD_DDR2_SIZE_1024MBIT
	bool "1024MBit (128MByte) total size"
	depends on BOOT_ROM
	help
	  Use 1024MBit (128MByte) of DDR total size

config ONBOARD_DDR2_SIZE_2048MBIT
	bool "2048MBit (256MByte) total size"
	depends on BOOT_ROM
	help
	  Use 2048MBit (256MByte) of DDR total size

endchoice

choice
	prompt "DDR2 chip width"

config ONBOARD_DDR2_CHIP_WIDTH_8BIT
	bool "8bit DDR chip width"
	depends on BOOT_ROM
	help
	  Use DDR chips with 8bit width

config ONBOARD_DDR2_CHIP_WIDTH_16BIT
	bool "16bit DDR chip width"
	depends on BOOT_ROM
	help
	  Use DDR chips with 16bit width

endchoice

choice
	prompt "DDR2 bus width"

config ONBOARD_DDR2_BUS_WIDTH_16BIT
	bool "16bit DDR bus width"
	depends on BOOT_ROM
	help
	  Use 16bit DDR bus width

config ONBOARD_DDR2_BUS_WIDTH_32BIT
	bool "32bit DDR bus width"
	depends on BOOT_ROM
	help
	  Use 32bit DDR bus width

endchoice

config SUPPORTS_BOOT_RAM
	bool

source "board/gardena/smart-gateway-mt7688/Kconfig"
source "board/seeed/linkit-smart-7688/Kconfig"

endmenu
```

## release/src-rt-5.04axhnd.675x/bootloaders/u-boot-2019.07/arch/powerpc/Kconfig
```kconfig
menu "PowerPC architecture"
	depends on PPC

config SYS_ARCH
	default "powerpc"

choice
	prompt "CPU select"
	optional

config MPC83xx
	bool "MPC83xx"
	select CREATE_ARCH_SYMLINK
	select SYS_FSL_HAS_SEC
	select SYS_FSL_SEC_BE
	select SYS_FSL_SEC_COMPAT_2

config MPC85xx
	bool "MPC85xx"
	select CREATE_ARCH_SYMLINK
	select SYS_FSL_DDR
	select SYS_FSL_DDR_BE
	select BINMAN
	imply CMD_HASH
	imply CMD_IRQ
	imply USB_EHCI_HCD if USB

config MPC86xx
	bool "MPC86xx"
	select SYS_FSL_DDR
	select SYS_FSL_DDR_BE
	imply CMD_REGINFO

config MPC8xx
	bool "MPC8xx"
	select BOARD_EARLY_INIT_F
	imply CMD_REGINFO
	imply WDT_MPC8xx

endchoice

config HIGH_BATS
	bool "Enable high BAT registers"
	help
	  Enable BATs (block address translation registers) 4-7 on machines
	  that support them.

source "arch/powerpc/cpu/mpc83xx/Kconfig"
source "arch/powerpc/cpu/mpc85xx/Kconfig"
source "arch/powerpc/cpu/mpc86xx/Kconfig"
source "arch/powerpc/cpu/mpc8xx/Kconfig"

endmenu
```

## release/src-rt-5.04axhnd.675x/bootloaders/u-boot-2019.07/arch/powerpc/cpu/mpc83xx/elbc/Kconfig
```kconfig
menu "ELBC register setup"

choice
	prompt "OR/BR for NAND SPL"

config ELBC_BR_OR_NAND_PRELIM_NONE
	bool "None"

config ELBC_BR_OR_NAND_PRELIM_0
	bool "0"

config ELBC_BR_OR_NAND_PRELIM_1
	bool "1"

config ELBC_BR_OR_NAND_PRELIM_2
	bool "2"

config ELBC_BR_OR_NAND_PRELIM_3
	bool "3"

config ELBC_BR_OR_NAND_PRELIM_4
	bool "4"

endchoice

source "arch/powerpc/cpu/mpc83xx/elbc/Kconfig.elbc0"
source "arch/powerpc/cpu/mpc83xx/elbc/Kconfig.elbc1"
source "arch/powerpc/cpu/mpc83xx/elbc/Kconfig.elbc2"
source "arch/powerpc/cpu/mpc83xx/elbc/Kconfig.elbc3"
source "arch/powerpc/cpu/mpc83xx/elbc/Kconfig.elbc4"

endmenu
```
