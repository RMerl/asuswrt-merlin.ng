## release/src-rt-5.04axhnd.675x/bootloaders/u-boot-2019.07/arch/x86/cpu/baytrail/Kconfig
```kconfig
# SPDX-License-Identifier: GPL-2.0+
#
# Copyright (C) 2015 Google, Inc

config INTEL_BAYTRAIL
	bool
	select HAVE_FSP
	select ARCH_MISC_INIT
	select CPU_INTEL_TURBO_NOT_PACKAGE_SCOPED
	imply HAVE_INTEL_ME
	imply ENABLE_MRC_CACHE
	imply AHCI_PCI
	imply ICH_SPI
	imply INTEL_ICH6_GPIO
	imply PINCTRL_ICH6
	imply MMC
	imply MMC_PCI
	imply MMC_SDHCI
	imply MMC_SDHCI_SDMA
	imply SCSI
	imply SCSI_AHCI
	imply SPI_FLASH
	imply SYS_NS16550
	imply USB
	imply USB_EHCI_HCD
	imply USB_XHCI_HCD
	imply VIDEO_VESA

if INTEL_BAYTRAIL
config INTERNAL_UART
	bool "Enable the SoC integrated legacy UART"
	help
	  There is a legacy UART integrated into the Bay Trail SoC.
	  A maximum baud rate of 115200 bps is supported. For this
	  reason, it is recommended that the UART port be used for
	  debug purposes only, eg: U-Boot console.

config DEBUG_UART
	bool
	select DEBUG_UART_BOARD_INIT

endif
```

## release/src-rt-5.04axhnd.675x/bootloaders/u-boot-2019.07/arch/x86/cpu/broadwell/Kconfig
```kconfig
# SPDX-License-Identifier: GPL-2.0
#
# Copyright (C) 2016 Google Inc.
#

config INTEL_BROADWELL
	bool
	select CACHE_MRC_BIN
	select ARCH_EARLY_INIT_R
	imply HAVE_INTEL_ME
	imply ENABLE_MRC_CACHE
	imply AHCI_PCI
	imply ICH_SPI
	imply INTEL_BROADWELL_GPIO
	imply SCSI
	imply SCSI_AHCI
	imply SPI_FLASH
	imply USB
	imply USB_EHCI_HCD
	imply VIDEO_BROADWELL_IGD

if INTEL_BROADWELL

config DCACHE_RAM_BASE
	default 0xff7c0000

config DCACHE_RAM_SIZE
	default 0x40000

config DCACHE_RAM_MRC_VAR_SIZE
	default 0x30000

config CPU_SPECIFIC_OPTIONS
	def_bool y
	select SMM_TSEG
	select X86_RAMTEST

config SMM_TSEG_SIZE
	hex
	default 0x800000

endif
```

## release/src-rt-5.04axhnd.675x/bootloaders/u-boot-2019.07/arch/x86/cpu/qemu/Kconfig
```kconfig
# SPDX-License-Identifier: GPL-2.0+
#
# Copyright (C) 2015, Bin Meng <bmeng.cn@gmail.com>

config QEMU
	bool
	select ARCH_EARLY_INIT_R
	imply AHCI_PCI
	imply E1000
	imply SCSI
	imply SCSI_AHCI
	imply SYS_NS16550
	imply USB
	imply USB_EHCI_HCD
	imply VIDEO_VESA

if QEMU

config SYS_CAR_ADDR
	hex
	default 0x10000

config SYS_CAR_SIZE
	hex
	default 0x10000

config ACPI_PM1_BASE
	hex
	default 0xe400
	help
	  ACPI Power Management 1 (PM1) i/o-mapped base address.
	  This device is defined in ACPI specification, with 16 bytes in size.

endif
```

## release/src-rt-5.04axhnd.675x/bootloaders/u-boot-2019.07/arch/x86/cpu/quark/Kconfig
```kconfig
# SPDX-License-Identifier: GPL-2.0+
#
# Copyright (C) 2015, Bin Meng <bmeng.cn@gmail.com>

config INTEL_QUARK
	bool
	select HAVE_RMU
	select ARCH_EARLY_INIT_R
	select ARCH_MISC_INIT
	imply ENABLE_MRC_CACHE
	imply ETH_DESIGNWARE
	imply ICH_SPI
	imply INTEL_ICH6_GPIO
	imply MMC
	imply MMC_PCI
	imply MMC_SDHCI
	imply MMC_SDHCI_SDMA
	imply SPI_FLASH
	imply SYS_NS16550
	imply USB
	imply USB_EHCI_HCD

if INTEL_QUARK

config HAVE_RMU
	bool "Add a Remote Management Unit (RMU) binary"
	help
	  Select this option to add a Remote Management Unit (RMU) binary
	  to the resulting U-Boot image. It is a data block (up to 64K) of
	  machine-specific code which must be put in the flash for the RMU
	  within the Quark SoC processor to access when powered up before
	  system BIOS is executed.

config RMU_FILE
	string "Remote Management Unit (RMU) binary filename"
	depends on HAVE_RMU
	default "rmu.bin"
	help
	  The filename of the file to use as Remote Management Unit (RMU)
	  binary in the board directory.

config RMU_ADDR
	hex "Remote Management Unit (RMU) binary location"
	depends on HAVE_RMU
	default 0xfff00000
	help
	  The location of the RMU binary is determined by a strap. It must be
	  put in flash at a location matching the strap-determined base address.

	  The default base address of 0xfff00000 indicates that the binary must
	  be located at offset 0 from the beginning of a 1MB flash device.

config HAVE_CMC
	bool
	default HAVE_RMU

config CMC_FILE
	string
	depends on HAVE_CMC
	default RMU_FILE

config CMC_ADDR
	hex
	depends on HAVE_CMC
	default RMU_ADDR

config ESRAM_BASE
	hex
	default 0x80000000
	help
	  Embedded SRAM (eSRAM) memory-mapped base address.

config PCIE_ECAM_BASE
	hex
	default 0xe0000000

config RCBA_BASE
	hex
	default 0xfed1c000
	help
	  Root Complex register block memory-mapped base address.

config ACPI_PM1_BASE
	hex
	default 0x1000
	help
	  ACPI Power Management 1 (PM1) i/o-mapped base address.
	  This device is defined in ACPI specification, with 16 bytes in size.

config ACPI_PBLK_BASE
	hex
	default 0x1010
	help
	  ACPI Processor Block (PBLK) i/o-mapped base address.
	  This device is defined in ACPI specification, with 16 bytes in size.

config SPI_DMA_BASE
	hex
	default 0x1020
	help
	  SPI DMA i/o-mapped base address.

config GPIO_BASE
	hex
	default 0x1080
	help
	  GPIO i/o-mapped base address.

config ACPI_GPE0_BASE
	hex
	default 0x1100
	help
	  ACPI General Purpose Event 0 (GPE0) i/o-mapped base address.
	  This device is defined in ACPI specification, with 64 bytes in size.

config WDT_BASE
	hex
	default 0x1140
	help
	  Watchdog timer i/o-mapped base address.

config SYS_CAR_ADDR
	hex
	default ESRAM_BASE

config SYS_CAR_SIZE
	hex
	default 0x8000
	help
	  Space in bytes in eSRAM used as Cache-As-ARM (CAR).
	  Note this size must not exceed eSRAM's total size.

config X86_TSC_TIMER_EARLY_FREQ
	int
	default 400

endif
```

## release/src-rt-5.04axhnd.675x/bootloaders/u-boot-2019.07/arch/x86/cpu/tangier/Kconfig
```kconfig
# SPDX-License-Identifier: GPL-2.0+
#
# Copyright (c) 2017 Intel Corporation

config INTEL_TANGIER
	bool
	depends on INTEL_MID
	imply INTEL_MID_SERIAL
	imply MMC
	imply MMC_SDHCI
	imply MMC_SDHCI_SDMA
	imply MMC_SDHCI_TANGIER
	imply USB
	imply USB_DWC3

if INTEL_TANGIER

config SYS_CAR_ADDR
	hex
	default 0x19200000

config SYS_CAR_SIZE
	hex
	default 0x4000
	help
	  Space in bytes in eSRAM used as Cache-As-RAM (CAR).
	  Note this size must not exceed eSRAM's total size.

config SYS_USB_OTG_BASE
	hex
	default 0xf9100000

endif
```

## release/src-rt-5.04axhnd.675x/bootloaders/u-boot-2019.07/board/AndesTech/adp-ae3xx/Kconfig
```kconfig
if TARGET_ADP_AE3XX

config SYS_CPU
	default "n1213"

config SYS_BOARD
	default "adp-ae3xx"

config SYS_VENDOR
	default "AndesTech"

config SYS_SOC
	default "ae3xx"

config SYS_CONFIG_NAME
	default "adp-ae3xx"

endif
```

## release/src-rt-5.04axhnd.675x/bootloaders/u-boot-2019.07/board/AndesTech/adp-ag101p/Kconfig
```kconfig
if TARGET_ADP_AG101P

config SYS_CPU
	default "n1213"

config SYS_BOARD
	default "adp-ag101p"

config SYS_VENDOR
	default "AndesTech"

config SYS_SOC
	default "ag101"

config SYS_CONFIG_NAME
	default "adp-ag101p"

endif
```

## release/src-rt-5.04axhnd.675x/bootloaders/u-boot-2019.07/board/AndesTech/ax25-ae350/Kconfig
```kconfig
if TARGET_AX25_AE350

config SYS_CPU
	default "ax25"

config SYS_BOARD
	default "ax25-ae350"

config SYS_VENDOR
	default "AndesTech"

config SYS_SOC
	default "ae350"

config SYS_CONFIG_NAME
	default "ax25-ae350"

config ENV_SIZE
	default 0x2000 if ENV_IS_IN_SPI_FLASH

config ENV_OFFSET
	default 0x140000 if ENV_IS_IN_SPI_FLASH

config BOARD_SPECIFIC_OPTIONS # dummy
	def_bool y
	select RISCV_NDS
	imply SMP

endif
```

## release/src-rt-5.04axhnd.675x/bootloaders/u-boot-2019.07/board/BuS/eb_cpu5282/Kconfig
```kconfig
if TARGET_EB_CPU5282

config SYS_CPU
	default "mcf52x2"

config SYS_BOARD
	default "eb_cpu5282"

config SYS_VENDOR
	default "BuS"

config SYS_CONFIG_NAME
	default "eb_cpu5282"

endif
```

## release/src-rt-5.04axhnd.675x/bootloaders/u-boot-2019.07/board/CarMediaLab/flea3/Kconfig
```kconfig
if TARGET_FLEA3

config SYS_BOARD
	default "flea3"

config SYS_VENDOR
	default "CarMediaLab"

config SYS_SOC
	default "mx35"

config SYS_CONFIG_NAME
	default "flea3"

endif
```

## release/src-rt-5.04axhnd.675x/bootloaders/u-boot-2019.07/board/LaCie/net2big_v2/Kconfig
```kconfig
if TARGET_NET2BIG_V2

config SYS_BOARD
	default "net2big_v2"

config SYS_VENDOR
	default "LaCie"

config SYS_CONFIG_NAME
	default "lacie_kw"

endif
```
