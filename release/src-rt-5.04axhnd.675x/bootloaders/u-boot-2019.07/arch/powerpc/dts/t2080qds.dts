// SPDX-License-Identifier: GPL-2.0+ OR X11
/*
 * T2080QDS Device Tree Source
 *
 * Copyright 2013 - 2015 Freescale Semiconductor Inc.
 * Copyright 2018 NXP
 */

/include/ "t2080.dtsi"

/ {
	model = "fsl,T2080QDS";
	compatible = "fsl,T2080QDS";
	#address-cells = <2>;
	#size-cells = <2>;
	interrupt-parent = <&mpic>;
};
