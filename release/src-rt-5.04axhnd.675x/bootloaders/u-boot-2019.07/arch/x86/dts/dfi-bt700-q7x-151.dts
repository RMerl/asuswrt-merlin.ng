// SPDX-License-Identifier: GPL-2.0+
/*
 * Copyright (C) 2014, Bin Meng <bmeng.cn@gmail.com>
 * Copyright (C) 2016 Stefan Roese <sr@denx.de>
 */

/dts-v1/;

#include "dfi-bt700.dtsi"

#include "serial.dtsi"

/ {
	model = "DFI-BT700";
	compatible = "dfi,bt700", "intel,baytrail";

	aliases {
		serial0 = &serial;
		spi0 = &spi;
	};
};
