## release/src-rt-5.04axhnd.675x/bootloaders/u-boot-2019.07/board/Marvell/sheevaplug/Kconfig
```kconfig
if TARGET_SHEEVAPLUG

config SYS_BOARD
	default "sheevaplug"

config SYS_VENDOR
	default "Marvell"

config SYS_CONFIG_NAME
	default "sheevaplug"

endif
```

## release/src-rt-5.04axhnd.675x/bootloaders/u-boot-2019.07/board/Seagate/dockstar/Kconfig
```kconfig
if TARGET_DOCKSTAR

config SYS_BOARD
	default "dockstar"

config SYS_VENDOR
	default "Seagate"

config SYS_CONFIG_NAME
	default "dockstar"

endif
```

## release/src-rt-5.04axhnd.675x/bootloaders/u-boot-2019.07/board/advantech/dms-ba16/Kconfig
```kconfig
if TARGET_ADVANTECH_DMS_BA16

choice
	prompt "DDR Size"
	default SYS_DDR_2G

config SYS_DDR_1G
	bool "1GiB"

config SYS_DDR_2G
	bool "2GiB"

endchoice

config IMX_CONFIG
	default "board/advantech/dms-ba16/dms-ba16_2g.cfg" if SYS_DDR_2G
	default "board/advantech/dms-ba16/dms-ba16_1g.cfg" if SYS_DDR_1G

config SYS_BOARD
	default "dms-ba16"

config SYS_VENDOR
	default "advantech"

config SYS_SOC
	default "mx6"

config SYS_CONFIG_NAME
	default "advantech_dms-ba16"

endif
```

## release/src-rt-5.04axhnd.675x/bootloaders/u-boot-2019.07/board/altera/arria10-socdk/Kconfig
```kconfig
if TARGET_SOCFPGA_ARRIA10_SOCDK

config SYS_CPU
	default "armv7"

config SYS_BOARD
	default "socfpga_arria10"

config SYS_VENDOR
	default "altera"

config SYS_SOC
	default "socfpga_arria10"

config SYS_CONFIG_NAME
	default "socfpga_arria10"

endif
```

## release/src-rt-5.04axhnd.675x/bootloaders/u-boot-2019.07/board/astro/mcf5373l/Kconfig
```kconfig
if TARGET_ASTRO_MCF5373L

config SYS_CPU
	default "mcf532x"

config SYS_BOARD
	default "mcf5373l"

config SYS_VENDOR
	default "astro"

config SYS_CONFIG_NAME
	default "astro_mcf5373l"

endif
```

## release/src-rt-5.04axhnd.675x/bootloaders/u-boot-2019.07/board/atmel/at91rm9200ek/Kconfig
```kconfig
if TARGET_AT91RM9200EK

config SYS_BOARD
	default "at91rm9200ek"

config SYS_VENDOR
	default "atmel"

config SYS_CONFIG_NAME
	default "at91rm9200ek"

endif
```

## release/src-rt-5.04axhnd.675x/bootloaders/u-boot-2019.07/board/atmel/at91sam9260ek/Kconfig
```kconfig
if TARGET_AT91SAM9260EK

config SYS_BOARD
	default "at91sam9260ek"

config SYS_VENDOR
	default "atmel"

config SYS_CONFIG_NAME
	default "at91sam9260ek"

endif
```

## release/src-rt-5.04axhnd.675x/bootloaders/u-boot-2019.07/board/atmel/at91sam9261ek/Kconfig
```kconfig
if TARGET_AT91SAM9261EK

config SYS_BOARD
	default "at91sam9261ek"

config SYS_VENDOR
	default "atmel"

config SYS_CONFIG_NAME
	default "at91sam9261ek"

endif
```

## release/src-rt-5.04axhnd.675x/bootloaders/u-boot-2019.07/board/atmel/at91sam9263ek/Kconfig
```kconfig
if TARGET_AT91SAM9263EK

config SYS_BOARD
	default "at91sam9263ek"

config SYS_VENDOR
	default "atmel"

config SYS_CONFIG_NAME
	default "at91sam9263ek"

endif
```

## release/src-rt-5.04axhnd.675x/bootloaders/u-boot-2019.07/board/atmel/sama5d2_xplained/Kconfig
```kconfig
if TARGET_SAMA5D2_XPLAINED

config SYS_BOARD
	default "sama5d2_xplained"

config SYS_VENDOR
	default "atmel"

config SYS_SOC
	default "at91"

config SYS_CONFIG_NAME
	default "sama5d2_xplained"

endif
```

## release/src-rt-5.04axhnd.675x/bootloaders/u-boot-2019.07/board/atmel/sama5d3_xplained/Kconfig
```kconfig
if TARGET_SAMA5D3_XPLAINED

config SYS_BOARD
	default "sama5d3_xplained"

config SYS_VENDOR
	default "atmel"

config SYS_CONFIG_NAME
	default "sama5d3_xplained"

endif
```

## release/src-rt-5.04axhnd.675x/bootloaders/u-boot-2019.07/board/atmel/sama5d4_xplained/Kconfig
```kconfig
if TARGET_SAMA5D4_XPLAINED

config SYS_BOARD
	default "sama5d4_xplained"

config SYS_VENDOR
	default "atmel"

config SYS_CONFIG_NAME
	default "sama5d4_xplained"

endif
```

## release/src-rt-5.04axhnd.675x/bootloaders/u-boot-2019.07/board/atmel/sama5d4ek/Kconfig
```kconfig
if TARGET_SAMA5D4EK

config SYS_BOARD
	default "sama5d4ek"

config SYS_VENDOR
	default "atmel"

config SYS_CONFIG_NAME
	default "sama5d4ek"

endif
```

## release/src-rt-5.04axhnd.675x/bootloaders/u-boot-2019.07/board/avionic-design/plutux/Kconfig
```kconfig
if TARGET_PLUTUX

config SYS_BOARD
	default "plutux"

config SYS_VENDOR
	default "avionic-design"

config SYS_CONFIG_NAME
	default "plutux"

endif
```

## release/src-rt-5.04axhnd.675x/bootloaders/u-boot-2019.07/board/avionic-design/tec-ng/Kconfig
```kconfig
if TARGET_TEC_NG

config SYS_BOARD
	default "tec-ng"

config SYS_VENDOR
	default "avionic-design"

config SYS_CONFIG_NAME
	default "tec-ng"

endif
```

## release/src-rt-5.04axhnd.675x/bootloaders/u-boot-2019.07/board/bachmann/ot1200/Kconfig
```kconfig
if TARGET_OT1200

config SYS_BOARD
	default "ot1200"

config SYS_VENDOR
	default "bachmann"

config SYS_CONFIG_NAME
	default "ot1200"

endif
```

## release/src-rt-5.04axhnd.675x/bootloaders/u-boot-2019.07/board/barco/platinum/Kconfig
```kconfig
if TARGET_PLATINUM_PICON

config SYS_CPU
	default "armv7"

config SYS_VENDOR
	default "barco"

config SYS_BOARD
	default "platinum"

config SYS_CONFIG_NAME
	default "platinum_picon"

endif

if TARGET_PLATINUM_TITANIUM

config SYS_CPU
	default "armv7"

config SYS_VENDOR
	default "barco"

config SYS_BOARD
	default "platinum"

config SYS_CONFIG_NAME
	default "platinum_titanium"

endif
```

## release/src-rt-5.04axhnd.675x/bootloaders/u-boot-2019.07/board/barco/titanium/Kconfig
```kconfig
if TARGET_TITANIUM

config SYS_BOARD
	default "titanium"

config SYS_VENDOR
	default "barco"

config SYS_CONFIG_NAME
	default "titanium"

endif
```

## release/src-rt-5.04axhnd.675x/bootloaders/u-boot-2019.07/board/bluegiga/apx4devkit/Kconfig
```kconfig
if TARGET_APX4DEVKIT

config SYS_BOARD
	default "apx4devkit"

config SYS_VENDOR
	default "bluegiga"

config SYS_SOC
	default "mxs"

config SYS_CONFIG_NAME
	default "apx4devkit"

endif
```

## release/src-rt-5.04axhnd.675x/bootloaders/u-boot-2019.07/board/bluewater/gurnard/Kconfig
```kconfig
if TARGET_GURNARD

config SYS_BOARD
	default "gurnard"

config SYS_VENDOR
	default "bluewater"

config SYS_CONFIG_NAME
	default "snapper9g45"

endif
```

## release/src-rt-5.04axhnd.675x/bootloaders/u-boot-2019.07/board/bosch/guardian/Kconfig
```kconfig
if TARGET_AM335X_GUARDIAN

config SYS_BOARD
	default "guardian"

config SYS_VENDOR
	default "bosch"

config SYS_SOC
	default "am33xx"

config SYS_CONFIG_NAME
	default "am335x_guardian"

endif
```

## release/src-rt-5.04axhnd.675x/bootloaders/u-boot-2019.07/board/bosch/shc/Kconfig
```kconfig
if TARGET_AM335X_SHC

config SYS_BOARD
	default "shc"

config SYS_VENDOR
	default "bosch"

config SYS_SOC
	default "am33xx"

config SYS_CONFIG_NAME
	default "am335x_shc"

choice
	prompt "enable different boot versions for the shc board"
	default SHC_EMMC
	help
	  Select the boot version of the shc board.

config SHC_EMMC
	bool "enable eMMC"
	help
	  enable here the eMMC functionality on the bosch shc board.

config SHC_ICT
	bool "enable ICT"
	help
	  enable here the ICT functionality on the bosch shc board

config SHC_NETBOOT
	bool "enable NETBOOT"
	help
	  enable here the NETBOOT functionality on the bosch shc board

config SHC_SDBOOT
	bool "enable SDBOOT"
	help
	  enable here the SDBOOT functionality on the bosch shc board

endchoice

choice
	prompt "enable different board versions for the shc board"
	default C3_SAMPLE
	help
	  Select the board version of the shc board.

config B_SAMPLE
	bool "B Sample board version"
	help
	  activate, if you want to build for the B sample version
	  of the bosch shc board

config B2_SAMPLE
	bool "B2 Sample board version"
	help
	  activate, if you want to build for the B2 sample version
	  of the bosch shc board

config C_SAMPLE
	bool "C Sample board version"
	help
	  activate, if you want to build for the C sample version
	  of the bosch shc board

config C2_SAMPLE
	bool "C2 Sample board version"
	help
	  activate, if you want to build for the C2 sample version
	  of the bosch shc board

config C3_SAMPLE
	bool "C3 Sample board version"
	help
	  activate, if you want to build for the C3 sample version
	  of the bosch shc board

config SERIES
	bool "Series board version"
	help
	  activate, if you want to build for the Series version
	  of the bosch shc board

endchoice

endif
```

## release/src-rt-5.04axhnd.675x/bootloaders/u-boot-2019.07/board/broadcom/bcm28155_ap/Kconfig
```kconfig
if TARGET_BCM28155_AP

config SYS_BOARD
	default "bcm28155_ap"

config SYS_VENDOR
	default "broadcom"

config SYS_SOC
	default "bcm281xx"

config SYS_CONFIG_NAME
	default "bcm28155_ap"

endif
```

## release/src-rt-5.04axhnd.675x/bootloaders/u-boot-2019.07/board/broadcom/bcm963158/Kconfig
```kconfig
if TARGET_BCM963158

config SYS_VENDOR
	default "broadcom"

config SYS_BOARD
	default "bcm963158"

config SYS_CONFIG_NAME
	default "broadcom_bcm963158"

endif

config TARGET_BCM963158
	bool "Support Broadcom bcm963158"
	depends on ARCH_BCM63158
	select ARM64
```

## release/src-rt-5.04axhnd.675x/bootloaders/u-boot-2019.07/board/broadcom/bcmbca/Kconfig
```kconfig
# SPDX-License-Identifier: GPL-2.0+
#
# (C) Copyright 2019 Broadcom Ltd
#

config SYS_VENDOR
	default "broadcom"

config SYS_BOARD
	default "bcmbca"

if TARGET_BCM963158
config SYS_CONFIG_NAME
	default "bcm963158"
endif

if TARGET_BCM96858
config SYS_CONFIG_NAME
	default "bcm96858"
endif

if TARGET_BCM96856
config SYS_CONFIG_NAME
	default "bcm96856"
endif

if TARGET_BCM963178
config SYS_CONFIG_NAME
	default "bcm963178"
endif

if TARGET_BCM947622
config SYS_CONFIG_NAME
	default "bcm947622"
endif

if TARGET_BCM96756
config SYS_CONFIG_NAME
	default "bcm96756"
endif

if TARGET_BCM96846
config SYS_CONFIG_NAME
    default "bcm96846"
endif

if TARGET_BCM96878
config SYS_CONFIG_NAME
    default "bcm96878"
endif

if TARGET_BCM96855
config SYS_CONFIG_NAME
    default "bcm96855"
endif

if TARGET_BCM94908
config SYS_CONFIG_NAME
	default "bcm94908"
endif

if TARGET_BCM94912
config SYS_CONFIG_NAME
	default "bcm94912"
endif

if TARGET_BCM96813
config SYS_CONFIG_NAME
	default "bcm96813"
endif

if TARGET_BCM963146
config SYS_CONFIG_NAME
	default "bcm963146"
endif

if TARGET_BCM963138
config SYS_CONFIG_NAME
	default "bcm963138"
endif

if TARGET_BCM963148
config SYS_CONFIG_NAME
	default "bcm963148"
endif

config BCMBCA_HTTPD
	bool "Support HTTPD server"
	depends on NET

config BCMBCA_IKOS
	bool "IKOS"
	depends on !CONFIG_SYS_ARCH_TIMER
	help
	  Enable IKOS build 

config BCMBCA_BOARD_SPECIFIC_DT
	bool "Load board specific device tree for uboot"

config BCMBCA_UPDATE_MCB_IN_ENV
	bool "Auto update MCB selector in environment"
	depends on BCMBCA_BOARD_SPECIFIC_DT
	default y

config BCMBCA_BOARD_SDK
	bool "Support board sdk"
	default y

config BCMBCA_DECRYPT_TPL
	bool "Directs SPL to unconditionally decrypt TPL in Bootrom FLD/MFG Secure mode using AES symmetric key. Caution: TPL will not be capable to run in unsecrue mode"

config BCMBCA_EARLY_ABORT_JTAG_UNLOCK
	bool "Unlocks JTAG in early abort. Hazardous: Use in debug/development mode only"
	help
          JTAG unlock is a debug feature helping to unbrick board if booted to BOOTROM secure mode
		
#Hopefully temporary home for this driver
#since we need this in tpl, we can't have it under misc 
config BCM_BOOTSTATE
	bool "Enable support for Broadcom Bootstate Driver"
	help
	  If you say Y here, you will get support broadcom bootstate
	  mechanism

config BCMBCA_EXTRA_BOARD_OBJECTS
	string "Space Seperated List of Extra board/broadcom/bcmbca  objects to build"
	help
	  To add additional files to the uboot proper in the board/broadcom/bcmbca directory
	  add the names of the .o files in a space-separated list

config BCMBCA_BOARD_TK_PROG
	bool "Build Turnkey Programming SPL Version"
	default n

config BCMBCA_BUTTON
	bool "button support for broadcom board"
	depends on DM
	default y
```
