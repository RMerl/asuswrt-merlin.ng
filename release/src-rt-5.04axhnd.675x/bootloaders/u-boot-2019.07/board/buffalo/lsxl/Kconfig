## release/src-rt-5.04axhnd.675x/bootloaders/u-boot-2019.07/board/buffalo/lsxl/Kconfig
```kconfig
if TARGET_LSXL

config SYS_BOARD
	default "lsxl"

config SYS_VENDOR
	default "buffalo"

config SYS_CONFIG_NAME
	default "lsxl"

endif
```

## release/src-rt-5.04axhnd.675x/bootloaders/u-boot-2019.07/board/cavium/thunderx/Kconfig
```kconfig
if TARGET_THUNDERX_88XX

config SYS_CPU
	string
	default "armv8"

config SYS_BOARD
	string
	default "thunderx"

config SYS_VENDOR
	string
	default "cavium"

config SYS_CONFIG_NAME
	string
	default "thunderx_88xx"

config CMD_ATF
	bool "Enable ATF query commands"
	default y
	help
	  Enable vendor specific ATF query commands such as SPI and SD/MMC
	  devices access, low level environment query, boot device layout
	  and node count.

endif
```

## release/src-rt-5.04axhnd.675x/bootloaders/u-boot-2019.07/board/cei/cei-tk1-som/Kconfig
```kconfig
if TARGET_CEI_TK1_SOM

config SYS_BOARD
	default "cei-tk1-som"

config SYS_VENDOR
	default "cei"

config SYS_CONFIG_NAME
	default "cei-tk1-som"

endif
```

## release/src-rt-5.04axhnd.675x/bootloaders/u-boot-2019.07/board/cloudengines/pogo_e02/Kconfig
```kconfig
if TARGET_POGO_E02

config SYS_BOARD
	default "pogo_e02"

config SYS_VENDOR
	default "cloudengines"

config SYS_CONFIG_NAME
	default "pogo_e02"

endif
```

## release/src-rt-5.04axhnd.675x/bootloaders/u-boot-2019.07/board/compulab/cm_fx6/Kconfig
```kconfig
if TARGET_CM_FX6

config SYS_BOARD
	default "cm_fx6"

config SYS_VENDOR
	default "compulab"

config SYS_CONFIG_NAME
	default "cm_fx6"

endif
```

## release/src-rt-5.04axhnd.675x/bootloaders/u-boot-2019.07/board/compulab/cm_t335/Kconfig
```kconfig
if TARGET_CM_T335

config SYS_BOARD
	default "cm_t335"

config SYS_VENDOR
	default "compulab"

config SYS_SOC
	default "am33xx"

config SYS_CONFIG_NAME
	default "cm_t335"

endif
```

## release/src-rt-5.04axhnd.675x/bootloaders/u-boot-2019.07/board/compulab/trimslice/Kconfig
```kconfig
if TARGET_TRIMSLICE

config SYS_BOARD
	default "trimslice"

config SYS_VENDOR
	default "compulab"

config SYS_CONFIG_NAME
	default "trimslice"

endif
```

## release/src-rt-5.04axhnd.675x/bootloaders/u-boot-2019.07/board/comtrend/ar5387un/Kconfig
```kconfig
if BOARD_COMTREND_AR5387UN

config SYS_BOARD
	default "ar5387un"

config SYS_VENDOR
	default "comtrend"

config SYS_CONFIG_NAME
	default "comtrend_ar5387un"

endif
```

## release/src-rt-5.04axhnd.675x/bootloaders/u-boot-2019.07/board/comtrend/wap5813n/Kconfig
```kconfig
if BOARD_COMTREND_WAP5813N

config SYS_BOARD
	default "wap5813n"

config SYS_VENDOR
	default "comtrend"

config SYS_CONFIG_NAME
	default "comtrend_wap5813n"

endif
```

## release/src-rt-5.04axhnd.675x/bootloaders/u-boot-2019.07/board/congatec/cgtqmx6eval/Kconfig
```kconfig
if TARGET_CGTQMX6EVAL

config SYS_BOARD
	default "cgtqmx6eval"

config SYS_VENDOR
	default "congatec"

config SYS_CONFIG_NAME
	default "cgtqmx6eval"

endif
```

## release/src-rt-5.04axhnd.675x/bootloaders/u-boot-2019.07/board/coreboot/Kconfig
```kconfig
# SPDX-License-Identifier: GPL-2.0+
#
# Copyright (C) 2015, Bin Meng <bmeng.cn@gmail.com>

if VENDOR_COREBOOT

choice
	prompt "Mainboard model"
	optional

config TARGET_COREBOOT
	bool "coreboot"
	help
	  This target is used for running U-Boot on top of coreboot. In
	  this case coreboot does the early inititalisation, and U-Boot
	  takes over once the RAM, video and CPU are fully running.
	  U-Boot is loaded as a fallback payload from coreboot, in
	  coreboot terminology. This method was used for the Chromebook
	  Pixel when launched.

endchoice

source "board/coreboot/coreboot/Kconfig"

endif
```

## release/src-rt-5.04axhnd.675x/bootloaders/u-boot-2019.07/board/efi/Kconfig
```kconfig
if VENDOR_EFI

choice
	prompt "Mainboard model"
	optional

config TARGET_EFI_APP
	bool "efi application"
	help
	  This target is used for running U-Boot on top of EFI. In
	  this case EFI does the early initialisation, and U-Boot
	  takes over once the RAM, video and CPU are fully running.
	  U-Boot is loaded as an application from EFI.

config TARGET_EFI_PAYLOAD
	bool "efi payload"
	help
	  This target is used for running U-Boot on top of EFI. In
	  this case EFI does the early initialisation, and U-Boot
	  takes over once the RAM, video and CPU are fully running.
	  U-Boot is loaded as a payload from EFI.

endchoice

source "board/efi/efi-x86_app/Kconfig"
source "board/efi/efi-x86_payload/Kconfig"

endif
```

## release/src-rt-5.04axhnd.675x/bootloaders/u-boot-2019.07/board/efi/efi-x86_app/Kconfig
```kconfig
if TARGET_EFI_APP

config SYS_BOARD
	default "efi-x86_app"

config SYS_VENDOR
	default "efi"

config SYS_SOC
	default "efi"

config SYS_CONFIG_NAME
	default "efi-x86_app"

endif
```

## release/src-rt-5.04axhnd.675x/bootloaders/u-boot-2019.07/board/el/el6x/Kconfig
```kconfig
if TARGET_ZC5202

config SYS_BOARD
	default "el6x"

config SYS_VENDOR
	default "el"

config SYS_CONFIG_NAME
	default "zc5202"

endif

if TARGET_ZC5601

config SYS_BOARD
	default "el6x"

config SYS_VENDOR
	default "el"

config SYS_CONFIG_NAME
	default "zc5601"

endif
```

## release/src-rt-5.04axhnd.675x/bootloaders/u-boot-2019.07/board/embest/mx6boards/Kconfig
```kconfig
if TARGET_EMBESTMX6BOARDS

config SYS_BOARD
	default "mx6boards"

config SYS_VENDOR
	default "embest"

config SYS_CONFIG_NAME
	default "embestmx6boards"

endif
```

## release/src-rt-5.04axhnd.675x/bootloaders/u-boot-2019.07/board/emulation/Kconfig
```kconfig
# SPDX-License-Identifier: GPL-2.0+
#
# Copyright (C) 2015, Bin Meng <bmeng.cn@gmail.com>

if VENDOR_EMULATION

choice
	prompt "Mainboard model"

config TARGET_QEMU_X86
	bool "QEMU x86"
	help
	  This is the QEMU emulated x86 board. U-Boot supports running
	  as a coreboot payload as well as bare boot without coreboot.
	  There are two types of x86 boards supported by QEMU which are
	  supported by U-Boot. They are via QEMU '-M pc', an i440FX/PIIX
	  chipset platform and '-M q35', a Q35/ICH9 chipset platform.

config TARGET_QEMU_X86_64
	bool "QEMU x86 64-bit"
	help
	  This is the QEMU emulated x86 64-bit board. With this config
	  U-Boot is built as a 64-bit binary. This allows testing while
	  this feature is being completed.

endchoice

source "board/emulation/qemu-x86/Kconfig"

endif
```

## release/src-rt-5.04axhnd.675x/bootloaders/u-boot-2019.07/board/emulation/qemu-riscv/Kconfig
```kconfig
if TARGET_QEMU_VIRT

config SYS_BOARD
	default "qemu-riscv"

config SYS_VENDOR
	default "emulation"

config SYS_CPU
	default "generic"

config SYS_CONFIG_NAME
	default "qemu-riscv"

config SYS_TEXT_BASE
	default 0x80000000 if !RISCV_SMODE
	default 0x80200000 if RISCV_SMODE && ARCH_RV64I
	default 0x80400000 if RISCV_SMODE && ARCH_RV32I

config BOARD_SPECIFIC_OPTIONS # dummy
	def_bool y
	select GENERIC_RISCV
	imply SYS_NS16550
	imply VIRTIO_MMIO
	imply VIRTIO_NET
	imply VIRTIO_BLK
	imply CMD_PING
	imply CMD_FS_GENERIC
	imply DOS_PARTITION
	imply EFI_PARTITION
	imply ISO_PARTITION
	imply CMD_EXT2
	imply CMD_EXT4
	imply CMD_FAT
	imply BOARD_LATE_INIT
	imply OF_BOARD_SETUP
	imply SIFIVE_SERIAL
	imply SMP
	imply PCI
	imply DM_PCI
	imply PCIE_ECAM_GENERIC
	imply CMD_PCI
	imply E1000
	imply NVME

endif
```

## release/src-rt-5.04axhnd.675x/bootloaders/u-boot-2019.07/board/esd/meesc/Kconfig
```kconfig
if TARGET_MEESC

config SYS_BOARD
	default "meesc"

config SYS_VENDOR
	default "esd"

config SYS_CONFIG_NAME
	default "meesc"

endif
```

## release/src-rt-5.04axhnd.675x/bootloaders/u-boot-2019.07/board/freescale/bsc9131rdb/Kconfig
```kconfig
if TARGET_BSC9131RDB

config SYS_BOARD
	default "bsc9131rdb"

config SYS_VENDOR
	default "freescale"

config SYS_CONFIG_NAME
	default "BSC9131RDB"

endif
```

## release/src-rt-5.04axhnd.675x/bootloaders/u-boot-2019.07/board/freescale/common/Kconfig
```kconfig
config CHAIN_OF_TRUST
	depends on !FIT_SIGNATURE && SECURE_BOOT
	imply CMD_BLOB
	imply CMD_HASH if ARM
	select FSL_CAAM
	select SPL_BOARD_INIT if (ARM && SPL)
	select SHA_HW_ACCEL
	select SHA_PROG_HW_ACCEL
	select ENV_IS_NOWHERE
	select CMD_EXT4 if ARM
	select CMD_EXT4_WRITE if ARM
	bool
	default y

config CMD_ESBC_VALIDATE
	bool "Enable the 'esbc_validate' and 'esbc_halt' commands"
	default y if CHAIN_OF_TRUST
	help
	  This option enables two commands used for secure booting:

	    esbc_validate - validate signature using RSA verification
	    esbc_halt - put the core in spin loop (Secure Boot Only)

config VOL_MONITOR_LTC3882_READ
	depends on VID
	bool "Enable the LTC3882 voltage monitor read"
	default n
	help
	 This option enables LTC3882 voltage monitor read
	 functionality. It is used by common VID driver.

config VOL_MONITOR_LTC3882_SET
	depends on VID
	bool "Enable the LTC3882 voltage monitor set"
	default n
	help
	 This option enables LTC3882 voltage monitor set
	 functionality. It is used by common VID driver.
```

## release/src-rt-5.04axhnd.675x/bootloaders/u-boot-2019.07/board/freescale/corenet_ds/Kconfig
```kconfig
if TARGET_P3041DS

config SYS_BOARD
	default "corenet_ds"

config SYS_VENDOR
	default "freescale"

config SYS_CONFIG_NAME
	default "P3041DS"

source "board/freescale/common/Kconfig"

endif

if TARGET_P4080DS

config SYS_BOARD
	default "corenet_ds"

config SYS_VENDOR
	default "freescale"

config SYS_CONFIG_NAME
	default "P4080DS"

source "board/freescale/common/Kconfig"

endif

if TARGET_P5020DS

config SYS_BOARD
	default "corenet_ds"

config SYS_VENDOR
	default "freescale"

config SYS_CONFIG_NAME
	default "P5020DS"

source "board/freescale/common/Kconfig"

endif

if TARGET_P5040DS

config SYS_BOARD
	default "corenet_ds"

config SYS_VENDOR
	default "freescale"

config SYS_CONFIG_NAME
	default "P5040DS"

source "board/freescale/common/Kconfig"

endif
```

## release/src-rt-5.04axhnd.675x/bootloaders/u-boot-2019.07/board/freescale/ls1012afrdm/Kconfig
```kconfig
if TARGET_LS1012AFRDM

config SYS_BOARD
	default "ls1012afrdm"

config SYS_VENDOR
	default "freescale"

config SYS_SOC
	default "fsl-layerscape"

config SYS_CONFIG_NAME
	default "ls1012afrdm"

config SYS_LS_PFE_FW_ADDR
	hex "Flash address of PFE firmware"
	default 0x40a00000

config SYS_LS_PPA_FW_ADDR
	hex "PPA Firmware Addr"
	default 0x40400000
endif

if FSL_PFE

config BOARD_SPECIFIC_OPTIONS # dummy
	def_bool y
	select PHYLIB
	imply PHY_REALTEK
	imply PHY_ATHEROS

config DDR_PFE_PHYS_BASEADDR
	hex "PFE DDR physical base address"
	default 0x03800000

config DDR_PFE_BASEADDR
	hex "PFE DDR base address"
	default 0x83800000

config PFE_EMAC1_PHY_ADDR
	hex "PFE DDR base address"
	default 0x2

config PFE_EMAC2_PHY_ADDR
	hex "PFE DDR base address"
	default 0x1

endif

if TARGET_LS1012AFRWY

config SYS_BOARD
	default "ls1012afrdm"

config SYS_VENDOR
	default "freescale"

config SYS_SOC
	default "fsl-layerscape"

config SYS_CONFIG_NAME
	default "ls1012afrwy"

config SYS_LS_PFE_FW_ADDR
	hex "Flash address of PFE firmware"
	default 0x40020000

config SYS_LS_PPA_FW_ADDR
	hex "PPA Firmware Addr"
	default 0x40060000

config SYS_LS_PPA_ESBC_ADDR
	hex "PPA Firmware HDR Addr"
	default 0x401f4000

config SYS_LS_PFE_ESBC_ADDR
	hex "PFE Firmware HDR Addr"
	default 0x401f8000

endif

if TARGET_LS1012AFRDM || TARGET_LS1012AFRWY
source "board/freescale/common/Kconfig"
endif
```

## release/src-rt-5.04axhnd.675x/bootloaders/u-boot-2019.07/board/freescale/ls1012ardb/Kconfig
```kconfig
if TARGET_LS1012ARDB

config SYS_BOARD
	default "ls1012ardb"

config SYS_VENDOR
	default "freescale"

config SYS_SOC
	default "fsl-layerscape"

config SYS_CONFIG_NAME
	default "ls1012ardb"

config SYS_LS_PPA_FW_ADDR
        hex "PPA Firmware Addr"
        default 0x40400000

if CHAIN_OF_TRUST
config SYS_LS_PPA_ESBC_ADDR
	hex "PPA Firmware HDR Addr"
	default 0x40680000
endif

if FSL_PFE

config BOARD_SPECIFIC_OPTIONS # dummy
	def_bool y
	select PHYLIB
	imply PHY_REALTEK

config SYS_LS_PFE_FW_ADDR
	hex "Flash address of PFE firmware"
	default 0x40a00000

config SYS_LS_PFE_ESBC_ADDR
	hex "PFE Firmware HDR Addr"
	default 0x40700000

config DDR_PFE_PHYS_BASEADDR
	hex "PFE DDR physical base address"
	default 0x03800000

config DDR_PFE_BASEADDR
	hex "PFE DDR base address"
	default 0x83800000

config PFE_EMAC1_PHY_ADDR
	hex "PFE DDR base address"
	default 0x2

config PFE_EMAC2_PHY_ADDR
	hex "PFE DDR base address"
	default 0x1

endif

source "board/freescale/common/Kconfig"

endif

if TARGET_LS1012A2G5RDB

config SYS_BOARD
        default "ls1012ardb"

config SYS_VENDOR
        default "freescale"

config SYS_SOC
        default "fsl-layerscape"

config SYS_CONFIG_NAME
        default "ls1012a2g5rdb"

config SYS_LS_PPA_FW_ADDR
        hex "PPA Firmware Addr"
        default 0x40400000

if FSL_PFE

config BOARD_SPECIFIC_OPTIONS # dummy
	def_bool y
	select PHYLIB
	imply CONFIG_PHYLIB_10G
	imply CONFIG_PHY_AQUANTIA

config SYS_LS_PFE_FW_ADDR
	hex "Flash address of PFE firmware"
	default 0x40a00000

config DDR_PFE_PHYS_BASEADDR
	hex "PFE DDR physical base address"
	default 0x03800000

config DDR_PFE_BASEADDR
	hex "PFE DDR base address"
	default 0x83800000

config PFE_EMAC1_PHY_ADDR
	hex "PFE DDR base address"
	default 0x2

config PFE_EMAC2_PHY_ADDR
	hex "PFE DDR base address"
	default 0x1

endif

source "board/freescale/common/Kconfig"

endif
```

## release/src-rt-5.04axhnd.675x/bootloaders/u-boot-2019.07/board/freescale/ls1021aqds/Kconfig
```kconfig
if TARGET_LS1021AQDS

config SYS_BOARD
	default "ls1021aqds"

config SYS_VENDOR
	default "freescale"

config SYS_SOC
	default "ls102xa"

config SYS_CONFIG_NAME
	default "ls1021aqds"

source "board/freescale/common/Kconfig"

endif
```

## release/src-rt-5.04axhnd.675x/bootloaders/u-boot-2019.07/board/freescale/ls1021atwr/Kconfig
```kconfig
if TARGET_LS1021ATWR

config SYS_BOARD
	default "ls1021atwr"

config SYS_VENDOR
	default "freescale"

config SYS_SOC
	default "ls102xa"

config SYS_CONFIG_NAME
	default "ls1021atwr"

source "board/freescale/common/Kconfig"

endif
```
