## release/src-rt-5.04axhnd.675x/bootloaders/u-boot-2019.07/board/freescale/ls1028a/Kconfig
```kconfig
if TARGET_LS1028AQDS

config SYS_BOARD
	default "ls1028a"

config SYS_VENDOR
	default "freescale"

config SYS_SOC
	default "fsl-layerscape"

config SYS_CONFIG_NAME
	default "ls1028aqds"

config EMMC_BOOT
	bool "Support for booting from EMMC"
	default n

config SYS_TEXT_BASE
	default 0x96000000 if SD_BOOT || EMMC_BOOT
	default 0x82000000 if TFABOOT
	default 0x20100000

if FSL_LS_PPA
config SYS_LS_PPA_FW_ADDR
	hex "PPA Firmware Addr"
	default 0x20400000 if SYS_LS_PPA_FW_IN_XIP && ARCH_LS1028A
	default 0x400000 if SYS_LS_PPA_FW_IN_MMC && ARCH_LS1028A
if CHAIN_OF_TRUST
config SYS_LS_PPA_ESBC_ADDR
	hex "PPA header Addr"
	default 0x20600000 if SYS_LS_PPA_FW_IN_XIP && ARCH_LS1028A
endif
endif

source "board/freescale/common/Kconfig"

endif

if TARGET_LS1028ARDB

config SYS_BOARD
	default "ls1028a"

config SYS_VENDOR
	default "freescale"

config SYS_SOC
	default "fsl-layerscape"

config SYS_CONFIG_NAME
	default "ls1028ardb"

config EMMC_BOOT
	bool "Support for booting from EMMC"
	default n

config SYS_TEXT_BASE
	default 0x96000000 if SD_BOOT || EMMC_BOOT
	default 0x82000000 if TFABOOT
	default 0x20100000

source "board/freescale/common/Kconfig"

endif
```

## release/src-rt-5.04axhnd.675x/bootloaders/u-boot-2019.07/board/freescale/ls1046aqds/Kconfig
```kconfig
if TARGET_LS1046AQDS

config SYS_BOARD
	default "ls1046aqds"

config SYS_VENDOR
	default "freescale"

config SYS_SOC
	default "fsl-layerscape"

config SYS_CONFIG_NAME
	default "ls1046aqds"

if FSL_LS_PPA
config SYS_LS_PPA_FW_ADDR
	hex "PPA Firmware Addr"
	default 0x40400000 if SYS_LS_PPA_FW_IN_XIP && QSPI_BOOT
	default 0x60400000 if SYS_LS_PPA_FW_IN_XIP
	default 0x400000 if SYS_LS_PPA_FW_IN_MMC || SYS_LS_PPA_FW_IN_NAND

if CHAIN_OF_TRUST
config SYS_LS_PPA_ESBC_ADDR
	hex "PPA Firmware HDR Addr"
	default 0x40680000 if SYS_LS_PPA_FW_IN_XIP && QSPI_BOOT
	default 0x60680000 if SYS_LS_PPA_FW_IN_XIP
	default 0x680000 if SYS_LS_PPA_FW_IN_MMC || SYS_LS_PPA_FW_IN_NAND
endif
endif

source "board/freescale/common/Kconfig"

endif
```

## release/src-rt-5.04axhnd.675x/bootloaders/u-boot-2019.07/board/freescale/ls2080a/Kconfig
```kconfig
if TARGET_LS2080A_EMU

config SYS_BOARD
	default "ls2080a"

config SYS_VENDOR
	default "freescale"

config SYS_SOC
	default "fsl-layerscape"

config SYS_CONFIG_NAME
	default "ls2080a_emu"

source "board/freescale/common/Kconfig"

endif

if TARGET_LS2080A_SIMU

config SYS_BOARD
	default "ls2080a"

config SYS_VENDOR
	default "freescale"

config SYS_SOC
	default "fsl-layerscape"

config SYS_CONFIG_NAME
	default "ls2080a_simu"

source "board/freescale/common/Kconfig"

endif
```

## release/src-rt-5.04axhnd.675x/bootloaders/u-boot-2019.07/board/freescale/m52277evb/Kconfig
```kconfig
if TARGET_M52277EVB

config SYS_CPU
	default "mcf5227x"

config SYS_BOARD
	default "m52277evb"

config SYS_VENDOR
	default "freescale"

config SYS_CONFIG_NAME
	default "M52277EVB"

endif
```

## release/src-rt-5.04axhnd.675x/bootloaders/u-boot-2019.07/board/freescale/m5249evb/Kconfig
```kconfig
if TARGET_M5249EVB

config SYS_CPU
	default "mcf52x2"

config SYS_BOARD
	default "m5249evb"

config SYS_VENDOR
	default "freescale"

config SYS_CONFIG_NAME
	default "M5249EVB"

endif
```

## release/src-rt-5.04axhnd.675x/bootloaders/u-boot-2019.07/board/freescale/m5272c3/Kconfig
```kconfig
if TARGET_M5272C3

config SYS_CPU
	default "mcf52x2"

config SYS_BOARD
	default "m5272c3"

config SYS_VENDOR
	default "freescale"

config SYS_CONFIG_NAME
	default "M5272C3"

endif
```

## release/src-rt-5.04axhnd.675x/bootloaders/u-boot-2019.07/board/freescale/m5275evb/Kconfig
```kconfig
if TARGET_M5275EVB

config SYS_CPU
	default "mcf52x2"

config SYS_BOARD
	default "m5275evb"

config SYS_VENDOR
	default "freescale"

config SYS_CONFIG_NAME
	default "M5275EVB"

endif
```

## release/src-rt-5.04axhnd.675x/bootloaders/u-boot-2019.07/board/freescale/m5282evb/Kconfig
```kconfig
if TARGET_M5282EVB

config SYS_CPU
	default "mcf52x2"

config SYS_BOARD
	default "m5282evb"

config SYS_VENDOR
	default "freescale"

config SYS_CONFIG_NAME
	default "M5282EVB"

endif
```

## release/src-rt-5.04axhnd.675x/bootloaders/u-boot-2019.07/board/freescale/m53017evb/Kconfig
```kconfig
if TARGET_M53017EVB

config SYS_CPU
	default "mcf532x"

config SYS_BOARD
	default "m53017evb"

config SYS_VENDOR
	default "freescale"

config SYS_CONFIG_NAME
	default "M53017EVB"

endif
```

## release/src-rt-5.04axhnd.675x/bootloaders/u-boot-2019.07/board/freescale/m5329evb/Kconfig
```kconfig
if TARGET_M5329EVB

config SYS_CPU
	default "mcf532x"

config SYS_BOARD
	default "m5329evb"

config SYS_VENDOR
	default "freescale"

config SYS_CONFIG_NAME
	default "M5329EVB"

endif
```

## release/src-rt-5.04axhnd.675x/bootloaders/u-boot-2019.07/board/freescale/m54455evb/Kconfig
```kconfig
if TARGET_M54455EVB

config SYS_CPU
	default "mcf5445x"

config SYS_BOARD
	default "m54455evb"

config SYS_VENDOR
	default "freescale"

config SYS_CONFIG_NAME
	default "M54455EVB"

endif
```

## release/src-rt-5.04axhnd.675x/bootloaders/u-boot-2019.07/board/freescale/m547xevb/Kconfig
```kconfig
if TARGET_M5475EVB

config SYS_CPU
	default "mcf547x_8x"

config SYS_BOARD
	default "m547xevb"

config SYS_VENDOR
	default "freescale"

config SYS_CONFIG_NAME
	default "M5475EVB"

endif
```

## release/src-rt-5.04axhnd.675x/bootloaders/u-boot-2019.07/board/freescale/mpc8308rdb/Kconfig
```kconfig
if TARGET_MPC8308RDB

config SYS_BOARD
	default "mpc8308rdb"

config SYS_VENDOR
	default "freescale"

config SYS_CONFIG_NAME
	default "MPC8308RDB"

endif
```

## release/src-rt-5.04axhnd.675x/bootloaders/u-boot-2019.07/board/freescale/mpc8315erdb/Kconfig
```kconfig
if TARGET_MPC8315ERDB

config SYS_BOARD
	default "mpc8315erdb"

config SYS_VENDOR
	default "freescale"

config SYS_CONFIG_NAME
	default "MPC8315ERDB"

endif
```

## release/src-rt-5.04axhnd.675x/bootloaders/u-boot-2019.07/board/freescale/mpc832xemds/Kconfig
```kconfig
if TARGET_MPC832XEMDS

config SYS_BOARD
	default "mpc832xemds"

config SYS_VENDOR
	default "freescale"

config SYS_CONFIG_NAME
	default "MPC832XEMDS"

endif
```

## release/src-rt-5.04axhnd.675x/bootloaders/u-boot-2019.07/board/freescale/mpc8349emds/Kconfig
```kconfig
if TARGET_MPC8349EMDS

config SYS_BOARD
	default "mpc8349emds"

config SYS_VENDOR
	default "freescale"

config SYS_CONFIG_NAME
	default "MPC8349EMDS"

endif

if TARGET_MPC8349EMDS_SDRAM

config SYS_BOARD
	default "mpc8349emds"

config SYS_VENDOR
	default "freescale"

config SYS_CONFIG_NAME
	default "MPC8349EMDS_SDRAM"

endif
```

## release/src-rt-5.04axhnd.675x/bootloaders/u-boot-2019.07/board/freescale/mpc8536ds/Kconfig
```kconfig
if TARGET_MPC8536DS

config SYS_BOARD
	default "mpc8536ds"

config SYS_VENDOR
	default "freescale"

config SYS_CONFIG_NAME
	default "MPC8536DS"

endif
```

## release/src-rt-5.04axhnd.675x/bootloaders/u-boot-2019.07/board/freescale/mpc8541cds/Kconfig
```kconfig
if TARGET_MPC8541CDS

config SYS_BOARD
	default "mpc8541cds"

config SYS_VENDOR
	default "freescale"

config SYS_CONFIG_NAME
	default "MPC8541CDS"

endif
```

## release/src-rt-5.04axhnd.675x/bootloaders/u-boot-2019.07/board/freescale/mpc8544ds/Kconfig
```kconfig
if TARGET_MPC8544DS

config SYS_BOARD
	default "mpc8544ds"

config SYS_VENDOR
	default "freescale"

config SYS_CONFIG_NAME
	default "MPC8544DS"

endif
```

## release/src-rt-5.04axhnd.675x/bootloaders/u-boot-2019.07/board/freescale/mpc8548cds/Kconfig
```kconfig
if TARGET_MPC8548CDS

config SYS_BOARD
	default "mpc8548cds"

config SYS_VENDOR
	default "freescale"

config SYS_CONFIG_NAME
	default "MPC8548CDS"

endif
```

## release/src-rt-5.04axhnd.675x/bootloaders/u-boot-2019.07/board/freescale/mpc8568mds/Kconfig
```kconfig
if TARGET_MPC8568MDS

config SYS_BOARD
	default "mpc8568mds"

config SYS_VENDOR
	default "freescale"

config SYS_CONFIG_NAME
	default "MPC8568MDS"

endif
```

## release/src-rt-5.04axhnd.675x/bootloaders/u-boot-2019.07/board/freescale/mpc8569mds/Kconfig
```kconfig
if TARGET_MPC8569MDS

config SYS_BOARD
	default "mpc8569mds"

config SYS_VENDOR
	default "freescale"

config SYS_CONFIG_NAME
	default "MPC8569MDS"

endif
```

## release/src-rt-5.04axhnd.675x/bootloaders/u-boot-2019.07/board/freescale/mx28evk/Kconfig
```kconfig
if TARGET_MX28EVK

config SYS_BOARD
	default "mx28evk"

config SYS_VENDOR
	default "freescale"

config SYS_SOC
	default "mxs"

config SYS_CONFIG_NAME
	default "mx28evk"

endif
```

## release/src-rt-5.04axhnd.675x/bootloaders/u-boot-2019.07/board/freescale/mx35pdk/Kconfig
```kconfig
if TARGET_MX35PDK

config SYS_BOARD
	default "mx35pdk"

config SYS_VENDOR
	default "freescale"

config SYS_SOC
	default "mx35"

config SYS_CONFIG_NAME
	default "mx35pdk"

endif
```

## release/src-rt-5.04axhnd.675x/bootloaders/u-boot-2019.07/board/freescale/mx53ard/Kconfig
```kconfig
if TARGET_MX53ARD

config SYS_BOARD
	default "mx53ard"

config SYS_VENDOR
	default "freescale"

config SYS_SOC
	default "mx5"

config SYS_CONFIG_NAME
	default "mx53ard"

endif
```
