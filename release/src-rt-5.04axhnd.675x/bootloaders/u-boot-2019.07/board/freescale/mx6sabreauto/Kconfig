## release/src-rt-5.04axhnd.675x/bootloaders/u-boot-2019.07/board/freescale/mx6sabreauto/Kconfig
```kconfig
if TARGET_MX6SABREAUTO

config SYS_BOARD
	default "mx6sabreauto"

config SYS_VENDOR
	default "freescale"

config SYS_CONFIG_NAME
	default "mx6sabreauto"

endif
```

## release/src-rt-5.04axhnd.675x/bootloaders/u-boot-2019.07/board/freescale/mx6sllevk/Kconfig
```kconfig
if TARGET_MX6SLLEVK

config SYS_BOARD
	default "mx6sllevk"

config SYS_VENDOR
	default "freescale"

config SYS_CONFIG_NAME
	default "mx6sllevk"

endif
```

## release/src-rt-5.04axhnd.675x/bootloaders/u-boot-2019.07/board/freescale/mx6sxsabreauto/Kconfig
```kconfig
if TARGET_MX6SXSABREAUTO

config SYS_BOARD
	default "mx6sxsabreauto"

config SYS_VENDOR
	default "freescale"

config SYS_CONFIG_NAME
	default "mx6sxsabreauto"

endif
```

## release/src-rt-5.04axhnd.675x/bootloaders/u-boot-2019.07/board/freescale/mx7dsabresd/Kconfig
```kconfig
if TARGET_MX7DSABRESD

config SYS_BOARD
	default "mx7dsabresd"

config SYS_VENDOR
	default "freescale"

config SYS_CONFIG_NAME
	default "mx7dsabresd"

endif
```

## release/src-rt-5.04axhnd.675x/bootloaders/u-boot-2019.07/board/freescale/qemu-ppce500/Kconfig
```kconfig
if TARGET_QEMU_PPCE500

config SYS_BOARD
	default "qemu-ppce500"

config SYS_VENDOR
	default "freescale"

config SYS_CONFIG_NAME
	default "qemu-ppce500"

endif
```

## release/src-rt-5.04axhnd.675x/bootloaders/u-boot-2019.07/board/freescale/s32v234evb/Kconfig
```kconfig
if TARGET_S32V234EVB

config SYS_CPU
	string
	default "armv8"

config SYS_BOARD
	string
	default "s32v234evb"

config SYS_VENDOR
	string
	default "freescale"

config SYS_SOC
	string
	default "s32v234"

config SYS_CONFIG_NAME
	string
	default "s32v234evb"

endif
```

## release/src-rt-5.04axhnd.675x/bootloaders/u-boot-2019.07/board/freescale/t102xqds/Kconfig
```kconfig
if TARGET_T1024QDS

config SYS_BOARD
	default "t102xqds"

config SYS_VENDOR
	default "freescale"

config SYS_CONFIG_NAME
	default "T102xQDS"

source "board/freescale/common/Kconfig"

endif
```

## release/src-rt-5.04axhnd.675x/bootloaders/u-boot-2019.07/board/freescale/t102xrdb/Kconfig
```kconfig
if TARGET_T1023RDB || TARGET_T1024RDB

config SYS_BOARD
	default "t102xrdb"

config SYS_VENDOR
	default "freescale"

config SYS_CONFIG_NAME
	default "T102xRDB"

source "board/freescale/common/Kconfig"

endif
```

## release/src-rt-5.04axhnd.675x/bootloaders/u-boot-2019.07/board/freescale/t1040qds/Kconfig
```kconfig
if TARGET_T1040QDS

config SYS_BOARD
	default "t1040qds"

config SYS_VENDOR
	default "freescale"

config SYS_CONFIG_NAME
	default "T1040QDS"

source "board/freescale/common/Kconfig"

endif
```

## release/src-rt-5.04axhnd.675x/bootloaders/u-boot-2019.07/board/freescale/t208xqds/Kconfig
```kconfig
if TARGET_T2080QDS || TARGET_T2081QDS

config SYS_BOARD
	default "t208xqds"

config SYS_VENDOR
	default "freescale"

config SYS_CONFIG_NAME
	default "T208xQDS"

source "board/freescale/common/Kconfig"

endif
```

## release/src-rt-5.04axhnd.675x/bootloaders/u-boot-2019.07/board/freescale/t4qds/Kconfig
```kconfig
if TARGET_T4160QDS || TARGET_T4240QDS

config SYS_BOARD
	default "t4qds"

config SYS_VENDOR
	default "freescale"

config SYS_CONFIG_NAME
	default "T4240QDS"

source "board/freescale/common/Kconfig"

endif
```

## release/src-rt-5.04axhnd.675x/bootloaders/u-boot-2019.07/board/gardena/smart-gateway-mt7688/Kconfig
```kconfig
if BOARD_GARDENA_SMART_GATEWAY_MT7688

config SYS_BOARD
	default "smart-gateway-mt7688"

config SYS_VENDOR
	default "gardena"

config SYS_CONFIG_NAME
	default "gardena-smart-gateway-mt7688"

endif
```

## release/src-rt-5.04axhnd.675x/bootloaders/u-boot-2019.07/board/gateworks/gw_ventana/Kconfig
```kconfig
if TARGET_GW_VENTANA

config SYS_BOARD
	default "gw_ventana"

config SYS_VENDOR
	default "gateworks"

config SYS_CONFIG_NAME
	default "gw_ventana"

config CMD_EECONFIG
	bool "Enable the 'econfig' command"
	help
	  Provides access to EEPROM configuration on Gateworks Ventana

config CMD_GSC
	bool "Enable the 'gsc' command"
	help
	  Provides access to the GSC configuration:

	     gsc sleep - sleeps for a period of seconds
	     gsc wd - enables / disables the watchdog

endif
```

## release/src-rt-5.04axhnd.675x/bootloaders/u-boot-2019.07/board/gdsys/mpc8308/Kconfig
```kconfig
config GDSYS_LEGACY_OSD_CMDS
	bool
	help
	  Use the 'osdw', 'osdp', and 'osdsize' legacy commands required by
	  gdsys devices.

config GDSYS_LEGACY_DRIVERS
	bool
	help
	  Enable the gdsys legacy drivers under board/gdsys/common. If this
	  option is not set, all relevant DM drivers must be configured for the
	  device in question.

config SYS_FPGA0_BASE
	hex
	default E0600000
	help
	  The base address of the first FPGA's register map.

config SYS_FPGA0_SIZE
	hex
	default 1
	help
	  The base address of the first FPGA's register map.

config SYS_FPGA1_BASE
	hex
	help
	  The base address of the second FPGA's register map.

config SYS_FPGA1_SIZE
	hex
	help
	  The base address of the second FPGA's register map.

if TARGET_HRCON

config SYS_BOARD
	default "mpc8308"

config SYS_VENDOR
	default "gdsys"

config SYS_CONFIG_NAME
	default "hrcon"

config GDSYS_LEGACY_OSD_CMDS
	default y

config GDSYS_LEGACY_DRIVERS
	default y

endif

if TARGET_STRIDER

config SYS_BOARD
	default "mpc8308"

config SYS_VENDOR
	default "gdsys"

config SYS_CONFIG_NAME
	default "strider"

config GDSYS_LEGACY_OSD_CMDS
	default y

config GDSYS_LEGACY_DRIVERS
	default y

endif

if TARGET_GAZERBEAM

config SYS_BOARD
	default "mpc8308"

config SYS_VENDOR
	default "gdsys"

config SYS_CONFIG_NAME
	default "gazerbeam"

config SYS_FPGA1_BASE
	default E0700000

config SYS_FPGA1_SIZE
	default 1

config GDSYS_LEGACY_OSD_CMDS
	default y
endif

if TARGET_HRCON || TARGET_STRIDER || TARGET_GAZERBEAM

choice
	prompt "FPGA flavor selection"

config SYS_FPGA_FLAVOR_LEGACY
	bool "Legacy flavor"
	help
	  This enables support for the gdsys pre-Gazerbeam FPGA memory layout.

config SYS_FPGA_FLAVOR_GAZERBEAM
	bool "Gazerbeam flavor"
	help
	  This enables support for the gdsys FPGA memory layout of the
	  Gazerbeam board.

endchoice

config EXTENDED_FEATURES
	bool "FPGA extended features"
	depends on GDSYS_LEGACY_DRIVERS
	help
	  Enable support for the extended features field of the IHS FPGA.

config CMD_IOLOOP
	bool "Enable 'ioloop' and 'ioreflect' commands"
	help
	  These commands provide FPGA tests.

endif
```

## release/src-rt-5.04axhnd.675x/bootloaders/u-boot-2019.07/board/google/chromebook_link/Kconfig
```kconfig
if TARGET_CHROMEBOOK_LINK || TARGET_CHROMEBOOK_LINK64

config SYS_BOARD
	default "chromebook_link"

config SYS_VENDOR
	default "google"

config SYS_SOC
	default "ivybridge"

config SYS_CONFIG_NAME
	default "chromebook_link"

config SYS_TEXT_BASE
	default 0xfff00000 if !SUPPORT_SPL
	default 0x10000000 if SUPPORT_SPL

config BOARD_SPECIFIC_OPTIONS # dummy
	def_bool y
	select X86_RESET_VECTOR
	select NORTHBRIDGE_INTEL_IVYBRIDGE
	select HAVE_INTEL_ME
	select BOARD_ROMSIZE_KB_8192
	select SPI_FLASH_WINBOND

config PCIE_ECAM_BASE
	default 0xf0000000

config EARLY_POST_CROS_EC
	bool "Enable early post to Chrome OS EC"
	default y

config SYS_CAR_ADDR
	hex
	default 0xff7e0000

config SYS_CAR_SIZE
	hex
	default 0x20000

endif
```

## release/src-rt-5.04axhnd.675x/bootloaders/u-boot-2019.07/board/google/chromebook_samus/Kconfig
```kconfig
if TARGET_CHROMEBOOK_SAMUS || TARGET_CHROMEBOOK_SAMUS_TPL

config SYS_BOARD
	default "chromebook_samus"

config SYS_VENDOR
	default "google"

config SYS_SOC
	default "broadwell"

config SYS_CONFIG_NAME
	default "chromebook_samus" if TARGET_CHROMEBOOK_SAMUS
	default "chromebook_samus" if TARGET_CHROMEBOOK_SAMUS_TPL

config SYS_TEXT_BASE
	default 0xffe00000

config BOARD_SPECIFIC_OPTIONS # dummy
	def_bool y
	select X86_RESET_VECTOR
	select INTEL_BROADWELL
	select HAVE_INTEL_ME
	select BOARD_ROMSIZE_KB_8192
	select SPI_FLASH_WINBOND

config PCIE_ECAM_BASE
	default 0xf0000000

config EARLY_POST_CROS_EC
	bool "Enable early post to Chrome OS EC"
	default y

config SYS_CAR_ADDR
	hex
	default 0xff7c0000

config SYS_CAR_SIZE
	hex
	default 0x40000

endif

if TARGET_CHROMEBOOK_SAMUS_TPL

config BOARD_SPECIFIC_OPTIONS_TPL # dummy
	def_bool y
	select SPL
	select TPL

endif
```

## release/src-rt-5.04axhnd.675x/bootloaders/u-boot-2019.07/board/google/chromebox_panther/Kconfig
```kconfig
if TARGET_CHROMEBOX_PANTHER

config SYS_BOARD
	default "chromebox_panther"

config SYS_VENDOR
	default "google"

config SYS_SOC
	default "ivybridge"

config SYS_CONFIG_NAME
	default "chromebox_panther"

config SYS_TEXT_BASE
	default 0xfff00000

# Panther actually uses haswell, not ivybridge, so this is just a placeholder
config BOARD_SPECIFIC_OPTIONS # dummy
	def_bool y
	select X86_RESET_VECTOR
	select NORTHBRIDGE_INTEL_IVYBRIDGE
	select HAVE_INTEL_ME
	select BOARD_ROMSIZE_KB_8192
	select SPI_FLASH_WINBOND

config SYS_CAR_ADDR
	hex
	default 0xff7e0000

config SYS_CAR_SIZE
	hex
	default 0x20000

endif
```

## release/src-rt-5.04axhnd.675x/bootloaders/u-boot-2019.07/board/google/gru/Kconfig
```kconfig
if TARGET_CHROMEBOOK_BOB

config SYS_BOARD
	default "gru"

config SYS_VENDOR
	default "google"

config SYS_CONFIG_NAME
	default "gru"

config BOARD_SPECIFIC_OPTIONS # dummy
	def_bool y

endif
```

## release/src-rt-5.04axhnd.675x/bootloaders/u-boot-2019.07/board/google/veyron/Kconfig
```kconfig
if TARGET_CHROMEBOOK_JERRY

config SYS_BOARD
	default "veyron"

config SYS_VENDOR
	default "google"

config SYS_CONFIG_NAME
	default "veyron"

config BOARD_SPECIFIC_OPTIONS # dummy
	def_bool y

endif

if TARGET_CHROMEBIT_MICKEY

config SYS_BOARD
	default "veyron"

config SYS_VENDOR
	default "google"

config SYS_CONFIG_NAME
	default "veyron"

config BOARD_SPECIFIC_OPTIONS # dummy
	def_bool y

endif

if TARGET_CHROMEBOOK_MINNIE

config SYS_BOARD
	default "veyron"

config SYS_VENDOR
	default "google"

config SYS_CONFIG_NAME
	default "veyron"

config BOARD_SPECIFIC_OPTIONS # dummy
	def_bool y

endif

if TARGET_CHROMEBOOK_SPEEDY

config SYS_BOARD
	default "veyron"

config SYS_VENDOR
	default "google"

config SYS_CONFIG_NAME
	default "veyron"

config BOARD_SPECIFIC_OPTIONS # dummy
	def_bool y

endif
```

## release/src-rt-5.04axhnd.675x/bootloaders/u-boot-2019.07/board/gumstix/duovero/Kconfig
```kconfig
if TARGET_DUOVERO

config SYS_BOARD
	default "duovero"

config SYS_VENDOR
	default "gumstix"

config SYS_CONFIG_NAME
	default "duovero"

endif
```

## release/src-rt-5.04axhnd.675x/bootloaders/u-boot-2019.07/board/gumstix/pepper/Kconfig
```kconfig
if TARGET_PEPPER

config SYS_BOARD
	default "pepper"

config SYS_VENDOR
	default "gumstix"

config SYS_SOC
	default "am33xx"

config SYS_CONFIG_NAME
	default "pepper"

endif
```

## release/src-rt-5.04axhnd.675x/bootloaders/u-boot-2019.07/board/h2200/Kconfig
```kconfig
if TARGET_H2200

config SYS_BOARD
	default "h2200"

config SYS_CONFIG_NAME
	default "h2200"

endif
```

## release/src-rt-5.04axhnd.675x/bootloaders/u-boot-2019.07/board/hisilicon/hikey/Kconfig
```kconfig
if TARGET_HIKEY

config SYS_BOARD
	default "hikey"

config SYS_VENDOR
	default "hisilicon"

config SYS_SOC
	default "hi6220"

config SYS_CONFIG_NAME
	default "hikey"

endif
```

## release/src-rt-5.04axhnd.675x/bootloaders/u-boot-2019.07/board/imgtec/boston/Kconfig
```kconfig
if TARGET_BOSTON

config SYS_BOARD
	default "boston"

config SYS_VENDOR
	default "imgtec"

config SYS_CONFIG_NAME
	default "boston"

config SYS_TEXT_BASE
	default 0x9fc00000 if 32BIT
	default 0xffffffff9fc00000 if 64BIT

endif
```

## release/src-rt-5.04axhnd.675x/bootloaders/u-boot-2019.07/board/imgtec/ci20/Kconfig
```kconfig
if TARGET_JZ4780_CI20

config SYS_BOARD
	default "ci20"

config SYS_VENDOR
	default "imgtec"

config SYS_CONFIG_NAME
	default "ci20"

config SYS_TEXT_BASE
	default 0x80000000

endif
```
