## release/src-rt-5.04axhnd.675x/bootloaders/u-boot-2019.07/board/intel/cougarcanyon2/Kconfig
```kconfig
if TARGET_COUGARCANYON2

config SYS_BOARD
	default "cougarcanyon2"

config SYS_VENDOR
	default "intel"

config SYS_SOC
	default "ivybridge"

config SYS_CONFIG_NAME
	default "cougarcanyon2"

config SYS_TEXT_BASE
	default 0xffe00000

config BOARD_SPECIFIC_OPTIONS # dummy
	def_bool y
	select X86_RESET_VECTOR
	select NORTHBRIDGE_INTEL_IVYBRIDGE
	select HAVE_FSP
	select BOARD_ROMSIZE_KB_2048
	select BOARD_EARLY_INIT_F
	select SPI_FLASH_WINBOND

endif
```

## release/src-rt-5.04axhnd.675x/bootloaders/u-boot-2019.07/board/intel/crownbay/Kconfig
```kconfig
if TARGET_CROWNBAY

config SYS_BOARD
	default "crownbay"

config SYS_VENDOR
	default "intel"

config SYS_SOC
	default "queensbay"

config SYS_CONFIG_NAME
	default "crownbay"

config SYS_TEXT_BASE
	default 0xfff00000

config BOARD_SPECIFIC_OPTIONS # dummy
	def_bool y
	select X86_RESET_VECTOR
	select INTEL_QUEENSBAY
	select BOARD_ROMSIZE_KB_1024
	select BOARD_EARLY_INIT_F
	select SPI_FLASH_SST

endif
```

## release/src-rt-5.04axhnd.675x/bootloaders/u-boot-2019.07/board/intel/galileo/Kconfig
```kconfig
if TARGET_GALILEO

config SYS_BOARD
	default "galileo"

config SYS_VENDOR
	default "intel"

config SYS_SOC
	default "quark"

config SYS_CONFIG_NAME
	default "galileo"

config SYS_TEXT_BASE
	default 0xfff10000

config BOARD_SPECIFIC_OPTIONS # dummy
	def_bool y
	select X86_RESET_VECTOR
	select INTEL_QUARK
	select BOARD_ROMSIZE_KB_1024
	select SPI_FLASH_WINBOND

config SMBIOS_PRODUCT_NAME
	default "GalileoGen2"
	help
	  Override the default product name U-Boot reports in the SMBIOS
	  table, to be compatible with the Intel provided UEFI BIOS, as
	  Linux kernel drivers (drivers/mfd/intel_quark_i2c_gpio.c and
	  drivers/net/ethernet/stmicro/stmmac/stmmac_pci.c) make use of
	  it to do different board level configuration.

	  This can be "Galileo" for GEN1 Galileo board.

endif
```

## release/src-rt-5.04axhnd.675x/bootloaders/u-boot-2019.07/board/isee/igep00x0/Kconfig
```kconfig
if TARGET_OMAP3_IGEP00X0

config SYS_BOARD
	default "igep00x0"

config SYS_VENDOR
	default "isee"

config SYS_CONFIG_NAME
	default "omap3_igep00x0"

source "board/ti/common/Kconfig"

endif
```

## release/src-rt-5.04axhnd.675x/bootloaders/u-boot-2019.07/board/k+p/kp_imx6q_tpc/Kconfig
```kconfig
if TARGET_KP_IMX6Q_TPC

config SYS_BOARD
	default "kp_imx6q_tpc"

config SYS_VENDOR
	default "k+p"

config SYS_CONFIG_NAME
	default "kp_imx6q_tpc"

endif
```

## release/src-rt-5.04axhnd.675x/bootloaders/u-boot-2019.07/board/keymile/km83xx/Kconfig
```kconfig
if TARGET_KMETER1

config SYS_BOARD
	default "km83xx"

config SYS_VENDOR
	default "keymile"

config SYS_CONFIG_NAME
	default "kmeter1"

endif

if TARGET_KMCOGE5NE

config SYS_BOARD
	default "km83xx"

config SYS_VENDOR
	default "keymile"

config SYS_CONFIG_NAME
	default "kmcoge5ne"

endif

if TARGET_KMVECT1

config SYS_BOARD
	default "km83xx"

config SYS_VENDOR
	default "keymile"

config SYS_CONFIG_NAME
	default "kmvect1"

endif

if TARGET_KMTEGR1

config SYS_BOARD
	default "km83xx"

config SYS_VENDOR
	default "keymile"

config SYS_CONFIG_NAME
	default "kmtegr1"

endif

if TARGET_SUVD3

config SYS_BOARD
	default "km83xx"

config SYS_VENDOR
	default "keymile"

config SYS_CONFIG_NAME
	default "suvd3"

endif

if TARGET_TUXX1

config SYS_BOARD
	default "km83xx"

config SYS_VENDOR
	default "keymile"

config SYS_CONFIG_NAME
	default "tuxx1"

endif

if TARGET_KMSUPX5

config SYS_BOARD
	default "km83xx"

config SYS_VENDOR
	default "keymile"

config SYS_CONFIG_NAME
	default "kmsupx5"

endif

if TARGET_TUGE1

config SYS_BOARD
	default "km83xx"

config SYS_VENDOR
	default "keymile"

config SYS_CONFIG_NAME
	default "tuge1"

endif

if TARGET_KMOPTI2

config SYS_BOARD
	default "km83xx"

config SYS_VENDOR
	default "keymile"

config SYS_CONFIG_NAME
	default "kmopti2"

endif

if TARGET_KMTEPR2

config SYS_BOARD
	default "km83xx"

config SYS_VENDOR
	default "keymile"

config SYS_CONFIG_NAME
	default "kmtepr2"

endif
```

## release/src-rt-5.04axhnd.675x/bootloaders/u-boot-2019.07/board/keymile/km_arm/Kconfig
```kconfig
if TARGET_KM_KIRKWOOD

config SYS_BOARD
	default "km_arm"

config SYS_VENDOR
	default "keymile"

config SYS_CONFIG_NAME
	default "km_kirkwood"

endif
```

## release/src-rt-5.04axhnd.675x/bootloaders/u-boot-2019.07/board/keymile/kmp204x/Kconfig
```kconfig
if TARGET_KMP204X

config SYS_BOARD
	default "kmp204x"

config SYS_VENDOR
	default "keymile"

config SYS_CONFIG_NAME
	default "kmp204x"

endif
```

## release/src-rt-5.04axhnd.675x/bootloaders/u-boot-2019.07/board/kmc/kzm9g/Kconfig
```kconfig
if TARGET_KZM9G

config SYS_BOARD
	default "kzm9g"

config SYS_VENDOR
	default "kmc"

config SYS_CONFIG_NAME
	default "kzm9g"

endif
```

## release/src-rt-5.04axhnd.675x/bootloaders/u-boot-2019.07/board/laird/wb50n/Kconfig
```kconfig
if TARGET_WB50N

config SYS_BOARD
	default "wb50n"

config SYS_VENDOR
	default "laird"

config SYS_CONFIG_NAME
	default "wb50n"

endif
```

## release/src-rt-5.04axhnd.675x/bootloaders/u-boot-2019.07/board/lego/ev3/Kconfig
```kconfig
if TARGET_LEGOEV3

config SYS_BOARD
	default "ev3"

config SYS_VENDOR
	default "lego"

config SYS_CONFIG_NAME
	default "legoev3"

endif
```

## release/src-rt-5.04axhnd.675x/bootloaders/u-boot-2019.07/board/mediatek/mt7623/Kconfig
```kconfig
if TARGET_MT7623

config SYS_BOARD
	default "mt7623"

config SYS_CONFIG_NAME
	default "mt7623"

config MTK_BROM_HEADER_INFO
	string
	default "lk=1"

endif
```

## release/src-rt-5.04axhnd.675x/bootloaders/u-boot-2019.07/board/mediatek/mt7629/Kconfig
```kconfig
if TARGET_MT7629

config SYS_BOARD
	default "mt7629"

config SYS_CONFIG_NAME
	default "mt7629"

config MTK_SPL_PAD_SIZE
	hex
	default 0x10000

config MTK_BROM_HEADER_INFO
	string
	default "media=nor"

endif
```

## release/src-rt-5.04axhnd.675x/bootloaders/u-boot-2019.07/board/microchip/mpfs_icicle/Kconfig
```kconfig
if TARGET_MICROCHIP_ICICLE

config SYS_BOARD
	default "mpfs_icicle"

config SYS_VENDOR
	default "microchip"

config SYS_CPU
	default "generic"

config SYS_CONFIG_NAME
	default "microchip_mpfs_icicle"

config SYS_TEXT_BASE
	default 0x80000000 if !RISCV_SMODE
	default 0x80200000 if RISCV_SMODE

config BOARD_SPECIFIC_OPTIONS # dummy
	def_bool y
	select GENERIC_RISCV
	select BOARD_EARLY_INIT_F
	imply SMP
	imply SYS_NS16550

endif
```

## release/src-rt-5.04axhnd.675x/bootloaders/u-boot-2019.07/board/mini-box/picosam9g45/Kconfig
```kconfig
if TARGET_PICOSAM9G45

config SYS_BOARD
	default "picosam9g45"

config SYS_VENDOR
	default "mini-box"

config SYS_CONFIG_NAME
	default "picosam9g45"

endif
```

## release/src-rt-5.04axhnd.675x/bootloaders/u-boot-2019.07/board/mpc8308_p1m/Kconfig
```kconfig
if TARGET_MPC8308_P1M

config SYS_BOARD
	default "mpc8308_p1m"

config SYS_CONFIG_NAME
	default "mpc8308_p1m"

endif
```

## release/src-rt-5.04axhnd.675x/bootloaders/u-boot-2019.07/board/mqmaker/miqi_rk3288/Kconfig
```kconfig
if TARGET_MIQI_RK3288

config SYS_BOARD
	default "miqi_rk3288"

config SYS_VENDOR
	default "mqmaker"

config SYS_CONFIG_NAME
	default "miqi_rk3288"

config BOARD_SPECIFIC_OPTIONS # dummy
	def_bool y

endif
```

## release/src-rt-5.04axhnd.675x/bootloaders/u-boot-2019.07/board/mscc/jr2/Kconfig
```kconfig
# SPDX-License-Identifier: (GPL-2.0+ OR MIT)

config SYS_VENDOR
	default "mscc"

if SOC_JR2

config SYS_BOARD
	default "jr2"

config SYS_CONFIG_NAME
	default "jr2"

endif
```

## release/src-rt-5.04axhnd.675x/bootloaders/u-boot-2019.07/board/nvidia/e2220-1170/Kconfig
```kconfig
if TARGET_E2220_1170

config SYS_BOARD
	default "e2220-1170"

config SYS_VENDOR
	default "nvidia"

config SYS_CONFIG_NAME
	default "e2220-1170"

endif
```

## release/src-rt-5.04axhnd.675x/bootloaders/u-boot-2019.07/board/nvidia/nyan-big/Kconfig
```kconfig
if TARGET_NYAN_BIG

config SYS_BOARD
	default "nyan-big"

config SYS_VENDOR
	default "nvidia"

config SYS_CONFIG_NAME
	default "nyan-big"

endif
```

## release/src-rt-5.04axhnd.675x/bootloaders/u-boot-2019.07/board/nvidia/p2371-0000/Kconfig
```kconfig
if TARGET_P2371_0000

config SYS_BOARD
	default "p2371-0000"

config SYS_VENDOR
	default "nvidia"

config SYS_CONFIG_NAME
	default "p2371-0000"

endif
```

## release/src-rt-5.04axhnd.675x/bootloaders/u-boot-2019.07/board/nvidia/seaboard/Kconfig
```kconfig
if TARGET_SEABOARD

config SYS_BOARD
	default "seaboard"

config SYS_VENDOR
	default "nvidia"

config SYS_CONFIG_NAME
	default "seaboard"

endif
```

## release/src-rt-5.04axhnd.675x/bootloaders/u-boot-2019.07/board/nvidia/venice2/Kconfig
```kconfig
if TARGET_VENICE2

config SYS_BOARD
	default "venice2"

config SYS_VENDOR
	default "nvidia"

config SYS_CONFIG_NAME
	default "venice2"

endif
```

## release/src-rt-5.04axhnd.675x/bootloaders/u-boot-2019.07/board/overo/Kconfig
```kconfig
if TARGET_OMAP3_OVERO

config SYS_BOARD
	default "overo"

config SYS_CONFIG_NAME
	default "omap3_overo"

endif
```

## release/src-rt-5.04axhnd.675x/bootloaders/u-boot-2019.07/board/pandora/Kconfig
```kconfig
if TARGET_OMAP3_PANDORA

config SYS_BOARD
	default "pandora"

config SYS_CONFIG_NAME
	default "omap3_pandora"

endif
```
