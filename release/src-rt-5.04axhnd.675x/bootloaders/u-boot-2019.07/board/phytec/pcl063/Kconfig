## release/src-rt-5.04axhnd.675x/bootloaders/u-boot-2019.07/board/phytec/pcl063/Kconfig
```kconfig
if TARGET_PCL063

config SYS_BOARD
	default "pcl063"

config SYS_VENDOR
	default "phytec"

config SYS_CONFIG_NAME
	default "pcl063"

endif

if TARGET_PCL063_ULL

config SYS_BOARD
	default "pcl063"

config SYS_VENDOR
	default "phytec"

config SYS_CONFIG_NAME
	default "pcl063_ull"

endif
```

## release/src-rt-5.04axhnd.675x/bootloaders/u-boot-2019.07/board/phytec/pcm051/Kconfig
```kconfig
if TARGET_PCM051

config SYS_BOARD
	default "pcm051"

config SYS_VENDOR
	default "phytec"

config SYS_SOC
	default "am33xx"

config SYS_CONFIG_NAME
	default "pcm051"

endif
```

## release/src-rt-5.04axhnd.675x/bootloaders/u-boot-2019.07/board/phytec/pcm058/Kconfig
```kconfig
if TARGET_PCM058

config SYS_BOARD
	default "pcm058"

config SYS_VENDOR
	default "phytec"

config SYS_CONFIG_NAME
	default "pcm058"

endif
```

## release/src-rt-5.04axhnd.675x/bootloaders/u-boot-2019.07/board/qualcomm/dragonboard410c/Kconfig
```kconfig
if TARGET_DRAGONBOARD410C

config SYS_BOARD
	default "dragonboard410c"

config SYS_VENDOR
	default "qualcomm"

config SYS_SOC
	default "apq8016"

config SYS_CONFIG_NAME
	default "dragonboard410c"

endif
```

## release/src-rt-5.04axhnd.675x/bootloaders/u-boot-2019.07/board/radxa/rock2/Kconfig
```kconfig
if TARGET_ROCK2

config SYS_BOARD
	default "rock2"

config SYS_VENDOR
	default "radxa"

config SYS_CONFIG_NAME
	default "rock2"

config BOARD_SPECIFIC_OPTIONS # dummy
	def_bool y

endif
```

## release/src-rt-5.04axhnd.675x/bootloaders/u-boot-2019.07/board/renesas/MigoR/Kconfig
```kconfig
if TARGET_MIGOR

config SYS_BOARD
	default "MigoR"

config SYS_VENDOR
	default "renesas"

config SYS_CONFIG_NAME
	default "MigoR"

endif
```

## release/src-rt-5.04axhnd.675x/bootloaders/u-boot-2019.07/board/renesas/draak/Kconfig
```kconfig
if TARGET_DRAAK

config SYS_SOC
	default "rmobile"

config SYS_BOARD
	default "draak"

config SYS_VENDOR
	default "renesas"

config SYS_CONFIG_NAME
	default "draak"

endif
```

## release/src-rt-5.04axhnd.675x/bootloaders/u-boot-2019.07/board/renesas/gose/Kconfig
```kconfig
if TARGET_GOSE

config SYS_BOARD
	default "gose"

config SYS_VENDOR
	default "renesas"

config SYS_CONFIG_NAME
	default "gose"

endif
```

## release/src-rt-5.04axhnd.675x/bootloaders/u-boot-2019.07/board/renesas/grpeach/Kconfig
```kconfig
if TARGET_GRPEACH

config SYS_BOARD
	default "grpeach"

config SYS_VENDOR
	default "renesas"

config SYS_CONFIG_NAME
	default "grpeach"

endif
```

## release/src-rt-5.04axhnd.675x/bootloaders/u-boot-2019.07/board/renesas/koelsch/Kconfig
```kconfig
if TARGET_KOELSCH

config SYS_BOARD
	default "koelsch"

config SYS_VENDOR
	default "renesas"

config SYS_CONFIG_NAME
	default "koelsch"

endif
```

## release/src-rt-5.04axhnd.675x/bootloaders/u-boot-2019.07/board/renesas/porter/Kconfig
```kconfig
if TARGET_PORTER

config SYS_BOARD
	default "porter"

config SYS_VENDOR
	default "renesas"

config SYS_CONFIG_NAME
	default "porter"

endif
```

## release/src-rt-5.04axhnd.675x/bootloaders/u-boot-2019.07/board/renesas/r2dplus/Kconfig
```kconfig
if TARGET_R2DPLUS

config SYS_BOARD
	default "r2dplus"

config SYS_VENDOR
	default "renesas"

config SYS_CONFIG_NAME
	default "r2dplus"

endif
```

## release/src-rt-5.04axhnd.675x/bootloaders/u-boot-2019.07/board/renesas/r7780mp/Kconfig
```kconfig
if TARGET_R7780MP

config SYS_BOARD
	default "r7780mp"

config SYS_VENDOR
	default "renesas"

config SYS_CONFIG_NAME
	default "r7780mp"

endif
```

## release/src-rt-5.04axhnd.675x/bootloaders/u-boot-2019.07/board/renesas/salvator-x/Kconfig
```kconfig
if TARGET_SALVATOR_X

config SYS_SOC
	default "rmobile"

config SYS_BOARD
	default "salvator-x"

config SYS_VENDOR
	default "renesas"

config SYS_CONFIG_NAME
	default "salvator-x"

endif
```

## release/src-rt-5.04axhnd.675x/bootloaders/u-boot-2019.07/board/renesas/stout/Kconfig
```kconfig
if TARGET_STOUT

config SYS_BOARD
	default "stout"

config SYS_VENDOR
	default "renesas"

config SYS_CONFIG_NAME
	default "stout"

endif
```

## release/src-rt-5.04axhnd.675x/bootloaders/u-boot-2019.07/board/rockchip/evb_rk3288/Kconfig
```kconfig
if TARGET_EVB_RK3288

config SYS_BOARD
	default "evb_rk3288"

config SYS_VENDOR
	default "rockchip"

config SYS_CONFIG_NAME
	default "evb_rk3288"

config BOARD_SPECIFIC_OPTIONS # dummy
	def_bool y

endif
```

## release/src-rt-5.04axhnd.675x/bootloaders/u-boot-2019.07/board/rockchip/evb_rk3328/Kconfig
```kconfig
if TARGET_EVB_RK3328

config SYS_BOARD
	default "evb_rk3328"

config SYS_VENDOR
	default "rockchip"

config SYS_CONFIG_NAME
	default "evb_rk3328"

config BOARD_SPECIFIC_OPTIONS # dummy
	def_bool y

endif
```

## release/src-rt-5.04axhnd.675x/bootloaders/u-boot-2019.07/board/rockchip/evb_rv1108/Kconfig
```kconfig
if TARGET_EVB_RV1108

config SYS_BOARD
	default "evb_rv1108"

config SYS_VENDOR
	default "rockchip"

config SYS_CONFIG_NAME
	default "evb_rv1108"

config BOARD_SPECIFIC_OPTIONS # dummy
	def_bool y

endif
```

## release/src-rt-5.04axhnd.675x/bootloaders/u-boot-2019.07/board/rockchip/fennec_rk3288/Kconfig
```kconfig
if TARGET_FENNEC_RK3288

config SYS_BOARD
	default "fennec_rk3288"

config SYS_VENDOR
	default "rockchip"

config SYS_CONFIG_NAME
	default "fennec_rk3288"

config BOARD_SPECIFIC_OPTIONS # dummy
	def_bool y

endif
```

## release/src-rt-5.04axhnd.675x/bootloaders/u-boot-2019.07/board/rockchip/kylin_rk3036/Kconfig
```kconfig
if TARGET_KYLIN_RK3036

config SYS_BOARD
	default "kylin_rk3036"

config SYS_VENDOR
	default "rockchip"

config SYS_CONFIG_NAME
	default "kylin_rk3036"

config BOARD_SPECIFIC_OPTIONS # dummy
	def_bool y

endif
```

## release/src-rt-5.04axhnd.675x/bootloaders/u-boot-2019.07/board/samsung/espresso7420/Kconfig
```kconfig
if TARGET_ESPRESSO7420

config SYS_BOARD
	default "espresso7420"
	help
	  Espresso7420 is a development/evaluation board for Exynos7420 SoC.
	  It includes multiple onboard compoments (EMMC/Codec) and various
	  interconnects (USB/HDMI).

config SYS_VENDOR
	default "samsung"

config SYS_CONFIG_NAME
	default "espresso7420"

endif
```

## release/src-rt-5.04axhnd.675x/bootloaders/u-boot-2019.07/board/samsung/smdk5250/Kconfig
```kconfig
if TARGET_SMDK5250

config SYS_BOARD
	default "smdk5250"

config SYS_VENDOR
	default "samsung"

config SYS_CONFIG_NAME
	default "smdk5250"

endif

if TARGET_SNOW

config SYS_BOARD
	default "smdk5250"

config SYS_VENDOR
	default "samsung"

config SYS_CONFIG_NAME
	default "snow"

endif

if TARGET_SPRING

config SYS_BOARD
	default "smdk5250"

config SYS_VENDOR
	default "samsung"

config SYS_CONFIG_NAME
	default "spring"

endif
```

## release/src-rt-5.04axhnd.675x/bootloaders/u-boot-2019.07/board/samsung/smdk5420/Kconfig
```kconfig
if TARGET_ODROID_XU3

config SYS_BOARD
	default "smdk5420"

config SYS_VENDOR
	default "samsung"

config SYS_CONFIG_NAME
	default "odroid_xu3"

endif

if TARGET_PEACH_PI

config SYS_BOARD
	default "smdk5420"

config SYS_VENDOR
	default "samsung"

config SYS_CONFIG_NAME
	default "peach-pi"

endif

if TARGET_PEACH_PIT

config SYS_BOARD
	default "smdk5420"

config SYS_VENDOR
	default "samsung"

config SYS_CONFIG_NAME
	default "peach-pit"

endif

if TARGET_SMDK5420

config SYS_BOARD
	default "smdk5420"

config SYS_VENDOR
	default "samsung"

config SYS_CONFIG_NAME
	default "smdk5420"

endif
```

## release/src-rt-5.04axhnd.675x/bootloaders/u-boot-2019.07/board/samsung/trats/Kconfig
```kconfig
if TARGET_TRATS

config SYS_BOARD
	default "trats"

config SYS_VENDOR
	default "samsung"

config SYS_CONFIG_NAME
	default "trats"

endif
```

## release/src-rt-5.04axhnd.675x/bootloaders/u-boot-2019.07/board/sbc8548/Kconfig
```kconfig
if TARGET_SBC8548

config SYS_BOARD
	default "sbc8548"

config SYS_CONFIG_NAME
	default "sbc8548"

endif
```
