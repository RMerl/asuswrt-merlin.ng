## release/src-rt-5.04axhnd.675x/bootloaders/u-boot-2019.07/board/siemens/corvus/Kconfig
```kconfig
if TARGET_CORVUS

config SYS_BOARD
	default "corvus"

config SYS_VENDOR
	default "siemens"

config SYS_CONFIG_NAME
	default "corvus"

endif
```

## release/src-rt-5.04axhnd.675x/bootloaders/u-boot-2019.07/board/siemens/draco/Kconfig
```kconfig
if TARGET_DRACO

config SYS_BOARD
	default "draco"

config SYS_VENDOR
	default "siemens"

config SYS_SOC
	default "am33xx"

config SYS_CONFIG_NAME
	default "draco"

endif

if TARGET_THUBAN

config SYS_BOARD
	default "draco"

config SYS_VENDOR
	default "siemens"

config SYS_SOC
	default "am33xx"

config SYS_CONFIG_NAME
	default "thuban"

endif

if TARGET_RASTABAN

config SYS_BOARD
	default "draco"

config SYS_VENDOR
	default "siemens"

config SYS_SOC
	default "am33xx"

config SYS_CONFIG_NAME
	default "rastaban"

endif

if TARGET_ETAMIN

config SYS_BOARD
        default "draco"

config SYS_VENDOR
        default "siemens"

config SYS_SOC
        default "am33xx"

config SYS_CONFIG_NAME
        default "etamin"

endif
```

## release/src-rt-5.04axhnd.675x/bootloaders/u-boot-2019.07/board/siemens/pxm2/Kconfig
```kconfig
if TARGET_PXM2

config SYS_BOARD
	default "pxm2"

config SYS_VENDOR
	default "siemens"

config SYS_SOC
	default "am33xx"

config SYS_CONFIG_NAME
	default "pxm2"

endif
```

## release/src-rt-5.04axhnd.675x/bootloaders/u-boot-2019.07/board/siemens/smartweb/Kconfig
```kconfig
if TARGET_SMARTWEB

config SYS_BOARD
	default "smartweb"

config SYS_VENDOR
	default "siemens"

config SYS_CONFIG_NAME
	default "smartweb"

endif
```

## release/src-rt-5.04axhnd.675x/bootloaders/u-boot-2019.07/board/silica/pengwyn/Kconfig
```kconfig
if TARGET_PENGWYN

config SYS_BOARD
	default "pengwyn"

config SYS_VENDOR
	default "silica"

config SYS_SOC
	default "am33xx"

config SYS_CONFIG_NAME
	default "pengwyn"

endif
```

## release/src-rt-5.04axhnd.675x/bootloaders/u-boot-2019.07/board/softing/vining_2000/Kconfig
```kconfig
if TARGET_SOFTING_VINING_2000

config SYS_BOARD
	default "vining_2000"

config SYS_VENDOR
	default "softing"

config SYS_CONFIG_NAME
	default "vining_2000"

endif
```

## release/src-rt-5.04axhnd.675x/bootloaders/u-boot-2019.07/board/solidrun/mx6cuboxi/Kconfig
```kconfig
if TARGET_MX6CUBOXI

config SYS_BOARD
	default "mx6cuboxi"

config SYS_VENDOR
	default "solidrun"

config SYS_CONFIG_NAME
	default "mx6cuboxi"

endif
```

## release/src-rt-5.04axhnd.675x/bootloaders/u-boot-2019.07/board/spear/spear300/Kconfig
```kconfig
if TARGET_SPEAR300

config SYS_BOARD
	default "spear300"

config SYS_VENDOR
	default "spear"

config SYS_SOC
	default "spear"

config SYS_CONFIG_NAME
	default "spear3xx_evb"

endif
```

## release/src-rt-5.04axhnd.675x/bootloaders/u-boot-2019.07/board/spear/x600/Kconfig
```kconfig
if TARGET_X600

config SPL_LDSCRIPT
	default "arch/arm/cpu/arm926ejs/spear/u-boot-spl.lds"

config SYS_BOARD
	default "x600"

config SYS_VENDOR
	default "spear"

config SYS_SOC
	default "spear"

config SYS_CONFIG_NAME
	default "x600"

endif
```

## release/src-rt-5.04axhnd.675x/bootloaders/u-boot-2019.07/board/st/stih410-b2260/Kconfig
```kconfig
if TARGET_STIH410_B2260

config SYS_BOARD
	string
	default "stih410-b2260"

config SYS_VENDOR
	string
	default "st"

config SYS_SOC
	string
	default "stih410"

config SYS_CONFIG_NAME
	string
	default "stih410-b2260"

endif
```

## release/src-rt-5.04axhnd.675x/bootloaders/u-boot-2019.07/board/st/stm32f429-evaluation/Kconfig
```kconfig
if TARGET_STM32F429_EVALUATION

config SYS_BOARD
	string
	default "stm32f429-evaluation"

config SYS_VENDOR
	string
	default "st"

config SYS_SOC
	string
	default "stm32f4"

config SYS_CONFIG_NAME
	string
	default "stm32f429-evaluation"

endif
```

## release/src-rt-5.04axhnd.675x/bootloaders/u-boot-2019.07/board/st/stm32f746-disco/Kconfig
```kconfig
if TARGET_STM32F746_DISCO

config SYS_BOARD
	string
	default "stm32f746-disco"

config SYS_VENDOR
	string
	default "st"

config SYS_SOC
	string
	default "stm32f7"

config SYS_CONFIG_NAME
	string
	default "stm32f746-disco"

endif
```

## release/src-rt-5.04axhnd.675x/bootloaders/u-boot-2019.07/board/st/stv0991/Kconfig
```kconfig
if TARGET_STV0991

config SYS_BOARD
	default "stv0991"

config SYS_VENDOR
	default "st"

config SYS_SOC
	default "stv0991"

config SYS_CONFIG_NAME
	default "stv0991"

endif
```

## release/src-rt-5.04axhnd.675x/bootloaders/u-boot-2019.07/board/synopsys/hsdk/Kconfig
```kconfig
if TARGET_HSDK

config SYS_BOARD
	default "hsdk"

config SYS_VENDOR
	default "synopsys"

config SYS_CONFIG_NAME
	default "hsdk"

endif
```

## release/src-rt-5.04axhnd.675x/bootloaders/u-boot-2019.07/board/syteco/zmx25/Kconfig
```kconfig
if TARGET_ZMX25

config SYS_BOARD
	default "zmx25"

config SYS_VENDOR
	default "syteco"

config SYS_SOC
	default "mx25"

config SYS_CONFIG_NAME
	default "zmx25"

endif
```

## release/src-rt-5.04axhnd.675x/bootloaders/u-boot-2019.07/board/technologic/ts4800/Kconfig
```kconfig
if TARGET_TS4800

config SYS_BOARD
	default "ts4800"

config SYS_VENDOR
	default "technologic"

config SYS_SOC
	default "mx5"

config SYS_CONFIG_NAME
	default "ts4800"

endif
```

## release/src-rt-5.04axhnd.675x/bootloaders/u-boot-2019.07/board/ti/am43xx/Kconfig
```kconfig
if TARGET_AM43XX_EVM

config SYS_BOARD
	default "am43xx"

config SYS_VENDOR
	default "ti"

config SYS_SOC
	default "am33xx"

config SYS_CONFIG_NAME
	default "am43xx_evm"

source "board/ti/common/Kconfig"

endif
```

## release/src-rt-5.04axhnd.675x/bootloaders/u-boot-2019.07/board/ti/beagle/Kconfig
```kconfig
if TARGET_OMAP3_BEAGLE

config SYS_BOARD
	default "beagle"

config SYS_VENDOR
	default "ti"

config SYS_CONFIG_NAME
	default "omap3_beagle"

endif
```

## release/src-rt-5.04axhnd.675x/bootloaders/u-boot-2019.07/board/ti/dra7xx/Kconfig
```kconfig
if TARGET_DRA7XX_EVM

config SYS_BOARD
	default "dra7xx"

config SYS_VENDOR
	default "ti"

config SYS_CONFIG_NAME
	default "dra7xx_evm"

source "board/ti/common/Kconfig"

endif
```

## release/src-rt-5.04axhnd.675x/bootloaders/u-boot-2019.07/board/ti/evm/Kconfig
```kconfig
if TARGET_OMAP3_EVM

config SYS_BOARD
	default "evm"

config SYS_VENDOR
	default "ti"

config SYS_CONFIG_NAME
	default "omap3_evm"

endif
```

## release/src-rt-5.04axhnd.675x/bootloaders/u-boot-2019.07/board/ti/ti816x/Kconfig
```kconfig
if TARGET_TI816X_EVM

config SYS_BOARD
	default "ti816x"

config SYS_VENDOR
	default "ti"

config SYS_SOC
	default "am33xx"

config SYS_CONFIG_NAME
	default "ti816x_evm"

endif
```

## release/src-rt-5.04axhnd.675x/bootloaders/u-boot-2019.07/board/timll/devkit8000/Kconfig
```kconfig
if TARGET_DEVKIT8000

config SYS_BOARD
	default "devkit8000"

config SYS_VENDOR
	default "timll"

config SYS_CONFIG_NAME
	default "devkit8000"

endif
```

## release/src-rt-5.04axhnd.675x/bootloaders/u-boot-2019.07/board/toradex/apalis-imx8/Kconfig
```kconfig
if TARGET_APALIS_IMX8

config SYS_BOARD
	default "apalis-imx8"

config SYS_VENDOR
	default "toradex"

config SYS_CONFIG_NAME
	default "apalis-imx8"

config TDX_CFG_BLOCK
	default y

config TDX_HAVE_MMC
	default y

config TDX_CFG_BLOCK_DEV
	default "0"

config TDX_CFG_BLOCK_PART
	default "1"

# Toradex config block in eMMC, at the end of 1st "boot sector"
config TDX_CFG_BLOCK_OFFSET
	default "-512"

source "board/toradex/common/Kconfig"

endif
```

## release/src-rt-5.04axhnd.675x/bootloaders/u-boot-2019.07/board/toradex/apalis_imx6/Kconfig
```kconfig
if TARGET_APALIS_IMX6

config SYS_BOARD
	default "apalis_imx6"

config SYS_CONFIG_NAME
	default "apalis_imx6"

config SYS_CPU
	default "armv7"

config SYS_SOC
	default "mx6"

config SYS_VENDOR
	default "toradex"

config TDX_CFG_BLOCK
	default y

config TDX_HAVE_MMC
	default y

config TDX_CFG_BLOCK_DEV
	default "0"

config TDX_CFG_BLOCK_PART
	default "1"

# Toradex config block in eMMC, at the end of 1st "boot sector"
config TDX_CFG_BLOCK_OFFSET
	default "-512"

config TDX_CMD_IMX_MFGR
	bool "Enable factory testing commands for Toradex iMX 6 modules"
	help
	  This adds the commands
	    pf0100_otp_prog - Program the OTP fuses on the PMIC PF0100
	  If executed on already fused modules it doesn't change any fuse setting.
	default y

config TDX_APALIS_IMX6_V1_0
	bool "Apalis iMX6 V1.0 HW"
	help
	  Apalis iMX6 V1.0 HW has a different pinout for the UART.
	    The UARTs must be used in DCE mode, RTS/CTS are swapped and
	    thus unusable on standard carrier boards.
	    This option configures DCE mode unconditionally. Whithout this
	    option the config block stating V1.0 HW selects DCE mode,
	    otherwise the UARTs are configuered in DTE mode.
	default n

source "board/toradex/common/Kconfig"

endif
```

## release/src-rt-5.04axhnd.675x/bootloaders/u-boot-2019.07/board/toradex/colibri-imx6ull/Kconfig
```kconfig
if TARGET_COLIBRI_IMX6ULL

config SYS_BOARD
	default "colibri-imx6ull"

config SYS_VENDOR
	default "toradex"

config SYS_CONFIG_NAME
	default "colibri-imx6ull"

config TDX_CFG_BLOCK
	default y

config TDX_HAVE_NAND
	default y

config TDX_CFG_BLOCK_OFFSET
	default "2048"

config TDX_CFG_BLOCK_OFFSET2
	default "133120"

config TDX_CFG_BLOCK_2ND_ETHADDR
	default y

source "board/toradex/common/Kconfig"

endif
```
