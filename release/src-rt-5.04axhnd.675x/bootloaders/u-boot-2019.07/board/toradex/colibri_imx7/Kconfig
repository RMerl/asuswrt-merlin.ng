## release/src-rt-5.04axhnd.675x/bootloaders/u-boot-2019.07/board/toradex/colibri_imx7/Kconfig
```kconfig
if TARGET_COLIBRI_IMX7

choice
	prompt "Colibri iMX7S/D variant"

config TARGET_COLIBRI_IMX7_NAND
	bool "Support Colibri iMX7 Solo 256MB/Dual 512MB (raw NAND) modules"
	imply NAND_MXS
	help
	  Choose this option if you build for a Toradex Colibri iMX7S
	  256MB or Colibri iMX7D 512MB module which do have raw NAND
	  on-module.

config TARGET_COLIBRI_IMX7_EMMC
	bool "Support Colibri iMX7 Dual 1GB (eMMC) modules"
	help
	  Choose this option if you build for a Toradex Colibri iMX7D
	  1GB module which does have eMMC on-module.

endchoice

config SYS_BOARD
	default "colibri_imx7"

config SYS_VENDOR
	default "toradex"

config SYS_CONFIG_NAME
	default "colibri_imx7"

config COLIBRI_IMX7_EXT_PHYCLK
	bool "External oscillator for Ethernet PHY clock provided"
	help
	  Select this if your module provides a external Ethernet PHY
	  clock source.
	default y

config TDX_CFG_BLOCK
	default y

config TDX_CFG_BLOCK_2ND_ETHADDR
	default y

if TARGET_COLIBRI_IMX7_NAND

config TDX_HAVE_NAND
	default y

config TDX_CFG_BLOCK_OFFSET
	default "2048"

config TDX_CFG_BLOCK_OFFSET2
	default "133120"

endif

if TARGET_COLIBRI_IMX7_EMMC

config TDX_HAVE_MMC
	default y

config TDX_CFG_BLOCK_DEV
	default "0"

config TDX_CFG_BLOCK_PART
	default "1"

# Toradex config block in eMMC, at the end of 1st "boot sector"
config TDX_CFG_BLOCK_OFFSET
	default "-512"

endif

source "board/toradex/common/Kconfig"

endif
```

## release/src-rt-5.04axhnd.675x/bootloaders/u-boot-2019.07/board/toradex/colibri_pxa270/Kconfig
```kconfig
if TARGET_COLIBRI_PXA270

config SYS_BOARD
	default "colibri_pxa270"

config SYS_VENDOR
	default "toradex"

config SYS_CONFIG_NAME
	default "colibri_pxa270"

config TDX_CFG_BLOCK
	default y

config TDX_HAVE_NOR
	default y

config TDX_CFG_BLOCK_OFFSET
	default "262144"

source "board/toradex/common/Kconfig"

endif
```

## release/src-rt-5.04axhnd.675x/bootloaders/u-boot-2019.07/board/toradex/common/Kconfig
```kconfig
# SPDX-License-Identifier: GPL-2.0+
# Copyright (c) 2016 Toradex, Inc.

menuconfig TDX_CFG_BLOCK
	bool "Enable Toradex config block support"
	select OF_BOARD_SETUP
	help
	  The Toradex config block stored production data on the on-module
	  flash device (NAND, NOR or eMMC). The area is normally preserved by
	  software and contains the serial number (out of which the MAC
	  address is generated) and the exact module type.

# Helper config to determine the correct default location of the cfg block
config TDX_HAVE_MMC
	bool

config TDX_HAVE_NAND
	bool

config TDX_HAVE_NOR
	bool

if TDX_CFG_BLOCK

config TDX_CFG_BLOCK_IS_IN_MMC
	bool
	depends on TDX_HAVE_MMC
	default y

config TDX_CFG_BLOCK_IS_IN_NAND
	bool
	depends on TDX_HAVE_NAND
	default y

config TDX_CFG_BLOCK_IS_IN_NOR
	bool
	depends on TDX_HAVE_NOR
	default y

config TDX_CFG_BLOCK_DEV
	int "Toradex config block eMMC device ID"
	depends on TDX_CFG_BLOCK_IS_IN_MMC

config TDX_CFG_BLOCK_PART
	int "Toradex config block eMMC partition ID"
	depends on TDX_CFG_BLOCK_IS_IN_MMC

config TDX_CFG_BLOCK_OFFSET
	int "Toradex config block offset"
	help
	  Specify the byte offset of the Toradex config block within the flash
	  device the config block is stored on.

config TDX_CFG_BLOCK_OFFSET2
	int "Toradex config block offset, second instance"
	default 0
	help
	  Specify the byte offset of the 2nd instance of the Toradex config block
	  within the flash device the config block is stored on.
	  Set to 0 on modules which have no 2nd instance.

config TDX_CFG_BLOCK_2ND_ETHADDR
	bool "Set the second Ethernet address"
	help
	  For each serial number two Ethernet addresses are available for dual
	  Ethernet carrier boards. This options enables the code to set the
	  second Ethernet address as environment variable (eth1addr).

endif
```

## release/src-rt-5.04axhnd.675x/bootloaders/u-boot-2019.07/board/tqc/tqma6/Kconfig
```kconfig
if TARGET_TQMA6

config SYS_BOARD
	default "tqma6"

config SYS_VENDOR
	default "tqc"

config SYS_CONFIG_NAME
	default "tqma6"

choice
	prompt "TQMa6 SoC variant"
	default TQMA6Q
	help
	  select the TQMa6 module variant. The variants differing in the used
	  i.MX6 CPU type and DRAM

config TQMA6Q
	bool "TQMa6Q / TQMa6D"
	select MX6Q
	help
	  select TQMa6Q / TQMa6D with i.MX6Q/D and 1GiB DRAM

config TQMA6DL
	bool "TQMa6DL"
	select MX6DL
	help
	  select TQMa6DL with i.MX6DL and 1GiB DRAM

config TQMA6S
	bool "TQMa6S"
	select MX6S
	help
	  select TQMa6S with i.MX6S and 512 MiB DRAM

endchoice

choice
	prompt "TQMa6 boot configuration"
	default TQMA6X_MMC_BOOT
	help
	  Configure boot device. This is also used to implement environment
	  location.

config TQMA6X_MMC_BOOT
	bool "MMC / SD Boot"
	help
	  Boot from eMMC / SD Card

config TQMA6X_SPI_BOOT
	bool "SPI NOR Boot"
	help
	  Boot from on board SPI NOR flash

endchoice

choice
	prompt "TQMa6 base board variant"
	default MBA6
	help
	  Select base board for TQMa6

config MBA6
	bool "TQMa6 on MBa6 Starterkit"
	help
	  Select the MBa6 starterkit. This features a GigE Phy, USB, SD-Card
	  etc.

config WRU4
	bool "OHB WRU-IV"
	help
	  Select the OHB Systems AG WRU-IV baseboard.

endchoice

config IMX_CONFIG
	default "board/tqc/tqma6/tqma6q.cfg" if TQMA6Q
	default "board/tqc/tqma6/tqma6dl.cfg" if TQMA6DL
	default "board/tqc/tqma6/tqma6s.cfg" if TQMA6S

endif
```

## release/src-rt-5.04axhnd.675x/bootloaders/u-boot-2019.07/board/udoo/neo/Kconfig
```kconfig
if TARGET_UDOO_NEO

config SYS_VENDOR
	default "udoo"

config SYS_BOARD
	default "neo"

config SYS_CONFIG_NAME
	default "udoo_neo"

endif
```

## release/src-rt-5.04axhnd.675x/bootloaders/u-boot-2019.07/board/vscom/baltos/Kconfig
```kconfig
if TARGET_AM335X_BALTOS

config SYS_BOARD
	default "baltos"

config SYS_VENDOR
	default "vscom"

config SYS_SOC
	default "am33xx"

config SYS_CONFIG_NAME
	default "baltos"

endif
```

## release/src-rt-5.04axhnd.675x/bootloaders/u-boot-2019.07/board/wandboard/Kconfig
```kconfig
if TARGET_WANDBOARD

config SYS_BOARD
	default "wandboard"

config SYS_CONFIG_NAME
	default "wandboard"

endif
```

## release/src-rt-5.04axhnd.675x/bootloaders/u-boot-2019.07/board/warp/Kconfig
```kconfig
if TARGET_WARP

config SYS_BOARD
	default "warp"

config SYS_CONFIG_NAME
	default "warp"

endif
```

## release/src-rt-5.04axhnd.675x/bootloaders/u-boot-2019.07/board/warp7/Kconfig
```kconfig
if TARGET_WARP7

config SYS_BOARD
	default "warp7"

config SYS_CONFIG_NAME
	default "warp7"

config WARP7_ROOT_PART
	int "Partition number to use for root filesystem"
	default 2
	help
	  The partition number to use for root filesystem this is the
	  partition that is typically specified with root=/dev/sdaX or
	  which gets converted into a root=PARTUUID=some_uuid.

config SYS_FDT_ADDR
	hex "FDT load address"
	default 0x83000000
	help
	  The address the FDT file should be loaded to.

endif
```

## release/src-rt-5.04axhnd.675x/bootloaders/u-boot-2019.07/board/xes/xpedite517x/Kconfig
```kconfig
if TARGET_XPEDITE517X

config SYS_BOARD
	default "xpedite517x"

config SYS_VENDOR
	default "xes"

config SYS_CONFIG_NAME
	default "xpedite517x"

endif
```

## release/src-rt-5.04axhnd.675x/bootloaders/u-boot-2019.07/board/xes/xpedite520x/Kconfig
```kconfig
if TARGET_XPEDITE520X

config SYS_BOARD
	default "xpedite520x"

config SYS_VENDOR
	default "xes"

config SYS_CONFIG_NAME
	default "xpedite520x"

endif
```

## release/src-rt-5.04axhnd.675x/bootloaders/u-boot-2019.07/board/xes/xpedite550x/Kconfig
```kconfig
if TARGET_XPEDITE550X

config SYS_BOARD
	default "xpedite550x"

config SYS_VENDOR
	default "xes"

config SYS_CONFIG_NAME
	default "xpedite550x"

endif
```

## release/src-rt-5.04axhnd.675x/bootloaders/u-boot-2019.07/board/xilinx/microblaze-generic/Kconfig
```kconfig
if TARGET_MICROBLAZE_GENERIC

config SYS_BOARD
	default "microblaze-generic"

config SYS_VENDOR
	default "xilinx"

config SYS_CONFIG_NAME
	string "Board configuration name"
	default "microblaze-generic"
	help
	  This option contains information about board configuration name.
	  Based on this option include/configs/<CONFIG_SYS_CONFIG_NAME>.h header
	  will be used for board configuration.

config XILINX_MICROBLAZE0_USE_MSR_INSTR
	int "USE_MSR_INSTR range (0:1)"
	default 0

config XILINX_MICROBLAZE0_USE_PCMP_INSTR
	int "USE_PCMP_INSTR range (0:1)"
	default 0

config XILINX_MICROBLAZE0_USE_BARREL
	int "USE_BARREL range (0:1)"
	default 0

config XILINX_MICROBLAZE0_USE_DIV
	int "USE_DIV range (0:1)"
	default 0

config XILINX_MICROBLAZE0_USE_HW_MUL
	int "USE_HW_MUL values (0=NONE, 1=MUL32, 2=MUL64)"
	default 0

config XILINX_MICROBLAZE0_HW_VER
	string "Core version number"
	default "7.10.d"

endif
```

## release/src-rt-5.04axhnd.675x/bootloaders/u-boot-2019.07/board/zyxel/nsa310s/Kconfig
```kconfig
# SPDX-License-Identifier: GPL-2.0+
#
# Copyright (C) 2015
# Gerald Kerma <dreagle@doukki.net>
# Tony Dinh <mibodhi@gmail.com>

if TARGET_NSA310S

config SYS_BOARD
	default "nsa310s"

config SYS_VENDOR
	default "zyxel"

config SYS_CONFIG_NAME
	default "nsa310s"

endif
```
