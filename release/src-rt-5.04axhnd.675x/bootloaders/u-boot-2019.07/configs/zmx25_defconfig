## release/src-rt-5.04axhnd.675x/bootloaders/u-boot-2019.07/doc/uImage.FIT/multi.its
```
/*
 * U-Boot uImage source file with multiple kernels, ramdisks and FDT blobs
 */

/dts-v1/;

/ {
	description = "Various kernels, ramdisks and FDT blobs";
	#address-cells = <1>;

	images {
		kernel-1 {
			description = "vanilla-2.6.23";
			data = /incbin/("./vmlinux.bin.gz");
			type = "kernel";
			arch = "ppc";
			os = "linux";
			compression = "gzip";
			load = <00000000>;
			entry = <00000000>;
			hash-1 {
				algo = "md5";
			};
			hash-2 {
				algo = "sha1";
			};
		};

		kernel-2 {
			description = "2.6.23-denx";
			data = /incbin/("./2.6.23-denx.bin.gz");
			type = "kernel";
			arch = "ppc";
			os = "linux";
			compression = "gzip";
			load = <00000000>;
			entry = <00000000>;
			hash-1 {
				algo = "sha1";
			};
		};

		kernel-3 {
			description = "2.4.25-denx";
			data = /incbin/("./2.4.25-denx.bin.gz");
			type = "kernel";
			arch = "ppc";
			os = "linux";
			compression = "gzip";
			load = <00000000>;
			entry = <00000000>;
			hash-1 {
				algo = "md5";
			};
		};

		ramdisk-1 {
			description = "eldk-4.2-ramdisk";
			data = /incbin/("./eldk-4.2-ramdisk");
			type = "ramdisk";
			arch = "ppc";
			os = "linux";
			compression = "gzip";
			load = <00000000>;
			entry = <00000000>;
			hash-1 {
				algo = "sha1";
			};
		};

		ramdisk-2 {
			description = "eldk-3.1-ramdisk";
			data = /incbin/("./eldk-3.1-ramdisk");
			type = "ramdisk";
			arch = "ppc";
			os = "linux";
			compression = "gzip";
			load = <00000000>;
			entry = <00000000>;
			hash-1 {
				algo = "crc32";
			};
		};

		fdt-1 {
			description = "tqm5200-fdt";
			data = /incbin/("./tqm5200.dtb");
			type = "flat_dt";
			arch = "ppc";
			compression = "none";
			hash-1 {
				algo = "crc32";
			};
		};

		fdt-2 {
			description = "tqm5200s-fdt";
			data = /incbin/("./tqm5200s.dtb");
			type = "flat_dt";
			arch = "ppc";
			compression = "none";
			load = <00700000>;
			hash-1 {
				algo = "sha1";
			};
		};

	};

	configurations {
		default = "config-1";

		config-1 {
			description = "tqm5200 vanilla-2.6.23 configuration";
			kernel = "kernel-1";
			ramdisk = "ramdisk-1";
			fdt = "fdt-1";
		};

		config-2 {
			description = "tqm5200s denx-2.6.23 configuration";
			kernel = "kernel-2";
			ramdisk = "ramdisk-1";
			fdt = "fdt-2";
		};

		config-3 {
			description = "tqm5200s denx-2.4.25 configuration";
			kernel = "kernel-3";
			ramdisk = "ramdisk-2";
		};
	};
};
```

## release/src-rt-5.04axhnd.675x/bootloaders/u-boot-2019.07/doc/uImage.FIT/multi_spl.its
```
/dts-v1/;

/*
 * (Bogus) example FIT image description file demonstrating the usage
 * of multiple images loaded by the SPL.
 * Several binaries will be loaded at their respective load addresses.
 *
 * For booting U-Boot, "firmware" is searched first. If not found, "loadables"
 * is used to identify images to be loaded into memory. If falcon boot is
 * enabled, "kernel" is searched first. If not found, it falls back to the
 * same flow as booting U-Boot. Changing image type will result skipping
 * specific image.
 *
 * Finally the one image specifying an entry point will be entered by the SPL.
 */

/ {
	description = "multiple firmware blobs and U-Boot, loaded by SPL";
	#address-cells = <0x1>;

	images {

		uboot {
			description = "U-Boot (64-bit)";
			type = "standalone";
			arch = "arm64";
			compression = "none";
			load = <0x4a000000>;
		};

		atf {
			description = "ARM Trusted Firmware";
			type = "firmware";
			arch = "arm64";
			compression = "none";
			load = <0x18000>;
			entry = <0x18000>;
		};

		mgmt-firmware {
			description = "arisc management processor firmware";
			type = "firmware";
			arch = "or1k";
			compression = "none";
			load = <0x40000>;
		};

		fdt-1 {
			description = "Pine64+ DT";
			type = "flat_dt";
			compression = "none";
			load = <0x4fa00000>;
			arch = "arm64";
		};

		fdt-2 {
			description = "Pine64 DT";
			type = "flat_dt";
			compression = "none";
			load = <0x4fa00000>;
			arch = "arm64";
		};

		kernel {
			description = "4.7-rc5 kernel";
			type = "kernel";
			compression = "none";
			load = <0x40080000>;
			arch = "arm64";
		};

		initrd {
			description = "Debian installer initrd";
			type = "ramdisk";
			compression = "none";
			load = <0x4fe00000>;
			arch = "arm64";
		};
	};

	configurations {
		default = "config-1";

		config-1 {
			description = "sun50i-a64-pine64-plus";
			loadables = "uboot", "atf", "kernel", "initrd";
			fdt = "fdt-1";
		};

		config-2 {
			description = "sun50i-a64-pine64";
			loadables = "uboot", "atf", "mgmt-firmware";
			fdt = "fdt-2";
		};
	};
};
```

## release/src-rt-5.04axhnd.675x/bootloaders/u-boot-2019.07/doc/uImage.FIT/update3.its
```
/*
 * Example Automatic software update file.
 */

/dts-v1/;

/ {
	description = "Automatic software updates: kernel, ramdisk, FDT";
	#address-cells = <1>;

	images {
		update-1 {
			description = "Linux kernel binary";
			data = /incbin/("./vmlinux.bin.gz");
			compression = "none";
			type = "firmware";
			load = <FF700000>;
			hash-1 {
				algo = "sha1";
			};
		};
		update-2 {
			description = "Ramdisk image";
			data = /incbin/("./ramdisk_image.gz");
			compression = "none";
			type = "firmware";
			load = <FF8E0000>;
			hash-1 {
				algo = "sha1";
			};
		};

		update-3 {
			description = "FDT blob";
			data = /incbin/("./blob.fdt");
			compression = "none";
			type = "firmware";
			load = <FFAC0000>;
			hash-1 {
				algo = "sha1";
			};
		};
	};
};
```

## release/src-rt-5.04axhnd.675x/bootloaders/u-boot-2019.07/drivers/Kconfig
```kconfig
menu "Device Drivers"

source "drivers/core/Kconfig"

# types of drivers sorted in alphabetical order

source "drivers/adc/Kconfig"

source "drivers/ata/Kconfig"

source "drivers/axi/Kconfig"

source "drivers/block/Kconfig"

source "drivers/bootcount/Kconfig"

source "drivers/cache/Kconfig"

source "drivers/clk/Kconfig"

source "drivers/cpu/Kconfig"

source "drivers/crypto/Kconfig"

source "drivers/ddr/Kconfig"

source "drivers/demo/Kconfig"

source "drivers/board/Kconfig"

source "drivers/ddr/fsl/Kconfig"

source "drivers/dfu/Kconfig"

source "drivers/dma/Kconfig"

source "drivers/fastboot/Kconfig"

source "drivers/firmware/Kconfig"

source "drivers/fpga/Kconfig"

source "drivers/gpio/Kconfig"

source "drivers/hwspinlock/Kconfig"

source "drivers/i2c/Kconfig"

source "drivers/input/Kconfig"

source "drivers/led/Kconfig"

source "drivers/mailbox/Kconfig"

source "drivers/memory/Kconfig"

source "drivers/misc/Kconfig"

source "drivers/mmc/Kconfig"

source "drivers/mtd/Kconfig"

source "drivers/net/Kconfig"

source "drivers/nvme/Kconfig"

source "drivers/pci/Kconfig"

source "drivers/pch/Kconfig"

source "drivers/pcmcia/Kconfig"

source "drivers/phy/Kconfig"

source "drivers/phy/allwinner/Kconfig"

source "drivers/phy/marvell/Kconfig"

source "drivers/pinctrl/Kconfig"

source "drivers/power/Kconfig"

source "drivers/pwm/Kconfig"

source "drivers/qe/Kconfig"

source "drivers/ram/Kconfig"

source "drivers/remoteproc/Kconfig"

source "drivers/reset/Kconfig"

source "drivers/rtc/Kconfig"

source "drivers/scsi/Kconfig"

source "drivers/serial/Kconfig"

source "drivers/smem/Kconfig"

source "drivers/sound/Kconfig"

source "drivers/soc/Kconfig"

source "drivers/spi/Kconfig"

source "drivers/spmi/Kconfig"

source "drivers/sysreset/Kconfig"

source "drivers/tee/Kconfig"

source "drivers/thermal/Kconfig"

source "drivers/timer/Kconfig"

source "drivers/tpm/Kconfig"

source "drivers/usb/Kconfig"

source "drivers/video/Kconfig"

source "drivers/virtio/Kconfig"

source "drivers/w1/Kconfig"

source "drivers/w1-eeprom/Kconfig"

source "drivers/watchdog/Kconfig"

config PHYS_TO_BUS
	bool "Custom physical to bus address mapping"
	help
	  Some SoCs use a different address map for CPU physical addresses and
	  peripheral DMA master accesses. If yours does, select this option in
	  your platform's Kconfig, and implement the appropriate mapping
	  functions in your platform's support code.

endmenu
```

## release/src-rt-5.04axhnd.675x/bootloaders/u-boot-2019.07/drivers/adc/Kconfig
```kconfig
config ADC
	bool "Enable ADC drivers using Driver Model"
	help
	  This enables ADC API for drivers, which allows driving ADC features
	  by single and multi-channel methods for:
	  - start/stop/get data for conversion of a single-channel selected by
	    a number or multi-channels selected by a bitmask
	  - get data mask (ADC resolution)
	  ADC reference Voltage supply options:
	  - methods for get Vdd/Vss reference Voltage values with polarity
	  - support supply's phandle with auto-enable
	  - supply polarity setting in fdt

config ADC_EXYNOS
	bool "Enable Exynos 54xx ADC driver"
	help
	  This enables basic driver for Exynos ADC compatible with Exynos54xx.
	  It provides:
	  - 10 analog input channels
	  - 12-bit resolution
	  - 600 KSPS of sample rate

config ADC_SANDBOX
	bool "Enable Sandbox ADC test driver"
	help
	  This enables driver for Sandbox ADC device emulation.
	  It provides:
	  - 4 analog input channels
	  - 16-bit resolution
	  - single and multi-channel conversion mode

config SARADC_MESON
	bool "Enable Amlogic Meson SARADC driver"
	imply REGMAP
	help
	  This enables driver for Amlogic Meson SARADC.
	  It provides:
	  - 8 analog input channels
	  - 1O or 12 bits resolution
	  - Up to 1MSPS of sample rate

config SARADC_ROCKCHIP
	bool "Enable Rockchip SARADC driver"
	help
	  This enables driver for Rockchip SARADC.
	  It provides:
	  - 2~6 analog input channels
	  - 1O or 12 bits resolution
	  - Up to 1MSPS of sample rate

config STM32_ADC
	bool "Enable STMicroelectronics STM32 ADC driver"
	depends on ADC && (STM32H7 || ARCH_STM32MP)
	help
	  This enables driver for STMicroelectronics STM32 analog-to-digital
	  converter (ADC).
	  A STM32 ADC block can be composed of several individual ADCs.
	  Each has its own private registers, but shares some resources:
	  - clock selection and prescaler
	  - voltage reference
	  - common registers area.
	  STM32 ADC driver is composed of:
	  - core driver to deal with common resources
	  - child driver to deal with individual ADC resources (declare ADC
	  device and associated channels, start/stop conversions)
```

## release/src-rt-5.04axhnd.675x/bootloaders/u-boot-2019.07/drivers/ata/Kconfig
```kconfig
config AHCI
	bool "Support SATA controllers with driver model"
	depends on DM
	help
	  This enables a uclass for disk controllers in U-Boot. Various driver
	  types can use this, such as AHCI/SATA. It does not provide any standard
	  operations at present. The block device interface has not been converted
	  to driver model.

config SATA
	bool "Support SATA controllers"
	select HAVE_BLOCK_DEVICE
	help
	  This enables support for SATA (Serial Advanced Technology
	  Attachment), a serial bus standard for connecting to hard drives and
	  other storage devices.

	  SATA replaces PATA (originally just ATA), which stands for Parallel AT
	  Attachment, where AT refers to an IBM AT (Advanced Technology)
	  computer released in 1984.

	  See also CMD_SATA which provides command-line support.

config LIBATA
	bool
	help
	  Select this to build and link the libata helper functions.

config SCSI_AHCI
	bool "Enable SCSI interface to SATA devices"
	select LIBATA
	help
	  Enable this to allow interfacing SATA devices via the SCSI layer.

menu "SATA/SCSI device support"

config AHCI_PCI
	bool "Support for PCI-based AHCI controller"
	depends on DM_SCSI
	help
	  Enables support for the PCI-based AHCI controller.

config SATA_CEVA
	bool "Ceva Sata controller"
	depends on AHCI
	depends on DM_SCSI
	help
	  This option enables Ceva Sata controller hard IP available on Xilinx
	  ZynqMP. Support up to 2 external devices. Complient with SATA 3.1 and
	  AHCI 1.3 specifications with hot-plug detect feature.


config DWC_AHCI
	bool "Enable Synopsys DWC AHCI driver support"
	select SCSI_AHCI
	select PHY
	depends on DM_SCSI
	help
	  Enable this driver to support Sata devices through
	  Synopsys DWC AHCI module.

config FSL_AHCI
	bool "Enable Freescale AHCI driver support"
	select SCSI_AHCI
	depends on AHCI
	depends on DM_SCSI
	help
	  Enable this driver to support Sata devices found in
	  some Freescale PowerPC SoCs.


config DWC_AHSATA
	bool "Enable DWC AHSATA driver support"
	select LIBATA
	help
	  Enable this driver to support the DWC AHSATA SATA controller found
	  in i.MX5 and i.MX6 SoCs.

config DWC_AHSATA_AHCI
	bool "Enable DWC AHSATA AHCI driver support"
	depends on DWC_AHSATA
	depends on AHCI
	default y
	help
	  Enable this option unless you need your private ahci implementation

config FSL_SATA
	bool "Enable Freescale SATA controller driver support"
	select LIBATA
	help
	  Enable this driver to support the SATA controller found in
	  some Freescale PowerPC SoCs.

config MVSATA_IDE
	bool "Enable Marvell SATA controller driver support via IDE interface"
	help
	  Enable this driver to support the SATA controller found in
	  some Marvell SoCs, running in IDE compatibility mode using PIO.

config SATA_MV
	bool "Enable Marvell SATA controller driver support"
	select AHCI
	select LIBATA
	depends on BLK
	help
	  Enable this driver to support the SATA controller found in
	  some Marvell SoCs.

config SATA_SIL
	bool "Enable Silicon Image SIL3131 / SIL3132 / SIL3124 SATA driver support"
	select LIBATA
	help
	  Enable this driver to support the SIL3131, SIL3132 and SIL3124
	  SATA controllers.

config SATA_SIL3114
	bool "Enable Silicon Image SIL3114 SATA driver support"
	select LIBATA
	help
	  Enable this driver to support the SIL3114 SATA controllers.

config SUNXI_AHCI
	bool "Enable Allwinner SATA driver support"
	depends on AHCI
	default y if ARCH_SUNXI
	help
	  Enable this driver to support the SATA controllers found in the
	  Allwinner A10, A20 and R40 SoCs.

config AHCI_MVEBU
	bool "Marvell EBU AHCI SATA support"
	depends on ARCH_MVEBU
	depends on AHCI
	select SCSI_AHCI
	select DM_SCSI
	help
	  This option enables support for the Marvell EBU SoC's
	  onboard AHCI SATA.

	  If unsure, say N.
endmenu
```

## release/src-rt-5.04axhnd.675x/bootloaders/u-boot-2019.07/drivers/board/Kconfig
```kconfig
menuconfig BOARD
	bool "Device Information"
	help
	  Support methods to query hardware configurations from internal
	  mechanisms (e.g. reading GPIO values, determining the presence of
	  devices on busses, etc.). This enables the usage of U-Boot with
	  modular board architectures.

if BOARD


config BOARD_GAZERBEAM
	bool "Enable board driver for the Gazerbeam board"
	help
	  Support querying device information for the gdsys Gazerbeam board.

config BOARD_SANDBOX
	bool "Enable board driver for the Sandbox board"
	help
	  Support querying device information for the Sandbox boards.

endif
```
