## release/src-rt-5.04axhnd.675x/bootloaders/u-boot-2019.07/drivers/bootcount/Kconfig
```kconfig
#
# Boot count configuration
#

menuconfig BOOTCOUNT_LIMIT
	bool "Enable support for checking boot count limit"
	help
	  Enable checking for exceeding the boot count limit.
	  More information: http://www.denx.de/wiki/DULG/UBootBootCountLimit

if BOOTCOUNT_LIMIT

choice
	prompt "Boot count device"
	default BOOTCOUNT_AM33XX if AM33XX || SOC_DA8XX
	default BOOTCOUNT_AT91 if AT91SAM9XE
	default BOOTCOUNT_GENERIC

config BOOTCOUNT_GENERIC
	bool "Generic default boot counter"
	help
	  Generic bootcount stored at SYS_BOOTCOUNT_ADDR.

	  SYS_BOOTCOUNT_ADDR:
	    Set to the address where the bootcount and bootcount magic
	    will be stored.

config BOOTCOUNT_EXT
	bool "Boot counter on EXT filesystem"
	help
	  Add support for maintaining boot count in a file on an EXT
	  filesystem.

config BOOTCOUNT_AM33XX
	bool "Boot counter in AM33XX RTC IP block"
	depends on AM33XX || SOC_DA8XX
	select SPL_AM33XX_ENABLE_RTC32K_OSC if AM33XX
	help
	  A bootcount driver for the RTC IP block found on many TI platforms.
	  This requires the RTC clocks, etc, to be enabled prior to use and
	  not all boards with this IP block on it will have the RTC in use.

config BOOTCOUNT_ENV
	bool "Boot counter in environment"
	help
	  If no softreset save registers are found on the hardware
	  "bootcount" is stored in the environment. To prevent a
	  saveenv on all reboots, the environment variable
	  "upgrade_available" is used. If "upgrade_available" is
	  0, "bootcount" is always 0, if "upgrade_available" is
	  1 "bootcount" is incremented in the environment.
	  So the Userspace Application must set the "upgrade_available"
	  and "bootcount" variable to 0, if a boot was successfully.

config BOOTCOUNT_RAM
	bool "Boot counter in RAM"
	help
	  Store the bootcount in DRAM protected against against bit errors
	  due to short power loss or holding a system in RESET.

config BOOTCOUNT_I2C
	bool "Boot counter on I2C device"
	help
	  Enable support for the bootcounter on an i2c (like RTC) device.
	  CONFIG_SYS_I2C_RTC_ADDR = i2c chip address
	  CONFIG_SYS_BOOTCOUNT_ADDR = i2c addr which is used for
	                              the bootcounter.

config BOOTCOUNT_AT91
	bool "Boot counter for Atmel AT91SAM9XE"
	depends on AT91SAM9XE

config DM_BOOTCOUNT
        bool "Boot counter in a device-model device"
	help
	  Enables reading/writing the bootcount in a device-model based
	  backing store.  If an entry in /chosen/u-boot,bootcount-device
	  exists, this will be the preferred bootcount device; otherwise
	  the first available bootcount device will be used.

endchoice

if DM_BOOTCOUNT

menu "Backing stores for device-model backed bootcount"
config DM_BOOTCOUNT_RTC
	bool "Support RTC devices as a backing store for bootcount"
	depends on DM_RTC
	help
	  Enabled reading/writing the bootcount in a DM RTC device.
	  The wrapper device is to be specified with the compatible string
	  'u-boot,bootcount-rtc' and the 'rtc'-property (a phandle pointing
	  to the underlying RTC device) and an optional 'offset' property
	  are supported.

	  Accesses to the backing store are performed using the write16
	  and read16 ops of DM RTC devices.

endmenu

endif

config BOOTCOUNT_BOOTLIMIT
	int "Maximum number of reboot cycles allowed"
	default 0
	help
	  Set the Maximum number of reboot cycles allowed without the boot
	  counter being cleared.
	  If set to 0 do not set a boot limit in the environment.

config BOOTCOUNT_ALEN
	int "I2C address length"
	default 1
	depends on BOOTCOUNT_I2C
	help
	  Length of the the I2C address at SYS_BOOTCOUNT_ADDR for storing
	  the boot counter.

config SYS_BOOTCOUNT_SINGLEWORD
	bool "Use single word to pack boot count and magic value"
	depends on BOOTCOUNT_GENERIC
	help
	  This option enables packing boot count magic value and boot count
	  into single word (32 bits).

config SYS_BOOTCOUNT_EXT_INTERFACE
	string "Interface on which to find boot counter EXT filesystem"
	default "mmc"
	depends on BOOTCOUNT_EXT
	help
	  Set the interface to use when locating the filesystem to use for the
	  boot counter.

config SYS_BOOTCOUNT_EXT_DEVPART
	string "Partition of the boot counter EXT filesystem"
	default "0:1"
	depends on BOOTCOUNT_EXT
	help
	  Set the partition to use when locating the filesystem to use for the
	  boot counter.

config SYS_BOOTCOUNT_EXT_NAME
	string "Path and filename of the EXT filesystem based boot counter"
	default "/boot/failures"
	depends on BOOTCOUNT_EXT
	help
	  Set the filename and path of the file used to store the boot counter.

config SYS_BOOTCOUNT_ADDR
	hex "RAM address used for reading and writing the boot counter"
	default 0x44E3E000 if BOOTCOUNT_AM33XX
	default 0xE0115FF8 if ARCH_LS1043A || ARCH_LS1021A
	depends on BOOTCOUNT_AM33XX || BOOTCOUNT_GENERIC || BOOTCOUNT_EXT || \
		   BOOTCOUNT_I2C
	help
	  Set the address used for reading and writing the boot counter.

config SYS_BOOTCOUNT_MAGIC
	hex "Magic value for the boot counter"
	default 0xB001C041
	help
	  Set the magic value used for the boot counter.

endif
```

## release/src-rt-5.04axhnd.675x/bootloaders/u-boot-2019.07/drivers/cache/Kconfig
```kconfig
#
# Cache controllers
#

menu "Cache Controller drivers"

config CACHE
	bool "Enable Driver Model for Cache controllers"
	depends on DM
	help
	  Enable driver model for cache controllers that are found on
	  most CPU's. Cache is memory that the CPU can access directly and
	  is usually located on the same chip. This uclass can be used for
	  configuring settings that be found from a device tree file.

config L2X0_CACHE
	tristate "PL310 cache driver"
	select CACHE
	depends on ARM
	help
	  This driver is for the PL310 cache controller commonly found on
	  ARMv7(32-bit) devices. The driver configures the cache settings
	  found in the device tree.

endmenu
```

## release/src-rt-5.04axhnd.675x/bootloaders/u-boot-2019.07/drivers/clk/Kconfig
```kconfig
menu "Clock"

config CLK
	bool "Enable clock driver support"
	depends on DM
	help
	  This allows drivers to be provided for clock generators, including
	  oscillators and PLLs. Devices can use a common clock API to request
	  a particular clock rate and check on available clocks. Clocks can
	  feed into other clocks in a tree structure, with multiplexers to
	  choose the source for each clock.

config SPL_CLK
	bool "Enable clock support in SPL"
	depends on CLK && SPL && SPL_DM
	help
	  The clock subsystem adds a small amount of overhead to the image.
	  If this is acceptable and you have a need to use clock drivers in
	  SPL, enable this option. It might provide a cleaner interface to
	  setting up clocks within SPL, and allows the same drivers to be
	  used as U-Boot proper.

config TPL_CLK
	bool "Enable clock support in TPL"
	depends on CLK && TPL_DM
	help
	  The clock subsystem adds a small amount of overhead to the image.
	  If this is acceptable and you have a need to use clock drivers in
	  SPL, enable this option. It might provide a cleaner interface to
	  setting up clocks within TPL, and allows the same drivers to be
	  used as U-Boot proper.

config CLK_BCM6345
	bool "Clock controller driver for BCM6345"
	depends on CLK && ARCH_BMIPS
	default y
	help
	  This clock driver adds support for enabling and disabling peripheral
	  clocks on BCM6345 SoCs. HW has no rate changing capabilities.

config CLK_BOSTON
	def_bool y if TARGET_BOSTON
	depends on CLK
	select REGMAP
	select SYSCON
	help
	  Enable this to support the clocks

config CLK_STM32F
	bool "Enable clock driver support for STM32F family"
	depends on CLK && (STM32F7 || STM32F4)
	default y
	help
	  This clock driver adds support for RCC clock management
	  for STM32F4 and STM32F7 SoCs.

config CLK_TI_SCI
	bool "TI System Control Interface (TI SCI) clock driver"
	depends on CLK && TI_SCI_PROTOCOL && OF_CONTROL
	help
	  This enables the clock driver support over TI System Control Interface
	  available on some new TI's SoCs. If you wish to use clock resources
	  managed by the TI System Controller, say Y here. Otherwise, say N.

config CLK_HSDK
	bool "Enable cgu clock driver for HSDK"
	depends on CLK
	help
	  Enable this to support the cgu clocks on Synopsys ARC HSDK

config CLK_VEXPRESS_OSC
	bool "Enable driver for Arm Versatile Express OSC clock generators"
	depends on CLK && VEXPRESS_CONFIG
	help
	  This clock driver adds support for clock generators present on
	  Arm Versatile Express platforms.

config CLK_ZYNQ
	bool "Enable clock driver support for Zynq"
	depends on CLK && ARCH_ZYNQ
	default y
	help
	  This clock driver adds support for clock realted settings for
	  Zynq platform.

config CLK_ZYNQMP
	bool "Enable clock driver support for ZynqMP"
	depends on ARCH_ZYNQMP
	help
	  This clock driver adds support for clock realted settings for
	  ZynqMP platform.

config CLK_STM32MP1
	bool "Enable RCC clock driver for STM32MP1"
	depends on ARCH_STM32MP && CLK
	default y
	help
	  Enable the STM32 clock (RCC) driver. Enable support for
	  manipulating STM32MP1's on-SoC clocks.

source "drivers/clk/at91/Kconfig"
source "drivers/clk/exynos/Kconfig"
source "drivers/clk/imx/Kconfig"
source "drivers/clk/meson/Kconfig"
source "drivers/clk/mvebu/Kconfig"
source "drivers/clk/owl/Kconfig"
source "drivers/clk/renesas/Kconfig"
source "drivers/clk/sunxi/Kconfig"
source "drivers/clk/sifive/Kconfig"
source "drivers/clk/tegra/Kconfig"
source "drivers/clk/uniphier/Kconfig"

config ICS8N3QV01
	bool "Enable ICS8N3QV01 VCXO driver"
	depends on CLK
	help
	  Support for the ICS8N3QV01 Quad-Frequency VCXO (Voltage-Controlled
	  Crystal Oscillator). The output frequency can be programmed via an
	  I2C interface.

config CLK_MPC83XX
	bool "Enable MPC83xx clock driver"
	depends on CLK
	help
	  Support for the clock driver of the MPC83xx series of SoCs.

endmenu
```

## release/src-rt-5.04axhnd.675x/bootloaders/u-boot-2019.07/drivers/clk/exynos/Kconfig
```kconfig
config CLK_EXYNOS
	bool
	select CLK
	help
	  This enables support for common clock driver API on Samsung
	  Exynos SoCs.

menu "Clock drivers for Exynos SoCs"
	depends on CLK_EXYNOS

config CLK_EXYNOS7420
	bool "Clock driver for Samsung's Exynos7420 SoC"
	default y
	help
	  This enables common clock driver support for platforms based
	  on Samsung Exynos7420 SoC.

endmenu
```

## release/src-rt-5.04axhnd.675x/bootloaders/u-boot-2019.07/drivers/clk/meson/Kconfig
```kconfig
config CLK_MESON_GX
	bool "Enable clock support for Amlogic GX"
	depends on CLK && ARCH_MESON
	default MESON_GX
	help
	  Enable clock support for the Amlogic GX SoC family, such as
	  the S905, S905X/D and S912.

config CLK_MESON_AXG
	bool "Enable clock support for Amlogic AXG"
	depends on CLK && ARCH_MESON
	default MESON_AXG
	help
	  Enable clock support for the Amlogic AXG SoC family, such as
	  the A113X/D

config CLK_MESON_G12A
	bool "Enable clock support for Amlogic G12A"
	depends on CLK && ARCH_MESON
	default MESON_G12A
	help
	  Enable clock support for the Amlogic G12A SoC family, such as
	  the S905X/D2
```

## release/src-rt-5.04axhnd.675x/bootloaders/u-boot-2019.07/drivers/clk/renesas/Kconfig
```kconfig
config CLK_RENESAS
	bool "Renesas clock drivers"
	depends on CLK && ARCH_RMOBILE
	help
	  Enable support for clock present on Renesas RCar SoCs.

config CLK_RCAR_GEN2
	bool "Renesas RCar Gen2 clock driver"
	def_bool y if RCAR_32
	depends on CLK_RENESAS
	help
	  Enable this to support the clocks on Renesas RCar Gen2 SoC.

config CLK_R8A7790
	bool "Renesas R8A7790 clock driver"
	depends on CLK_RCAR_GEN2
	help
	  Enable this to support the clocks on Renesas R8A7790 SoC.

config CLK_R8A7791
	bool "Renesas R8A7791 clock driver"
	depends on CLK_RCAR_GEN2
	help
	  Enable this to support the clocks on Renesas R8A7791 SoC.

config CLK_R8A7792
	bool "Renesas R8A7792 clock driver"
	depends on CLK_RCAR_GEN2
	help
	  Enable this to support the clocks on Renesas R8A7792 SoC.

config CLK_R8A7793
	bool "Renesas R8A7793 clock driver"
	depends on CLK_RCAR_GEN2
	help
	  Enable this to support the clocks on Renesas R8A7793 SoC.

config CLK_R8A7794
	bool "Renesas R8A7794 clock driver"
	depends on CLK_RCAR_GEN2
	help
	  Enable this to support the clocks on Renesas R8A7794 SoC.

config CLK_RCAR_GEN3
	bool "Renesas RCar Gen3 clock driver"
	def_bool y if RCAR_GEN3
	depends on CLK_RENESAS
	help
	  Enable this to support the clocks on Renesas RCar Gen3 SoC.

config CLK_R8A7795
	bool "Renesas R8A7795 clock driver"
	depends on CLK_RCAR_GEN3
	help
	  Enable this to support the clocks on Renesas R8A7795 SoC.

config CLK_R8A7796
	bool "Renesas R8A7796 clock driver"
	depends on CLK_RCAR_GEN3
	help
	  Enable this to support the clocks on Renesas R8A7796 SoC.

config CLK_R8A77965
	bool "Renesas R8A77965 clock driver"
	depends on CLK_RCAR_GEN3
	help
	  Enable this to support the clocks on Renesas R8A77965 SoC.

config CLK_R8A77970
	bool "Renesas R8A77970 clock driver"
	depends on CLK_RCAR_GEN3
	help
	  Enable this to support the clocks on Renesas R8A77970 SoC.

config CLK_R8A77990
	bool "Renesas R8A77990 clock driver"
	depends on CLK_RCAR_GEN3
	help
	  Enable this to support the clocks on Renesas R8A77990 SoC.

config CLK_R8A77995
	bool "Renesas R8A77995 clock driver"
	depends on CLK_RCAR_GEN3
	help
	  Enable this to support the clocks on Renesas R8A77995 SoC.
```

## release/src-rt-5.04axhnd.675x/bootloaders/u-boot-2019.07/drivers/clk/sifive/Kconfig
```kconfig
# SPDX-License-Identifier: GPL-2.0

config CLK_ANALOGBITS_WRPLL_CLN28HPC
	bool

config CLK_SIFIVE
	bool "SiFive SoC driver support"
	depends on CLK
	help
	  SoC drivers for SiFive Linux-capable SoCs.

config CLK_SIFIVE_FU540_PRCI
	bool "PRCI driver for SiFive FU540 SoCs"
	depends on CLK_SIFIVE
	select CLK_ANALOGBITS_WRPLL_CLN28HPC
	help
	  Supports the Power Reset Clock interface (PRCI) IP block found in
	  FU540 SoCs.  If this kernel is meant to run on a SiFive FU540 SoC,
	  enable this driver.

config CLK_SIFIVE_GEMGXL_MGMT
	bool "GEMGXL management for SiFive FU540 SoCs"
	depends on CLK_SIFIVE
	help
	  Supports the GEMGXL management IP block found in FU540 SoCs to
	  control GEM TX clock operation mode for 10/100/1000 Mbps.
```
