## release/src-rt-5.04axhnd.675x/bootloaders/u-boot-2019.07/drivers/net/bcmbca/Kconfig
```kconfig
# SPDX-License-Identifier: GPL-2.0+
#
# (C) Copyright 2019 Broadcom Ltd
#

config BCMBCA_RDP_ETH
	bool "BCMBCA RDP based network driver"
	select BCMBCA_RDP
	depends on DM_ETH && ARCH_BCMBCA
	default y if BCM63138
	default y if BCM63148
	default n
	help
	   This driver supports RDP based network driver

config BCMBCA_XRDP_ETH
	bool "BCMBCA XRDP based network driver"
	depends on DM_ETH && ARCH_BCMBCA
	default y if BCM6846
	default y if BCM6856
	default y if BCM6858
	default y if BCM6878
	default y if BCM63146
	default y if BCM4912
	default y if BCM6813
	default y if BCM6855
	default n
	help
	   This driver supports XRDP based network driver

config BCMBCA_XRDP_ETH_SWITCH_IFACE
	bool "BCMBCA XRDP network driver switch"
	depends on BCMBCA_XRDP_ETH
	default y
	help
	   Create a single ETH interface representing the whole switch

config BCMBCA_LPORT
	bool "BCMBCA LPORT driver"
	default y if BCM6858
	default n
	help
	   This driver supports lport

config BCMBCA_XRDP
	bool "BCMBCA XRDP driver"
	default y if BCM6846
	default y if BCM6856
	default y if BCM6858
	default y if BCM6878
	default y if BCM63146
	default y if BCM4912
	default y if BCM6813
	default y if BCM6855
	default n
	help
	   This driver supports xrdp

config BCMBCA_XRDP_PON
	bool "BCMBCA XRDP driver for PON platform"
	default y if BCM6846
	default y if BCM6856
	default y if BCM6858
	default y if BCM6878
        default y if BCM6855
	default n
	help
	   This driver supports xrdp for PON

config BCMBCA_XRDP_DSL
	bool "BCMBCA XRDP driver for DSL platform"
	default y if BCM63146
	default y if BCM4912
	default y if BCM6813
	default n
	help
	   This driver supports xrdp for DSL

config BCMBCA_PHY
	bool "BCMBCA PHY framework driver"
	default y if BCM6846
	default y if BCM6856
	default y if BCM6858
	default y if BCM6878
	default y if BCM63178
	default y if BCM47622
	default y if BCM63146
	default y if BCM4912
	default y if BCM6756
	default y if BCM6813
	default y if BCM6855
	default n
	help
	   This driver supports PHY framework

config BCM_SELECTIVE_PHYS
	bool "Selective PHYs"
    depends on BCMBCA_PHY
	default n

config BCM_PHY_MAKO_A0
	bool "Mako A0 support"
	depends on BCM_SELECTIVE_PHYS
	default n

config BCM_PHY_ORCA_A0
	bool "Orca A0 support"
	depends on BCM_SELECTIVE_PHYS
	default n

config BCM_PHY_ORCA_B0
	bool "Orca A0 support"
	depends on BCM_SELECTIVE_PHYS
	default n

config BCM_PHY_BLACKFIN_A0
	bool "Blackfin A0 support"
	depends on BCM_SELECTIVE_PHYS
	default n

config BCM_PHY_BLACKFIN_B0
	bool "Blackfin B0 support"
	depends on BCM_SELECTIVE_PHYS
	default n

config BCM_PHY_LONGFIN_A0
	bool "Longfin A0 support"
	depends on BCM_SELECTIVE_PHYS
	default n

config BCM_PHY_LONGFIN_B0
	bool "Longfin B0 support"
	depends on BCM_SELECTIVE_PHYS
	default n

config BCMBCA_SYSPORT_V1
	bool "BCMBCA Sysport version 1 support"
	default y if BCM63158
	default n
	help
	   This driver supports BCM System port v1.0

config BCMBCA_SYSPORT_V2
	bool "BCMBCA Sysport version 2 support"
	default y if BCM63178
	default y if BCM47622
	default y if BCM6756
	default n
	help
	   This driver supports BCM System port v2.0

config BCMBCA_SWITCH
	bool "BCMBCA Switch Driver"
	default y if BCM63138
	default y if BCM63148
	default y if BCM63158
	default y if BCM63178
	default y if BCM4908
	default y if BCM6756	
	default n
	help
	   This driver supports BCMBCA Switch

config BCMBCA_SF2_GMAC
	bool "BCMBCA External Switch Driver"
	default y if BCM4908
	default n
	help
	   This driver supports BCMBCA External Switch

config BCMBCA_EXT_SWITCH
	bool "BCMBCA External Switch Driver"
	default y if BCM47622
	default y if BCM6756
	default n
	help
	   This driver supports BCMBCA External Switch
```

## release/src-rt-5.04axhnd.675x/bootloaders/u-boot-2019.07/drivers/net/mscc_eswitch/Kconfig
```kconfig
# SPDX-License-Identifier: GPL-2.0+
#
# Copyright (c) 2019 Microsemi Corporation

config MSCC_OCELOT_SWITCH
	bool "Ocelot switch driver"
	depends on DM_ETH && ARCH_MSCC
	select PHYLIB
	help
	  This driver supports the Ocelot network switch device.

config MSCC_LUTON_SWITCH
	bool "Luton switch driver"
	depends on DM_ETH && ARCH_MSCC
	select PHYLIB
	help
	  This driver supports the Luton network switch device.

config MSCC_JR2_SWITCH
	bool "Jaguar2 switch driver"
	depends on DM_ETH && ARCH_MSCC
	select PHYLIB
	help
	  This driver supports the Jaguar2 network switch device.

config MSCC_SERVALT_SWITCH
	bool "Servalt switch driver"
	depends on DM_ETH && ARCH_MSCC
	select PHYLIB
	help
	  This driver supports the Servalt network switch device.

config MSCC_SERVAL_SWITCH
	bool "Serval switch driver"
	depends on DM_ETH && ARCH_MSCC
	select PHYLIB
	help
	  This driver supports the Serval network switch device.
```

## release/src-rt-5.04axhnd.675x/bootloaders/u-boot-2019.07/drivers/net/pfe_eth/Kconfig
```kconfig
menuconfig FSL_PFE
	bool "NXP PFE Ethernet driver"
	help
	  This driver provides support for NXP's Packet Forwarding Engine.

if FSL_PFE

config SYS_FSL_PFE_ADDR
	hex "PFE base address"
	default 0x04000000

endif
```

## release/src-rt-5.04axhnd.675x/bootloaders/u-boot-2019.07/drivers/net/ti/Kconfig
```kconfig
# SPDX-License-Identifier: GPL-2.0+
#
# Copyright (C) 2018 Texas Instruments Incorporated - http://www.ti.com/

config DRIVER_TI_CPSW
	bool "TI Common Platform Ethernet Switch"
	select PHYLIB
	help
	  This driver supports the TI three port switch gigabit ethernet
	  subsystem found in the TI SoCs.

config DRIVER_TI_EMAC
	bool "TI Davinci EMAC"
	help
	   Support for davinci emac

config DRIVER_TI_KEYSTONE_NET
	bool "TI Keystone 2 Ethernet"
	help
	   This driver supports the TI Keystone 2 Ethernet subsystem
```

## release/src-rt-5.04axhnd.675x/bootloaders/u-boot-2019.07/drivers/phy/Kconfig
```kconfig
menu "PHY Subsystem"

config PHY
	bool "PHY Core"
	depends on DM
	help
	  PHY support.

	  This framework is designed to provide a generic interface for PHY
	  devices. PHY devices are dedicated hardware that handle the physical
	  layer of the protocols in the OSI model.
	  PHYs are commonly used for high speed interfaces such as Serial-ATA
	  or PCI express.
	  The API provides functions to initialize/deinitialize the
	  PHY, power on/off the PHY, and reset the PHY. It's meant to be as
	  compatible as possible with the equivalent framework found in the
	  linux kernel.

config SPL_PHY
	bool "PHY Core in SPL"
	depends on DM
	help
	  PHY support in SPL.

	  This framework is designed to provide a generic interface for PHY
	  devices. PHY devices are dedicated hardware that handle the physical
	  layer of the protocols (https://en.wikipedia.org/wiki/OSI_model).
	  PHYs are commonly used for high speed interfaces such as Serial-ATA
	  or PCI express.
	  The API provides functions to initialize/deinitialize the
	  PHY, power on/off the PHY, and reset the PHY. It's meant to be as
	  compatible as possible with the equivalent framework found in the
	  linux kernel.

config PHY_SANDBOX
	bool "Sandbox PHY support"
	depends on SANDBOX
	depends on PHY
	help
	  This select a dummy sandbox PHY driver. It used only to implement
	  the unit tests for the phy framework

config NOP_PHY
	bool "NOP PHY driver"
	depends on PHY
	help
	  Support for a no-op PHY driver (stubbed PHY driver).

	  This is useful when a driver uses the PHY framework but no real PHY
	  hardware exists.

config SPL_NOP_PHY
	bool "NOP PHY driver in SPL"
	depends on SPL_PHY
	help
	  Support for a no-op PHY driver (stubbed PHY driver) in the SPL.

	  This is useful when a driver uses the PHY framework but no real PHY
	  hardware exists.

config BCM6318_USBH_PHY
	bool "BCM6318 USBH PHY support"
	depends on PHY && ARCH_BMIPS
	select POWER_DOMAIN
	help
	  Support for the Broadcom MIPS BCM6318 USBH PHY.

config BCM6348_USBH_PHY
	bool "BCM6348 USBH PHY support"
	depends on PHY && ARCH_BMIPS
	help
	  Support for the Broadcom MIPS BCM6348 USBH PHY.

config BCM6358_USBH_PHY
	bool "BCM6358 USBH PHY support"
	depends on PHY && ARCH_BMIPS
	help
	  Support for the Broadcom MIPS BCM6358 USBH PHY.

config BCM6368_USBH_PHY
	bool "BCM6368 USBH PHY support"
	depends on PHY && ARCH_BMIPS
	help
	  Support for the Broadcom MIPS BCM6368 USBH PHY.

config PIPE3_PHY
	bool "Support omap's PIPE3 PHY"
	depends on PHY && ARCH_OMAP2PLUS
	help
	  Support for the omap PIPE3 phy for sata

	  This PHY is found on omap devices supporting SATA such as dra7, am57x
	  and omap5

config SPL_PIPE3_PHY
	bool "Support omap's PIPE3 PHY in SPL"
	depends on SPL_PHY && ARCH_OMAP2PLUS
	help
	  Support for the omap PIPE3 phy for sata in SPL

	  This PHY is found on omap devices supporting SATA such as dra7, am57x
	  and omap5

config STI_USB_PHY
	bool "STMicroelectronics USB2 picoPHY driver for STiH407 family"
	depends on PHY && ARCH_STI
	help
	  This is the generic phy driver for the picoPHY ports
	  used by USB2 and USB3 Host controllers available on
	  STiH407 SoC families.

config PHY_RCAR_GEN2
	tristate "Renesas R-Car Gen2 USB PHY"
	depends on PHY && RCAR_GEN2
	help
	  Support for the Renesas R-Car Gen2 USB PHY. This driver operates the
	  PHY connected to USBHS module, PCI EHCI module and USB3.0 module and
	  allows configuring the module multiplexing.

config PHY_RCAR_GEN3
	tristate "Renesas R-Car Gen3 USB PHY"
	depends on PHY && RCAR_GEN3 && CLK && DM_REGULATOR
	default y if RCAR_GEN3
	help
	  Support for the Renesas R-Car Gen3 USB PHY. This driver operates the
	  PHY connected to EHCI USB module and controls USB OTG operation.

config PHY_STM32_USBPHYC
	tristate "STMicroelectronics STM32 SoC USB HS PHY driver"
	depends on PHY && ARCH_STM32MP
	help
	  Enable this to support the High-Speed USB transceiver that is part of
	  STMicroelectronics STM32 SoCs.

	  This driver controls the entire USB PHY block: the USB PHY controller
	  (USBPHYC) and the two 8-bit wide UTMI+ interface. First interface is
	  used by an HS USB Host controller, and the second one is shared
	  between an HS USB OTG controller and an HS USB Host controller,
	  selected by an USB switch.

config MESON_GXL_USB_PHY
	bool "Amlogic Meson GXL USB PHYs"
	depends on PHY && ARCH_MESON && (MESON_GXL || MESON_GXM)
	imply REGMAP
	help
	  This is the generic phy driver for the Amlogic Meson GXL
	  USB2 and USB3 PHYS.

config MESON_G12A_USB_PHY
	bool "Amlogic Meson G12A USB PHYs"
	depends on PHY && ARCH_MESON && MESON_G12A
	imply REGMAP
	help
	  This is the generic phy driver for the Amlogic Meson G12A
	  USB2 and USB3 PHYS.

config MSM8916_USB_PHY
	bool "Qualcomm MSM8916 USB PHY support"
	depends on PHY
	help
          Support the USB PHY in msm8916

	  This PHY is found on qualcomm dragonboard410c development board.

config OMAP_USB2_PHY
	bool "Support OMAP's USB2 PHY"
	depends on PHY
	depends on SYSCON
	help
	  Support for the OMAP's USB2 PHY.

	  This PHY is found on OMAP devices supporting USB2.


config KEYSTONE_USB_PHY
	bool "Support TI Keystone USB PHY"
	depends on PHY
	depends on ARCH_KEYSTONE
	help
	  Support for the USB PHY found on some Keystone (k2) processors

	  This PHY is found on some Keystone (K2) devices supporting USB.

config MT76X8_USB_PHY
	bool "MediaTek MT76x8 (7628/88) USB PHY support"
	depends on PHY
	help
          Support the USB PHY in MT76x8 SoCs

	  This PHY is found on MT76x8 devices supporting USB.

endmenu
```

## release/src-rt-5.04axhnd.675x/bootloaders/u-boot-2019.07/drivers/phy/allwinner/Kconfig
```kconfig
#
# Phy drivers for Allwinner platforms
#
config PHY_SUN4I_USB
	bool "Allwinner Sun4I USB PHY driver"
	depends on ARCH_SUNXI
	select PHY
	help
	  Enable this to support the transceiver that is part of Allwinner
	  sunxi SoCs.

	  This driver controls the entire USB PHY block, both the USB OTG
	  parts, as well as the 2 regular USB 2 host PHYs.
```
