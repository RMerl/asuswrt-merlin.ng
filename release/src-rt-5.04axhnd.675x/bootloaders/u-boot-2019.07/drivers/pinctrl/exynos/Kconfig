## release/src-rt-5.04axhnd.675x/bootloaders/u-boot-2019.07/drivers/pinctrl/exynos/Kconfig
```kconfig
config PINCTRL_EXYNOS
	bool

config PINCTRL_EXYNOS7420
	bool "Samsung Exynos7420 pinctrl driver"
	depends on ARCH_EXYNOS && PINCTRL_FULL
	select PINCTRL_EXYNOS
	help
	  Support pin multiplexing and pin configuration control on
	  Samsung's Exynos7420 SoC.
```

## release/src-rt-5.04axhnd.675x/bootloaders/u-boot-2019.07/drivers/pinctrl/mediatek/Kconfig
```kconfig
if ARCH_MEDIATEK

config PINCTRL_MTK
	depends on PINCTRL_GENERIC
	bool

config PINCTRL_MT7623
	bool "MT7623 SoC pinctrl driver"
	select PINCTRL_MTK

config PINCTRL_MT7629
	bool "MT7629 SoC pinctrl driver"
	select PINCTRL_MTK

config PINCTRL_MT8516
	bool "MT8516 SoC pinctrl driver"
	select PINCTRL_MTK

endif
```

## release/src-rt-5.04axhnd.675x/bootloaders/u-boot-2019.07/drivers/pinctrl/meson/Kconfig
```kconfig
if ARCH_MESON

config PINCTRL_MESON
	select PINCTRL_GENERIC
	select PINCONF
	bool

config PINCTRL_MESON_GX_PMX
	select PINCTRL_MESON
	bool

config PINCTRL_MESON_AXG_PMX
	select PINCTRL_MESON
	bool

config PINCTRL_MESON_GXBB
	bool "Amlogic Meson GXBB SoC pinctrl driver"
	select PINCTRL_MESON_GX_PMX

config PINCTRL_MESON_GXL
	bool "Amlogic Meson GXL SoC pinctrl driver"
	select PINCTRL_MESON_GX_PMX

config PINCTRL_MESON_AXG
	bool "Amlogic Meson AXG SoC pinctrl driver"
	select PINCTRL_MESON_AXG_PMX

config PINCTRL_MESON_G12A
	bool "Amlogic Meson G12a SoC pinctrl driver"
	select PINCTRL_MESON_AXG_PMX

endif
```

## release/src-rt-5.04axhnd.675x/bootloaders/u-boot-2019.07/drivers/pinctrl/nxp/Kconfig
```kconfig
config PINCTRL_IMX
	bool

config PINCTRL_IMX_SCU
	bool

config PINCTRL_IMX5
	bool "IMX5 pinctrl driver"
	depends on ARCH_MX5 && PINCTRL_FULL
	select DEVRES
	select PINCTRL_IMX
	help
	  Say Y here to enable the imx5 pinctrl driver

	  This provides a simple pinctrl driver for i.MX 53SoC familiy,
	  i.MX53. This feature depends on device tree
	  configuration. This driver is different from the linux one,
	  this is a simple implementation, only parses the 'fsl,pins'
	  property and configure related registers.

config PINCTRL_IMX6
	bool "IMX6 pinctrl driver"
	depends on ARCH_MX6 && PINCTRL_FULL
	select DEVRES
	select PINCTRL_IMX
	help
	  Say Y here to enable the imx6 pinctrl driver

	  This provides a simple pinctrl driver for i.MX6 SoC familiy,
	  i.MX6DQ/SL/SX/UL/DQP. This feature depends on device tree
	  configuration. This driver is different from the linux one,
	  this is a simple implementation, only parses the 'fsl,pins'
	  property and configure related registers.

config PINCTRL_IMX7
	bool "IMX7 pinctrl driver"
	depends on ARCH_MX7 && PINCTRL_FULL
	select DEVRES
	select PINCTRL_IMX
	help
	  Say Y here to enable the imx7 pinctrl driver

	  This provides a simple pinctrl driver for i.MX7 SoC familiy,
	  i.MX7D. This feature depends on device tree
	  configuration. This driver is different from the linux one,
	  this is a simple implementation, only parses the 'fsl,pins'
	  property and configure related registers.

config PINCTRL_IMX7ULP
	bool "IMX7ULP pinctrl driver"
	depends on ARCH_MX7ULP && PINCTRL_FULL
	select DEVRES
	select PINCTRL_IMX
	help
	  Say Y here to enable the imx7ulp pinctrl driver

	  This provides a simple pinctrl driver for i.MX7ULP SoC familiy.
	  This feature depends on device tree configuration. This driver
	  is different from the linux one, this is a simple implementation,
	  only parses the 'fsl,pins' property and configure related
	  registers.

config PINCTRL_IMX8
	bool "IMX8 pinctrl driver"
	depends on ARCH_IMX8 && PINCTRL_FULL
	select DEVRES
	select PINCTRL_IMX
	select PINCTRL_IMX_SCU
	help
	  Say Y here to enable the imx8 pinctrl driver

	  This provides a simple pinctrl driver for i.MX8 SoC familiy.
	  This feature depends on device tree configuration. This driver
	  is different from the linux one, this is a simple implementation,
	  only parses the 'fsl,pins' property and configures related
	  registers.

config PINCTRL_IMX8M
	bool "IMX8M pinctrl driver"
	depends on ARCH_IMX8M && PINCTRL_FULL
	select DEVRES
	select PINCTRL_IMX
	help
	  Say Y here to enable the imx8m pinctrl driver

	  This provides a simple pinctrl driver for i.MX8M SoC familiy.
	  This feature depends on device tree configuration. This driver
	  is different from the linux one, this is a simple implementation,
	  only parses the 'fsl,pins' property and configure related
	  registers.

config PINCTRL_VYBRID
	bool "Vybrid (vf610) pinctrl driver"
	depends on ARCH_VF610 && PINCTRL_FULL
	select DEVRES
	select PINCTRL_IMX
	help
	  Say Y here to enable the Vybrid (vf610) pinctrl driver

	  This provides a simple pinctrl driver for Vybrid SoC familiy,
	  vf610. This feature depends on device tree
	  configuration. This driver is different from the linux one,
	  this is a simple implementation, only parses the 'fsl,pins'
	  property and configure related registers.
```

## release/src-rt-5.04axhnd.675x/bootloaders/u-boot-2019.07/drivers/power/domain/Kconfig
```kconfig
menu "Power Domain Support"

config POWER_DOMAIN
	bool "Enable power domain support using Driver Model"
	depends on DM && OF_CONTROL
	help
	  Enable support for the power domain driver class. Many SoCs allow
	  power to be applied to or removed from portions of the SoC (power
	  domains). This may be used to save power. This API provides the
	  means to control such power management hardware.

config BCM6328_POWER_DOMAIN
	bool "Enable the BCM6328 power domain driver"
	depends on POWER_DOMAIN && ARCH_BMIPS
	help
	  Enable support for manipulating BCM6345 power domains via MMIO
	  mapped registers.

config IMX8_POWER_DOMAIN
	bool "Enable i.MX8 power domain driver"
        depends on ARCH_IMX8
        help
          Enable support for manipulating NXP i.MX8 on-SoC power domains via IPC
          requests to the SCU.

config MTK_POWER_DOMAIN
	bool "Enable the MediaTek power domain driver"
	depends on POWER_DOMAIN && ARCH_MEDIATEK
	help
	  Enable support for manipulating MediaTek power domains via MMIO
	  mapped registers.

config MESON_GX_VPU_POWER_DOMAIN
	bool "Enable Amlogic Meson GX VPU power domain driver"
	depends on POWER_DOMAIN && ARCH_MESON
	help
	  Enable support for manipulating Amlogic Meson GX Video Processing
	  Unit power domain.

config SANDBOX_POWER_DOMAIN
	bool "Enable the sandbox power domain test driver"
	depends on POWER_DOMAIN && SANDBOX
	help
	  Enable support for a test power domain driver implementation, which
	  simply accepts requests to power on/off various HW modules without
	  actually doing anything beyond a little error checking.

config TEGRA186_POWER_DOMAIN
	bool "Enable Tegra186 BPMP-based power domain driver"
	depends on TEGRA186_BPMP
	help
	  Enable support for manipulating Tegra's on-SoC power domains via IPC
	  requests to the BPMP (Boot and Power Management Processor).

config TI_SCI_POWER_DOMAIN
	bool "Enable the TI SCI-based power domain driver"
	depends on POWER_DOMAIN && TI_SCI_PROTOCOL
	help
	  Generic power domain implementation for TI devices implementing the
	  TI SCI protocol.
endmenu
```
