## release/src-rt-5.04axhnd.675x/bootloaders/u-boot-2019.07/drivers/power/regulator/Kconfig
```kconfig
config DM_REGULATOR
	bool "Enable Driver Model for REGULATOR drivers (UCLASS_REGULATOR)"
	depends on DM
	---help---
	This config enables the driver model regulator support.
	UCLASS_REGULATOR - designed to provide a common API for basic regulator's
	functions, like get/set Voltage or Current value, enable state, etc...
	Note:
	When enabling this, please read the description, found in the files:
	- 'include/power/pmic.h'
	- 'include/power/regulator.h'
	- 'drivers/power/pmic/pmic-uclass.c'
	- 'drivers/power/pmic/regulator-uclass.c'
	It's important to call the device_bind() with the proper node offset,
	when binding the regulator devices. The pmic_bind_childs() can be used
	for this purpose if PMIC I/O driver is implemented or dm_scan_fdt_dev()
	otherwise. Detailed information can be found in the header file.

config SPL_DM_REGULATOR
	bool "Enable regulators for SPL"
	depends on DM_REGULATOR
	---help---
	Regulators are seldom needed in SPL. Even if they are accessed, some
	code space can be saved by accessing the PMIC registers directly.
	Enable this option if you need regulators in SPL and can cope with
	the extra code size.

config REGULATOR_ACT8846
	bool "Enable driver for ACT8846 regulator"
	depends on DM_REGULATOR && PMIC_ACT8846
	---help---
	Enable support for the regulator functions of the ACT8846 PMIC. The
	driver implements get/set api for the various BUCKS and LDOS supported
	by the PMIC device. This driver is controlled by a device tree node
	which includes voltage limits.

config REGULATOR_AS3722
	bool "Enable driver for AS7322 regulator"
	depends on DM_REGULATOR && PMIC_AS3722
	help
	  Enable support for the regulator functions of the AS3722. The
	  driver implements enable/disable for step-down bucks and LDOs,
	  but does not yet support change voltages. Currently this must be
	  done using direct register writes to the PMIC.

config DM_REGULATOR_PFUZE100
	bool "Enable Driver Model for REGULATOR PFUZE100"
	depends on DM_REGULATOR && DM_PMIC_PFUZE100
	---help---
	This config enables implementation of driver-model regulator uclass
	features for REGULATOR PFUZE100. The driver implements get/set api for:
	value, enable and mode.

config REGULATOR_PWM
	bool "Enable driver for PWM regulators"
	depends on DM_REGULATOR
	---help---
	Enable support for the PWM regulator functions which voltage are
	controlled by PWM duty ratio. Some of Rockchip board using this kind
	of regulator. The driver implements get/set api for the various BUCKS.
	This driver is controlled by a device tree node
	which includes voltage limits.

config SPL_REGULATOR_PWM
	bool "Enable Driver for PWM regulators in SPL"
	depends on REGULATOR_PWM
	help
	  This config enables implementation of driver-model regulator uclass
	  features for PWM regulators in SPL.

config DM_REGULATOR_MAX77686
	bool "Enable Driver Model for REGULATOR MAX77686"
	depends on DM_REGULATOR && DM_PMIC_MAX77686
	---help---
	This config enables implementation of driver-model regulator uclass
	features for REGULATOR MAX77686. The driver implements get/set api for:
	value, enable and mode.

config DM_REGULATOR_FAN53555
	bool "Enable Driver Model for REGULATOR FAN53555"
	depends on DM_PMIC_FAN53555
	help
	  This config enables implementation of driver-model regulator
	  uclass features for the FAN53555 regulator. The FAN53555 is
	  a (family of) single-output regulators that supports
	  transitioning between two different output voltages based on
	  an voltage selection pin.

	  The driver implements a get/set api for the voltage of the
	  'normal mode' voltage only. Switching to 'suspend mode'
	  (i.e. the alternate voltage), disabling output via software,
	  or switching the mode is not supported by this driver (at
	  this time).

config DM_REGULATOR_FIXED
	bool "Enable Driver Model for REGULATOR Fixed value"
	depends on DM_REGULATOR
	---help---
	This config enables implementation of driver-model regulator uclass
	features for fixed value regulators. The driver implements get/set api
	for enable and get only for voltage value.

config SPL_DM_REGULATOR_FIXED
	bool "Enable Driver Model for REGULATOR Fixed value in SPL"
	depends on DM_REGULATOR_FIXED
	---help---
	This config enables implementation of driver-model regulator uclass
	features for fixed value regulators in SPL.

config DM_REGULATOR_GPIO
	bool "Enable Driver Model for GPIO REGULATOR"
	depends on DM_REGULATOR && DM_GPIO
	---help---
	This config enables implementation of driver-model regulator uclass
	features for gpio regulators. The driver implements get/set for
	voltage value.

config SPL_DM_REGULATOR_GPIO
	bool "Enable Driver Model for GPIO REGULATOR in SPL"
	depends on DM_REGULATOR_GPIO && SPL_GPIO_SUPPORT
	---help---
	This config enables implementation of driver-model regulator uclass
	features for gpio regulators in SPL.

config REGULATOR_RK8XX
	bool "Enable driver for RK8XX regulators"
	depends on DM_REGULATOR && PMIC_RK8XX
	---help---
	Enable support for the regulator functions of the RK8XX PMIC. The
	driver implements get/set api for the various BUCKS and LDOs supported
	by the PMIC device. This driver is controlled by a device tree node
	which includes voltage limits.

config DM_REGULATOR_S2MPS11
	bool "Enable driver for S2MPS11 regulator"
	depends on DM_REGULATOR && PMIC_S2MPS11
	---help---
	This enables implementation of driver-model regulator uclass
	features for REGULATOR S2MPS11.
	The driver implements get/set api for: value and enable.

config REGULATOR_S5M8767
	bool "Enable support for S5M8767 regulator"
	depends on DM_REGULATOR && PMIC_S5M8767
	---help---
	This enables the regulator features of the S5M8767, allowing voltages
	to be set, etc. The driver is not fully complete but supports most
	common requirements, including all LDOs and BUCKs. This allows many
	supplies to be set automatically using the device tree values.

config DM_REGULATOR_SANDBOX
	bool "Enable Driver Model for Sandbox PMIC regulator"
	depends on DM_REGULATOR && DM_PMIC_SANDBOX
	---help---
	Enable the regulator driver for emulated Sandbox PMIC.
	The emulated PMIC device depends on two drivers:
	- sandbox PMIC I/O driver - implements dm pmic operations
	- sandbox PMIC regulator driver - implements dm regulator operations
	- sandbox PMIC i2c emul driver - emulates the PMIC's I2C transmission

	The regulator driver provides uclass operations for sandbox PMIC's
	regulators. The driver implements get/set api for: voltage, current,
	operation mode and enable state.
	The driver supports LDO and BUCK regulators.

	The Sandbox PMIC info:
	* I/O interface:
	  - I2C chip address:       0x40
	  - first register address: 0x0
	  - register count:         0x10
	* Adjustable outputs:
	  - 2x LDO
	  - 2x BUCK
	  - Each, with a different operating conditions (header).
	* Reset values:
	  - set by i2c emul driver's probe() (defaults in header)

	A detailed information can be found in header: '<power/sandbox_pmic.h>'
	Binding info: 'doc/device-tree-bindings/pmic/max77686.txt'

config REGULATOR_TPS65090
	bool "Enable driver for TPS65090 PMIC regulators"
	depends on PMIC_TPS65090
	---help---
	The TPS65090 provides several FETs (Field-effect Transistors,
	effectively switches) which are supported by this driver as
	regulators, one for each FET. The standard regulator interface is
	supported, but it is only possible to turn the regulators on or off.
	There is no voltage/current control.

config DM_REGULATOR_PALMAS
	bool "Enable driver for PALMAS PMIC regulators"
       depends on PMIC_PALMAS
	---help---
	This enables implementation of driver-model regulator uclass
	features for REGULATOR PALMAS and the family of PALMAS PMICs.
	The driver implements get/set api for: value and enable.

config DM_REGULATOR_PBIAS
	bool "Enable driver for PBIAS regulator"
	depends on DM_REGULATOR
	select REGMAP
	select SYSCON
	---help---
	This enables implementation of driver-model regulator uclass
	features for pseudo-regulator PBIAS found in the OMAP SOCs.
	This pseudo-regulator is used to provide a BIAS voltage to MMC1
	signal pads and must be configured properly during a voltage switch.
	Voltage switching is required by some operating modes of SDcards and
	eMMC.

config DM_REGULATOR_LP873X
	bool "Enable driver for LP873X PMIC regulators"
        depends on PMIC_LP873X
	---help---
	This enables implementation of driver-model regulator uclass
	features for REGULATOR LP873X and the family of LP873X PMICs.
	The driver implements get/set api for: value and enable.

config DM_REGULATOR_LP87565
	bool "Enable driver for LP87565 PMIC regulators"
        depends on PMIC_LP87565
	---help---
	This enables implementation of driver-model regulator uclass
	features for REGULATOR LP87565 and the family of LP87565 PMICs.
	LP87565 series of PMICs have 4 single phase BUCKs that can also
	be configured in multi phase modes. The driver implements
	get/set api for value and enable.

config DM_REGULATOR_STM32_VREFBUF
	bool "Enable driver for STMicroelectronics STM32 VREFBUF"
	depends on DM_REGULATOR && (STM32H7 || ARCH_STM32MP)
	help
	This driver supports STMicroelectronics STM32 VREFBUF (voltage
	reference buffer) which can be used as voltage reference for
	internal ADCs, DACs and also for external components through
	dedicated Vref+ pin.

config DM_REGULATOR_TPS65910
	bool "Enable driver for TPS65910 PMIC regulators"
	depends on DM_PMIC_TPS65910
	---help---
	The TPS65910 PMIC provides 4 SMPSs and 8 LDOs. This driver supports all
	regulator types of the TPS65910 (BUCK, BOOST and LDO). It implements
	the get/set api for value and enable.

config DM_REGULATOR_STPMIC1
	bool "Enable driver for STPMIC1 regulators"
	depends on DM_REGULATOR && PMIC_STPMIC1
	---help---
	Enable support for the regulator functions of the STPMIC1 PMIC. The
	driver implements get/set api for the various BUCKS and LDOs supported
	by the PMIC device. This driver is controlled by a device tree node
	which includes voltage limits.

config SPL_DM_REGULATOR_STPMIC1
	bool "Enable driver for STPMIC1 regulators in SPL"
	depends on SPL_DM_REGULATOR && PMIC_STPMIC1
	help
	  Enable support for the regulator functions of the STPMIC1 PMIC in SPL.
```

## release/src-rt-5.04axhnd.675x/bootloaders/u-boot-2019.07/drivers/pwm/Kconfig
```kconfig
config DM_PWM
	bool "Enable support for pulse-width modulation devices (PWM)"
	depends on DM
	help
	  A pulse-width modulator emits a pulse of varying width and provides
	  control over the duty cycle (high and low time) of the signal. This
	  is often used to control a voltage level. The more time the PWM
	  spends in the 'high' state, the higher the voltage. The PWM's
	  frequency/period can be controlled along with the proportion of that
	  time that the signal is high.

config PWM_EXYNOS
	bool "Enable support for the Exynos PWM"
	depends on DM_PWM
	help
	  This PWM is found on Samsung Exynos 5250 and other Samsung SoCs. It
	  supports a programmable period and duty cycle. A 32-bit counter is
	  used. It provides 5 channels which can be independently
	  programmed. Channel 4 (the last) is normally used as a timer.

config PWM_ROCKCHIP
	bool "Enable support for the Rockchip PWM"
	depends on DM_PWM
	help
	  This PWM is found on RK3288 and other Rockchip SoCs. It supports a
	  programmable period and duty cycle. A 32-bit counter is used.
	  Various options provided in the hardware (such as capture mode and
	  continuous/single-shot) are not supported by the driver.

config PWM_SANDBOX
	bool "Enable support for the sandbox PWM"
	help
	  This is a sandbox PWM used for testing. It provides 3 channels and
	  records the settings passed into it, but otherwise does nothing
	  useful. The PWM can be enabled but is not connected to any outputs
	  so this is not very useful.

config PWM_TEGRA
	bool "Enable support for the Tegra PWM"
	depends on DM_PWM
	help
	  This PWM is found on Tegra 20 and other Nvidia SoCs. It supports
	  four channels with a programmable period and duty cycle. Only a
	  32KHz clock is supported by the driver but the duty cycle is
	  configurable.

config PWM_SUNXI
	bool "Enable support for the Allwinner Sunxi PWM"
	depends on DM_PWM
	help
	  This PWM is found on H3, A64 and other Allwinner SoCs. It supports a
	  programmable period and duty cycle. A 16-bit counter is used.
```

## release/src-rt-5.04axhnd.675x/bootloaders/u-boot-2019.07/drivers/qe/Kconfig
```kconfig
#
# QUICC Engine Drivers
#
config QE
	bool "Enable support for QUICC Engine"
	depends on PPC
	default y if ARCH_T1040 || ARCH_T1042 || ARCH_T1024 || ARCH_P1021 \
		|| ARCH_P1025
	help
	  Chose this option to add support for the QUICC Engine.

config U_QE
	bool "Enable support for U QUICC Engine"
	default y if (ARCH_LS1021A && !SD_BOOT && !NAND_BOOT && !QSPI_BOOT) \
		|| (TARGET_T1024QDS) \
		|| (TARGET_T1024RDB) \
		|| (TARGET_T1040QDS && !NOBQFMAN) \
		|| (TARGET_LS1043ARDB && !SPL_NO_QE && !NAND_BOOT && !QSPI_BOOT)
	help
	  Choose this option to add support for U QUICC Engine.

choice
	prompt "QUICC Engine FMan ethernet firmware location"
	depends on FMAN_ENET || QE
	default SYS_QE_FMAN_FW_IN_ROM

config SYS_QE_FMAN_FW_IN_NOR
	bool "NOR flash"

config SYS_QE_FMAN_FW_IN_NAND
	bool "NAND flash"

config SYS_QE_FMAN_FW_IN_SPIFLASH
	bool "SPI flash"

config SYS_QE_FMAN_FW_IN_MMC
	bool "MMC"

config SYS_QE_FMAN_FW_IN_REMOTE
	bool "Remote memory location (PCI)"

config SYS_QE_FMAN_FW_IN_ROM
	bool "Firmware is already in ROM"

endchoice
```

## release/src-rt-5.04axhnd.675x/bootloaders/u-boot-2019.07/drivers/ram/Kconfig
```kconfig
config RAM
	bool "Enable RAM drivers using Driver Model"
	depends on DM
	help
	  This allows drivers to be provided for SDRAM and other RAM
	  controllers and their type to be specified in the board's device
	  tree. Generally some parameters are required to set up the RAM and
	  the RAM size can either be statically defined or dynamically
	  detected.

config SPL_RAM
	bool "Enable RAM support in SPL"
	depends on RAM && SPL_DM
	help
	  The RAM subsystem adds a small amount of overhead to the image.
	  If this is acceptable and you have a need to use RAM drivers in
	  SPL, enable this option. It might provide a cleaner interface to
	  setting up RAM (e.g. SDRAM / DDR) within SPL.

config TPL_RAM
	bool "Enable RAM support in TPL"
	depends on RAM && TPL_DM
	help
	  The RAM subsystem adds a small amount of overhead to the image.
	  If this is acceptable and you have a need to use RAM drivers in
	  TPL, enable this option. It might provide a cleaner interface to
	  setting up RAM (e.g. SDRAM / DDR) within TPL.

config STM32_SDRAM
	bool "Enable STM32 SDRAM support"
	depends on RAM
	help
	  STM32F7 family devices support flexible memory controller(FMC) to
	  support external memories like sdram, psram & nand.
	  This driver is for the sdram memory interface with the FMC.

config MPC83XX_SDRAM
	bool "Enable MPC83XX SDRAM support"
	depends on RAM
	help
	  Enable support for the internal DDR Memory Controller of the MPC83xx
	  family of SoCs. Both static configurations, as well as configuring
	  the RAM through the use of SPD (Serial Presence Detect) is supported
	  via device tree settings.

config K3_AM654_DDRSS
	bool "Enable AM654 DDRSS support"
	depends on RAM && SOC_K3_AM6
	help
	  K3 based AM654 devices has DDR memory subsystem that comprises
	  Synopys DDR controller, Synopsis DDR phy and wrapper logic to
	  intergrate these blocks into the device. This DDR subsystem
	  provides an interface to external SDRAM devices. Enabling this
	  config add support for the initialization of the external
	  SDRAM devices connected to DDR subsystem.

source "drivers/ram/stm32mp1/Kconfig"
```
