## release/src-rt-5.04axhnd.675x/bootloaders/u-boot-2019.07/drivers/thermal/Kconfig
```kconfig
config DM_THERMAL
	bool "Driver support for thermal devices"
	help
	  Enable support for temperature-sensing devices. Some SoCs have on-chip
	  temperature sensors to permit warnings, speed throttling or even
	  automatic power-off when the temperature gets too high or low. Other
	  devices may be discrete but connected on a suitable bus.

if DM_THERMAL

config IMX_THERMAL
	bool "Temperature sensor driver for Freescale i.MX SoCs"
	depends on MX6 || MX7
	help
	  Support for Temperature Monitor (TEMPMON) found on Freescale i.MX SoCs.
          It supports one critical trip point and one passive trip point.  The
          cpufreq is used as the cooling device to throttle CPUs when the
          passive trip is crossed.

config TI_DRA7_THERMAL
        bool "Temperature sensor driver for TI dra7xx SOCs"
        help
	 Enable thermal support for for the Texas Instruments DRA752 SoC family.
	 The driver supports reading CPU temperature.

endif # if DM_THERMAL
```

## release/src-rt-5.04axhnd.675x/bootloaders/u-boot-2019.07/drivers/timer/Kconfig
```kconfig
menu "Timer Support"

config TIMER
	bool "Enable driver model for timer drivers"
	depends on DM
	help
	  Enable driver model for timer access. It uses the same API as
	  lib/time.c, but now implemented by the uclass. The first timer
	  will be used. The timer is usually a 32 bits free-running up
	  counter. There may be no real tick, and no timer interrupt.

config SPL_TIMER
	bool "Enable driver model for timer drivers in SPL"
	depends on TIMER && SPL
	help
	  Enable support for timer drivers in SPL. These can be used to get
	  a timer value when in SPL, or perhaps for implementing a delay
	  function. This enables the drivers in drivers/timer as part of an
	  SPL build.

config TPL_TIMER
	bool "Enable driver model for timer drivers in TPL"
	depends on TIMER && TPL
	help
	  Enable support for timer drivers in TPL. These can be used to get
	  a timer value when in TPL, or perhaps for implementing a delay
	  function. This enables the drivers in drivers/timer as part of an
	  TPL build.

config TIMER_EARLY
	bool "Allow timer to be used early in U-Boot"
	depends on TIMER
	# initr_bootstage() requires a timer and is called before initr_dm()
	# so only the early timer is available
	default y if X86 && BOOTSTAGE
	help
	  In some cases the timer must be accessible before driver model is
	  active. Examples include when using CONFIG_TRACE to trace U-Boot's
	  execution before driver model is set up. Enable this option to
	  use an early timer. These functions must be supported by your timer
	  driver: timer_early_get_count() and timer_early_get_rate().

config AG101P_TIMER
	bool "AG101P timer support"
	depends on TIMER && NDS32
	help
	  Select this to enable a timer for AG01P devices.

config ALTERA_TIMER
	bool "Altera timer support"
	depends on TIMER
	help
	  Select this to enable a timer for Altera devices. Please find
	  details on the "Embedded Peripherals IP User Guide" of Altera.

config ARC_TIMER
	bool "ARC timer support"
	depends on TIMER && ARC && CLK
	help
	  Select this to enable built-in ARC timers.
	  ARC cores may have up to 2 built-in timers: timer0 and timer1,
	  usually at least one of them exists. Either of them is supported
	  in U-Boot.

config AST_TIMER
	bool "Aspeed ast2400/ast2500 timer support"
	depends on TIMER
	default y if ARCH_ASPEED
	help
	  Select this to enable timer for Aspeed ast2400/ast2500 devices.
	  This is a simple sys timer driver, it is compatible with lib/time.c,
	  but does not support any interrupts. Even though SoC has 8 hardware
	  counters, they are all treated as a single device by this driver.
	  This is mostly because they all share several registers which
	  makes it difficult to completely separate them.

config ATCPIT100_TIMER
	bool "ATCPIT100 timer support"
	depends on TIMER
	help
	  Select this to enable a ATCPIT100 timer which will be embedded
	  in AE3XX, AE250 boards.

config ATMEL_PIT_TIMER
	bool "Atmel periodic interval timer support"
	depends on TIMER
	help
	  Select this to enable a periodic interval timer for Atmel devices,
	  it is designed to offer maximum accuracy and efficient management,
	  even for systems with long response time.

config CADENCE_TTC_TIMER
	bool "Cadence TTC (Triple Timer Counter)"
	depends on TIMER
	help
	  Enables support for the cadence ttc driver. This driver is present
	  on Xilinx Zynq and ZynqMP SoCs.

config DESIGNWARE_APB_TIMER
	bool "Designware APB Timer"
	depends on TIMER
	help
	  Enables support for the Designware APB Timer driver. This timer is
	  present on Altera SoCFPGA SoCs.

config MPC83XX_TIMER
	bool "MPC83xx timer support"
	depends on TIMER
	help
	  Select this to enable support for the timer found on
	  devices based on the MPC83xx family of SoCs.

config RENESAS_OSTM_TIMER
	bool "Renesas RZ/A1 R7S72100 OSTM Timer"
	depends on TIMER
	help
	  Enables support for the Renesas OSTM Timer driver.
	  This timer is present on Renesas RZ/A1 R7S72100 SoCs.

config X86_TSC_TIMER_EARLY_FREQ
	int "x86 TSC timer frequency in MHz when used as the early timer"
	depends on X86_TSC_TIMER
	default 1000
	help
	  Sets the estimated CPU frequency in MHz when TSC is used as the
	  early timer and the frequency can neither be calibrated via some
	  hardware ways, nor got from device tree at the time when device
	  tree is not available yet.

config OMAP_TIMER
	bool "Omap timer support"
	depends on TIMER
	help
	  Select this to enable an timer for Omap devices.

config RISCV_TIMER
	bool "RISC-V timer support"
	depends on TIMER && RISCV
	help
	  Select this to enable support for the timer as defined
	  by the RISC-V privileged architecture spec.

config ROCKCHIP_TIMER
	bool "Rockchip timer support"
	depends on TIMER
	help
	  Select this to enable support for the timer found on
	  Rockchip devices.

config SANDBOX_TIMER
	bool "Sandbox timer support"
	depends on SANDBOX && TIMER
	help
	  Select this to enable an emulated timer for sandbox. It gets
	  time from host os.

config STI_TIMER
	bool "STi timer support"
	depends on TIMER
	default y if ARCH_STI
	help
	  Select this to enable a timer for STi devices.

config STM32_TIMER
	bool "STM32 timer support"
	depends on TIMER
	help
	  Select this to enable support for the timer found on
	  STM32 devices.

config X86_TSC_TIMER
	bool "x86 Time-Stamp Counter (TSC) timer support"
	depends on TIMER && X86
	help
	  Select this to enable Time-Stamp Counter (TSC) timer for x86.

config MTK_TIMER
	bool "MediaTek timer support"
	depends on TIMER
	help
	  Select this to enable support for the timer found on
	  MediaTek devices.

config BCM6XXX_TIMER
	bool "Broadcom 6XXX SoC timer support"
	depends on TIMER
	help
	  Select this to enable peripheral timer support for Broadcom
	  6XXX SoC devices

endmenu
```

## release/src-rt-5.04axhnd.675x/bootloaders/u-boot-2019.07/drivers/tpm/Kconfig
```kconfig
#
# TPM subsystem configuration
#

menu "TPM support"

config TPM_V1
	bool "TPMv1.x support"
	depends on TPM
	default y
	help
	  Major TPM versions are not compatible at all, choose either
	  one or the other. This option enables TPMv1.x drivers/commands.

if TPM_V1

config TPM_TIS_SANDBOX
	bool "Enable sandbox TPM driver"
	depends on TPM_V1 && SANDBOX
	default y
	help
	  This driver emulates a TPMv1.x, providing access to base functions
	  such as reading and writing TPM private data. This is enough to
	  support Chrome OS verified boot. Extend functionality is not
	  implemented.

config TPM_ATMEL_TWI
	bool "Enable Atmel TWI TPM device driver"
	depends on TPM_V1
	help
	  This driver supports an Atmel TPM device connected on the I2C bus.
	  The usual tpm operations and the 'tpm' command can be used to talk
	  to the device using the standard TPM Interface Specification (TIS)
	  protocol

config TPM_TIS_INFINEON
	bool "Enable support for Infineon SLB9635/45 TPMs on I2C"
	depends on TPM_V1 && DM_I2C
	help
	  This driver supports Infineon TPM devices connected on the I2C bus.
	  The usual tpm operations and the 'tpm' command can be used to talk
	  to the device using the standard TPM Interface Specification (TIS)
	  protocol

config TPM_TIS_I2C_BURST_LIMITATION
	bool "Enable I2C burst length limitation"
	depends on TPM_TIS_INFINEON
	help
	  Some broken TPMs have a limitation on the number of bytes they can
	  receive in one message. Enable this option to allow you to set this
	  option. The can allow a broken TPM to be used by splitting messages
	  into separate pieces.

config TPM_TIS_I2C_BURST_LIMITATION_LEN
	int "Length"
	depends on TPM_TIS_I2C_BURST_LIMITATION
	help
	  Use this to set the burst limitation length

config TPM_TIS_LPC
	bool "Enable support for Infineon SLB9635/45 TPMs on LPC"
	depends on TPM_V1 && X86
	help
	  This driver supports Infineon TPM devices connected on the LPC bus.
	  The usual tpm operations and the 'tpm' command can be used to talk
	  to the device using the standard TPM Interface Specification (TIS)
	  protocol

config TPM_AUTH_SESSIONS
	bool "Enable TPM authentication session support"
	depends on TPM_V1
	help
	  Enable support for authorised (AUTH1) commands as specified in the
	  TCG Main Specification 1.2. OIAP-authorised versions of the commands
	  TPM_LoadKey2 and TPM_GetPubKey are provided. Both features are
	  available using the 'tpm' command, too.

config TPM_ST33ZP24_I2C
	bool "STMicroelectronics ST33ZP24 I2C TPM"
	depends on TPM_V1 && DM_I2C
	---help---
	  This driver supports STMicroelectronics TPM devices connected on the I2C bus.
	  The usual tpm operations and the 'tpm' command can be used to talk
	  to the device using the standard TPM Interface Specification (TIS)
	  protocol

config TPM_ST33ZP24_SPI
	bool "STMicroelectronics ST33ZP24 SPI TPM"
	depends on TPM_V1 && DM_SPI
	---help---
	  This driver supports STMicroelectronics TPM devices connected on the SPI bus.
	  The usual tpm operations and the 'tpm' command can be used to talk
	  to the device using the standard TPM Interface Specification (TIS)
	  protocol

config TPM_FLUSH_RESOURCES
	bool "Enable TPM resource flushing support"
	depends on TPM_V1
	help
	  Enable support to flush specific resources (e.g. keys) from the TPM.
	  The functionality is available via the 'tpm' command as well.

config TPM_LOAD_KEY_BY_SHA1
	bool "Enable TPM key loading by SHA1 support"
	depends on TPM_V1
	help
	  Enable support to load keys into the TPM by identifying
	  their parent via the public key's SHA1 hash.
	  The functionality is available via the 'tpm' command as well.

config TPM_LIST_RESOURCES
	bool "Enable TPM resource listing support"
	depends on TPM_V1
	help
	  Enable support to list specific resources (e.g. keys) within the TPM.
	  The functionality is available via the 'tpm' command as well.

endif # TPM_V1

config TPM_V2
	bool "TPMv2.x support"
	depends on TPM
	default y
	help
	  Major TPM versions are not compatible at all, choose either
	  one or the other. This option enables TPMv2.x drivers/commands.

if TPM_V2

config TPM2_TIS_SANDBOX
	bool "Enable sandbox TPMv2.x driver"
	depends on TPM_V2 && SANDBOX
	default y
	help
	  This driver emulates a TPMv2.x, providing access to base functions
	  such as basic configuration, PCR extension and PCR read. Extended
	  functionalities are not implemented.

config TPM2_TIS_SPI
	bool "Enable support for TPMv2.x SPI chips"
	depends on TPM_V2 && DM_SPI
	help
	  This driver supports TPMv2.x devices connected on the SPI bus.
	  The usual TPM operations and the 'tpm' command can be used to talk
	  to the device using the standard TPM Interface Specification (TIS)
	  protocol.

endif # TPM_V2

endmenu
```

## release/src-rt-5.04axhnd.675x/bootloaders/u-boot-2019.07/drivers/usb/Kconfig
```kconfig
menuconfig USB
	bool "USB support"
	---help---
	  Universal Serial Bus (USB) is a specification for a serial bus
	  subsystem which offers higher speeds and more features than the
	  traditional PC serial port.  The bus supplies power to peripherals
	  and allows for hot swapping.  Up to 127 USB peripherals can be
	  connected to a single USB host in a tree structure.

	  The USB host is the root of the tree, the peripherals are the
	  leaves and the inner nodes are special USB devices called hubs.
	  Most PCs now have USB host ports, used to connect peripherals
	  such as scanners, keyboards, mice, modems, cameras, disks,
	  flash memory, network links, and printers to the PC.

	  Say Y here if your device has an USB port, either host, peripheral or
	  dual-role.

	  For an USB host port, you then need to say Y to at least one of the
	  Host Controller Driver (HCD) options below.  Choose a USB 1.1
	  controller, such as "UHCI HCD support" or "OHCI HCD support",
	  and "EHCI HCD (USB 2.0) support" except for older systems that
	  do not have USB 2.0 support.  It doesn't normally hurt to select
	  them all if you are not certain.

	  If your system has a device-side USB port, used in the peripheral
	  side of the USB protocol, see the "USB Gadget" framework instead.

	  After choosing your HCD, then select drivers for the USB peripherals
	  you'll be using.  You may want to check out the information provided
	  in <file:Documentation/usb/> and especially the links given in
	  <file:Documentation/usb/usb-help.txt>.

if USB

config DM_USB
	bool "Enable driver model for USB"
	depends on USB && DM
	help
	  Enable driver model for USB. The USB interface is then implemented
	  by the USB uclass. Multiple USB controllers of different types
	  (XHCI, EHCI) can be attached and used. The 'usb' command works as
	  normal. OCHI is not supported at present.

	  Much of the code is shared but with this option enabled the USB
	  uclass takes care of device enumeration. USB devices can be
	  declared with the U_BOOT_USB_DEVICE() macro and will be
	  automatically probed when found on the bus.

config SPL_DM_USB
	bool "Enable driver model for USB in SPL"
	depends on SPL_DM && DM_USB
	default y

config DM_USB_GADGET
	bool "Enable driver model for USB Gadget"
	depends on DM_USB
	help
	  Enable driver model for USB Gadget (Peripheral
	  mode)

config SPL_DM_USB_GADGET
	bool "Enable driver model for USB Gadget in sPL"
	depends on SPL_DM_USB
	help
	  Enable driver model for USB Gadget in SPL
	  (Peripheral mode)

source "drivers/usb/host/Kconfig"

source "drivers/usb/dwc3/Kconfig"

source "drivers/usb/musb/Kconfig"

source "drivers/usb/musb-new/Kconfig"

source "drivers/usb/emul/Kconfig"

source "drivers/usb/phy/Kconfig"

source "drivers/usb/ulpi/Kconfig"

comment "USB peripherals"

config USB_STORAGE
	bool "USB Mass Storage support"
	depends on !(BLK && !DM_USB)
	---help---
	  Say Y here if you want to connect USB mass storage devices to your
	  board's USB port.

config USB_KEYBOARD
	bool "USB Keyboard support"
	select SYS_STDIO_DEREGISTER
	---help---
	  Say Y here if you want to use a USB keyboard for U-Boot command line
	  input.

if USB_KEYBOARD

choice
	prompt "USB keyboard polling"
	default SYS_USB_EVENT_POLL
	---help---
	  Enable a polling mechanism for USB keyboard.

	config SYS_USB_EVENT_POLL
		bool "Interrupt polling"

	config SYS_USB_EVENT_POLL_VIA_INT_QUEUE
		bool "Poll via interrupt queue"

	config SYS_USB_EVENT_POLL_VIA_CONTROL_EP
		bool "Poll via control EP"

endchoice

endif

source "drivers/usb/gadget/Kconfig"

source "drivers/usb/eth/Kconfig"

endif
```
