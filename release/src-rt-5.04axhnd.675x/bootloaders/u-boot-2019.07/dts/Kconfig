## release/src-rt-5.04axhnd.675x/bootloaders/u-boot-2019.07/lib/optee/Kconfig
```kconfig
config OPTEE
	bool "Support OPTEE images"
	help
	  U-Boot can be configured to boot OPTEE images.
	  Selecting this option will enable shared OPTEE library code and
          enable an OPTEE specific bootm command that will perform additional
          OPTEE specific checks before booting an OPTEE image created with
          mkimage.

config OPTEE_LOAD_ADDR
	hex "OPTEE load address"
	default 0x00000000
	depends on OPTEE
	help
	  The load address of the bootable OPTEE binary.

config OPTEE_TZDRAM_SIZE
	hex "Amount of Trust-Zone RAM for the OPTEE image"
	default 0x0000000
	help
	  The size of pre-allocated Trust Zone DRAM to allocate for the OPTEE
	  runtime.

config OPTEE_TZDRAM_BASE
	hex "Base address of Trust-Zone RAM for the OPTEE image"
	default 0x00000000
	help
	  The base address of pre-allocated Trust Zone DRAM for
	  the OPTEE runtime.

config BOOTM_OPTEE
	bool "Support OPTEE bootm command"
	select BOOTM_LINUX
	depends on OPTEE
	default n
	help
	  Select this command to enable chain-loading of a Linux kernel
	  via an OPTEE firmware.
	  The bootflow is BootROM -> u-boot -> OPTEE -> Linux in this case.
```

## release/src-rt-5.04axhnd.675x/bootloaders/u-boot-2019.07/test/env/Kconfig
```kconfig
config UT_ENV
	bool "Enable env unit tests"
	depends on UNIT_TEST
	default y
	help
	  This enables the 'ut env' command which runs a series of unit
	  tests on the env code.
	  If all is well then all tests pass although there will be a few
	  messages printed along the way.
```

## release/src-rt-5.04axhnd.675x/bootloaders/u-boot-2019.07/test/overlay/Kconfig
```kconfig
config UT_OVERLAY
	bool "Enable Device Tree Overlays Unit Tests"
	depends on UNIT_TEST && OF_CONTROL
	default y
	select OF_LIBFDT_OVERLAY
	help
	  This enables the 'ut overlay' command which runs a series of unit
	  tests on the fdt overlay code.
	  If all is well then all tests pass although there will be a few
	  messages printed along the way.
```

## release/src-rt-5.04axhnd.675x/kernel/linux-4.19/net/netfilter/deDupTx/Kconfig
```kconfig
config NETFILTER_ROUTER_BOOST
        tristate  'support Router Boost'
		depends on NET && INET && NETFILTER
        help
          support ASUS OPPO Router Boost.
```

## release/src-rt-5.04behnd.4916/bcmdrivers/broadcom/char/bcmphydiag/Kconfig.autodetect
```kconfig
config BCM_PHY_DIAG
	tristate "PHY Diag Driver"
	default n
	depends on BCM963158 || BCM963178 || BCM963146 || BCM963138 || BCM963148
	help
	  This driver provide APIs for Diag clients to print status/debug info to DSL Diags application.

config BCM_PHY_DIAG_IMPL
	int "Implementation index for PHY Diag driver"
	depends on BCM_PHY_DIAG
	default 1
```

## release/src-rt-5.04behnd.4916/bcmdrivers/broadcom/char/laser/Kconfig.autodetect
```kconfig
config BCM_LASER
        depends on BCM_SFP
        tristate "Support for LASER"

config BCM_LASER_IMPL
        int "Implementation index for LASER"
        depends on BCM_LASER
```

## release/src-rt-5.04behnd.4916/bcmdrivers/broadcom/char/pon_drv/Kconfig.autodetect
```kconfig
config BCM_PON_DRV
	tristate "Support for Broadcom Pon Drv features"
	depends on !BRCM_IKOS
	default m if BCM_PON_XRDP
	default m if BCM963158
	default m if BCM96813 && !BCM_HND_EAP
	default n

config BCM_PON_DRV_IMPL
	int "Implementation index for Broadcom Pon Drv features"
	depends on BCM_PON_DRV
	default 2 if BCM96888 || BCM96813 || BCM968880 || BCM96837
	default 1
```

## release/src-rt-5.04behnd.4916/bcmdrivers/broadcom/net/wl/impl103/main/components/rdk/meta-rdk-broadcom-wifi/meta-brcm-wifi/conf/machine/include/brcm-wifi-cm3390-tarball.inc
```bitbake
# Broadcom WiFi driver configuration
BRCM_WIFI_PLATFORM ?= "CM3390"

PREFERRED_PROVIDER_hal-wifi = "hal-wifi-broadcom"
MACHINE_EXTRA_RDEPENDS += "broadcom-wifi"

# Additional CFLAGS for ccsp_soc.inc
CCSP_SOC_CFLAGS += "-D_ENABLE_BAND_STEERING_"
CCSP_SOC_CFLAGS += "-D_BEACONRATE_SUPPORT"
CCSP_SOC_CFLAGS += "-D_WIFI_AX_SUPPORT_"
CCSP_SOC_CFLAGS += "-D_WIFI_CONSOLIDATED_STANDARDS_"

# WIFI package server
# By default, BRCM_WIFI_PACKAGE_SERVER is defined as "file://".
# So you'll need to copy all WiFi packages to downloads/ directory manually.
# But if you have a local file server, you can use your server.
# For example, BRCM_WIFI_PACKAGE_SERVER = "http://your_server.com/wifi_pkg/"
BRCM_WIFI_PACKAGE_SERVER ?= "file://"

BRCM_WIFI_DRIVER_BASE_DIR ?= "wl"

BRCM_WIFI_DRIVER_SRC_URI ?= "${BRCM_WIFI_PACKAGE_SERVER}wifi_src.tgz;subdir=wl;name=wifidrv"
BRCM_WIFI_AIRIQ_URI ?= "${BRCM_WIFI_PACKAGE_SERVER}wifi_airiq.tgz;subdir=wl;name=wifidrv"
BRCM_WIFI_CCSP_HAL_SRC_URI ?= "${BRCM_WIFI_PACKAGE_SERVER}wifi_src.tgz;subdir=git;name=wlanhal"
```

## release/src-rt-5.04behnd.4916/bcmdrivers/broadcom/net/wl/impl107/main/components/rdk/CM33940/meta-rdk-broadcom-wifi/meta-brcm-wifi/conf/layer.conf
```bitbake
# We have a conf and classes directory, add to BBPATH
BBPATH .= ":${LAYERDIR}"

# We have recipes-* directories, add to BBFILES
BBFILES += "${LAYERDIR}/recipes-*/*/*.bb"
BBFILES += "${LAYERDIR}/recipes-*/*/*.bbappend"
BBFILES += "${LAYERDIR}/recipes-*/*.bb"
BBFILES += "${LAYERDIR}/recipes-*/*.bbappend"

BBFILE_COLLECTIONS += "brcm-wifi"
BBFILE_PATTERN_brcm-wifi := "^${LAYERDIR}/"
BBFILE_PRIORITY_brcm-wifi = "32"
LAYERVERSION_brcm-wifi = "1"
LAYERSERIES_COMPAT_brcm-wifi = "dunfell"
```

## release/src-rt-5.04behnd.4916/bcmdrivers/opensource/bus/pci/endpoint/gepd/Kconfig.autodetect
```kconfig
config BCM_PCIE_GEPD
	tristate "PCIe Generic End Point driver from bcmdriver"
	default n

config BCM_PCIE_GEPD_IMPL
	int "PCIe Generic End Point driver implementation selection"
	depends on BCM_PCIE_GEPD
	default 1
```

## release/src-rt-5.04behnd.4916/bcmdrivers/opensource/bus/pci/host/Kconfig.autodetect
```kconfig
config BCM_PCIE_HCD
	tristate "PCIe host controller driver from bcmdriver"
	depends on BCM_PCI
	default m

config BCM_PCIE_HCD_IMPL
	int "PCIe host controller driver implementation selection"
	depends on BCM_PCIE_HCD
	default 1

config BCM_PCI_MSI
	bool "Support for PCI MSI interrupts in PCIE HCD"
	depends on BCM_PCIE_HCD && PCI_MSI
	default n

config BCM_PCIE_963XX_HC
	bool "Broadcom 963xx PCIe host controller implementation"
	depends on BCM_PCIE_HCD
	default y

config BCM_PCIE_VCD
	bool "Support for PCIe Virtual Core Device for internal WiFi devices"
	depends on BCM_PCIE_HCD && BCM_WLAN
	depends on BCM963178 || BCM947622 || BCM96878 || BCM96756 || BCM96855 || BCM96765
	default y

config BCM_PCIE_PMC_BRD_STUBS
	bool "Support for PCIe PMC and Board API Stubs for Virtual Core Device bring up"
	depends on BCM_PCIE_VCD
	default n

config BCM_PCIE_PMC_BRD_STUBS
	bool "Stubs for external PMC, board, shared utils during vcd bringup"
	depends on BCM_PCIE_VCD
	depends on BRCM_IKOS
	default y

config BCM_PCIE_SWAM
	bool "Sub Window Address Manager to use only one BAR for WLAN (runner and MLO)"
	depends on BCM_PCIE_963XX_HC && BCM_WLAN && PHYS_ADDR_T_64BIT
	depends on BCM_WLAN_MLO
	depends on BCM963158 || BCM94912
	default y
```

## release/src-rt-5.04behnd.4916/bcmdrivers/opensource/bus/sata/Kconfig.autodetect
```kconfig
config BCM_BCA_SATA
	tristate "Broadcom BCA SATA AHCI Driver"
	default n
	help
	  Add the BCM BCA SATA AHCI host driver support

config BCM_BCA_SATA_IMPL
	int "Implementation index for BCA SATA AHCI module"
	depends on BCM_BCA_SATA
	default 1
```

## release/src-rt-5.04behnd.4916/bcmdrivers/opensource/char/bcm_bootstate/Kconfig.autodetect
```kconfig
config BCM_BOOTSTATE
	tristate "Broadcom Boot State Driver"
	default n

config BCM_BOOTSTATE_IMPL
	int "Implementation index for Broadcom Boot State Driver"
	depends on BCM_BOOTSTATE
	default 1 
```

## release/src-rt-5.04behnd.4916/bcmdrivers/opensource/char/bcmlibs/Kconfig.autodetect
```kconfig
config BCM_LIBS
	tristate "Broadcom Uitility Library"
	default m

config BCM_LIBS_IMPL
	int "Implementation index for Broadcom Uitility Library"
	depends on BCM_LIBS
	default 1 
```
