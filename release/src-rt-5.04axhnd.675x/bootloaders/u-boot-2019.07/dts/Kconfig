## release/src-rt-5.04axhnd.675x/bootloaders/u-boot-2019.07/fs/cbfs/Kconfig
```kconfig
config FS_CBFS
	bool "Enable CBFS (Coreboot Filesystem)"
	help
	  Define this to enable support for reading from a Coreboot
	  filesystem. This is a ROM-based filesystem used for accessing files
	  on systems that use coreboot as the first boot-loader and then load
	  U-Boot to actually boot the Operating System. You can also enable
	  CMD_CBFS to get command-line access.
```

## release/src-rt-5.04axhnd.675x/bootloaders/u-boot-2019.07/fs/cramfs/Kconfig
```kconfig
config FS_CRAMFS
	bool "Enable CRAMFS filesystem support"
	help
	  This provides support for reading images from CRAMFS (Compressed ROM
	  filesystem). CRAMFS is useful when space is tight since files are
	  compressed. You can also enable CMD_CRAMFS to get command-line
	  access.
```

## release/src-rt-5.04axhnd.675x/bootloaders/u-boot-2019.07/fs/fat/Kconfig
```kconfig
config FS_FAT
	bool "Enable FAT filesystem support"
	help
	  This provides support for reading images from File Allocation Table
	  (FAT) filesystem. FAT filesystem is a legacy, lightweight filesystem.
	  It is useful mainly for its wide compatibility with various operating
	  systems. You can also enable CMD_FAT to get access to fat commands.

config FAT_WRITE
	bool "Enable FAT filesystem write support"
	depends on FS_FAT
	help
	  This provides support for creating and writing new files to an
	  existing FAT filesystem partition.

config FS_FAT_MAX_CLUSTSIZE
	int "Set maximum possible clustersize"
	default 65536
	depends on FS_FAT
	help
	  Set the maximum possible clustersize for the FAT filesytem. This
	  is the smallest amount of disk space that can be used to hold a
	  file. Unless you have an extremely tight memory memory constraints,
	  leave the default.
```
