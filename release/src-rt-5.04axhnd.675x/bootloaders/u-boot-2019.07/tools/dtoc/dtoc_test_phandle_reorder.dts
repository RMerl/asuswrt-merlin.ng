// SPDX-License-Identifier: GPL-2.0+
/*
 * Test device tree file for dtoc
 *
 * Copyright 2018 Google, Inc
 */

/dts-v1/;

/ {

	phandle-source2 {
		u-boot,dm-pre-reloc;
		compatible = "source";
		clocks = <&phandle>;
	};

	phandle: phandle-target {
		u-boot,dm-pre-reloc;
		compatible = "target";
		#clock-cells = <0>;
	};
};
