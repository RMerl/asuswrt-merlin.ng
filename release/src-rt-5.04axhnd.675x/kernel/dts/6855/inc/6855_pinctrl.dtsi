pincontroller-functions {
        spim_group_pins: spim_group_pinmux {
            pins = <72 73 74>;
            function = <1>;
        };

        usb0_pwr_pins: usb0_pwr_pinmux {
            pins = <79 80>;
            function = <1>;
        };

        usb1_pwr_pins: usb1_pwr_pinmux {
            pins = <81 82>;
            function = <1>;
        };

        rgmii_pins: rgmii_pinmux {
            pins = <56 57 58 59 60 61 62 63 64 65 66 67>;
            function = <1>;
        };

        nand_data_pins: nand_data_pinmux {
            pins = <43 44 45 46 47 48 49 50>;
            function = <1>;
        };

        nand_ctrl_pins: nand_ctrl_pinmux {
            pins = <40 41 42 51 52 53>;
            function = <1>;
        };

        emmc_ctrl_pins: emmc_ctrl_pinmux {
            pins = <54 55>;
            function = <1>;
        };

        a_one_sec_pls_pin_8: a_one_sec_pls_pinmux {
            pins = <8>;
            function = <0>;
        };

        a_per_led_00_pin_0: a_per_led_00_pinmux {
            pins = <0>;
            function = <2>;
            crossbar-output = <0>;
        };

        a_per_led_01_pin_1: a_per_led_01_pinmux {
            pins = <1>;
            function = <2>;
            crossbar-output = <1>;
        };

        a_per_led_02_pin_2: a_per_led_02_pinmux {
            pins = <2>;
            function = <2>;
            crossbar-output = <2>;
        };

        a_per_led_03_pin_13: a_per_led_03_pinmux {
            pins = <13>;
            function = <2>;
            crossbar-output = <3>;
        };

        a_per_led_04_pin_14: a_per_led_04_pinmux {
            pins = <14>;
            function = <2>;
            crossbar-output = <4>;
        };

        a_per_led_05_pin_15: a_per_led_05_pinmux {
            pins = <15>;
            function = <2>;
            crossbar-output = <5>;
        };

        a_per_led_06_pin_7: a_per_led_06_pinmux {
            pins = <7>;
            function = <2>;
            crossbar-output = <6>;
        };

        a_per_led_07_pin_8: a_per_led_07_pinmux {
            pins = <8>;
            function = <2>;
            crossbar-output = <7>;
        };

        a_per_led_08_pin_9: a_per_led_08_pinmux {
            pins = <9>;
            function = <2>;
            crossbar-output = <8>;
        };

        a_per_led_09_pin_32: a_per_led_09_pinmux {
            pins = <32>;
            function = <2>;
            crossbar-output = <9>;
        };

        a_per_led_10_pin_10: a_per_led_10_pinmux {
            pins = <10>;
            function = <2>;
            crossbar-output = <10>;
        };

        a_per_led_11_pin_11: a_per_led_11_pinmux {
            pins = <11>;
            function = <2>;
            crossbar-output = <11>;
        };

        a_per_led_12_pin_18: a_per_led_12_pinmux {
            pins = <18>;
            function = <2>;
            crossbar-output = <12>;
        };

        a_per_led_13_pin_3: a_per_led_13_pinmux {
            pins = <3>;
            function = <2>;
            crossbar-output = <13>;
        };

        a_per_led_14_pin_4: a_per_led_14_pinmux {
            pins = <4>;
            function = <2>;
            crossbar-output = <14>;
        };

        a_per_led_15_pin_5: a_per_led_15_pinmux {
            pins = <5>;
            function = <2>;
            crossbar-output = <15>;
        };

        a_per_led_16_pin_6: a_per_led_16_pinmux {
            pins = <6>;
            function = <2>;
            crossbar-output = <16>;
        };

        a_per_led_17_pin_12: a_per_led_17_pinmux {
            pins = <12>;
            function = <2>;
            crossbar-output = <17>;
        };

        a_per_led_18_pin_19: a_per_led_18_pinmux {
            pins = <19>;
            function = <2>;
            crossbar-output = <18>;
        };

        a_per_led_19_pin_20: a_per_led_19_pinmux {
            pins = <20>;
            function = <2>;
            crossbar-output = <19>;
        };

        a_per_led_20_pin_87: a_per_led_20_pinmux {
            pins = <87>;
            function = <3>;
            crossbar-output = <20>;
        };

        a_per_led_21_pin_88: a_per_led_21_pinmux {
            pins = <88>;
            function = <3>;
            crossbar-output = <21>;
        };

        a_per_led_22_pin_57: a_per_led_22_pinmux {
            pins = <57>;
            function = <3>;
            crossbar-output = <22>;
        };

        a_per_led_23_pin_58: a_per_led_23_pinmux {
            pins = <58>;
            function = <3>;
            crossbar-output = <23>;
        };

        a_per_led_24_pin_59: a_per_led_24_pinmux {
            pins = <59>;
            function = <3>;
            crossbar-output = <24>;
        };

        a_per_led_25_pin_60: a_per_led_25_pinmux {
            pins = <60>;
            function = <3>;
            crossbar-output = <25>;
        };

        a_per_led_26_pin_61: a_per_led_26_pinmux {
            pins = <61>;
            function = <3>;
            crossbar-output = <26>;
        };

        a_per_led_27_pin_63: a_per_led_27_pinmux {
            pins = <63>;
            function = <3>;
            crossbar-output = <27>;
        };

        a_per_led_28_pin_64: a_per_led_28_pinmux {
            pins = <64>;
            function = <3>;
            crossbar-output = <28>;
        };

        a_per_led_29_pin_65: a_per_led_29_pinmux {
            pins = <65>;
            function = <3>;
            crossbar-output = <29>;
        };

        a_per_led_30_pin_66: a_per_led_30_pinmux {
            pins = <66>;
            function = <3>;
            crossbar-output = <30>;
        };

        a_per_led_31_pin_67: a_per_led_31_pinmux {
            pins = <67>;
            function = <3>;
            crossbar-output = <31>;
        };

        a_signal_detect_pin_12: a_signal_detect_pinmux {
            pins = <12>;
            function = <1>;
        };

        a_uart1_sin_pin_26: a_uart1_sin_pinmux {
            pins = <26>;
            function = <1>;
        };

        a_uart1_sout_pin_27: a_uart1_sout_pinmux {
            pins = <27>;
            function = <1>;
        };

        a_wan_nco_1pps_sig_pin_8: a_wan_nco_1pps_sig_pinmux {
            pins = <8>;
            function = <3>;
        };

        a_wl_gci_gpio_0_pin_72: a_wl_gci_gpio_0_pinmux {
            pins = <72>;
            function = <2>;
        };

        a_wl_gci_gpio_1_pin_73: a_wl_gci_gpio_1_pinmux {
            pins = <73>;
            function = <2>;
        };

        a_wl_gci_gpio_2_pin_74: a_wl_gci_gpio_2_pinmux {
            pins = <74>;
            function = <2>;
        };

        a_wl_gci_gpio_3_pin_75: a_wl_gci_gpio_3_pinmux {
            pins = <75>;
            function = <2>;
        };

        a_wl_gci_gpio_4_pin_76: a_wl_gci_gpio_4_pinmux {
            pins = <76>;
            function = <2>;
        };

        a_wl_seci_in_pin_10: a_wl_seci_in_pinmux {
            pins = <10>;
            function = <3>;
        };

        a_wl_seci_out_pin_9: a_wl_seci_out_pinmux {
            pins = <9>;
            function = <3>;
        };

        b_one_sec_pls_pin_20: b_one_sec_pls_pinmux {
            pins = <20>;
            function = <0>;
        };

        b_per_led_00_pin_38: b_per_led_00_pinmux {
            pins = <38>;
            function = <3>;
            crossbar-output = <0>;
        };

        b_per_led_01_pin_16: b_per_led_01_pinmux {
            pins = <16>;
            function = <2>;
            crossbar-output = <1>;
        };

        b_per_led_02_pin_17: b_per_led_02_pinmux {
            pins = <17>;
            function = <2>;
            crossbar-output = <2>;
        };

        b_per_led_03_pin_33: b_per_led_03_pinmux {
            pins = <33>;
            function = <3>;
            crossbar-output = <3>;
        };

        b_per_led_04_pin_54: b_per_led_04_pinmux {
            pins = <54>;
            function = <3>;
            crossbar-output = <4>;
        };

        b_per_led_09_pin_55: b_per_led_09_pinmux {
            pins = <55>;
            function = <3>;
            crossbar-output = <9>;
        };

        b_per_led_11_pin_21: b_per_led_11_pinmux {
            pins = <21>;
            function = <2>;
            crossbar-output = <11>;
        };

        b_per_led_12_pin_34: b_per_led_12_pinmux {
            pins = <34>;
            function = <3>;
            crossbar-output = <12>;
        };

        b_per_led_13_pin_93: b_per_led_13_pinmux {
            pins = <93>;
            function = <3>;
            crossbar-output = <13>;
        };

        b_per_led_14_pin_94: b_per_led_14_pinmux {
            pins = <94>;
            function = <3>;
            crossbar-output = <14>;
        };

        b_per_led_15_pin_95: b_per_led_15_pinmux {
            pins = <95>;
            function = <3>;
            crossbar-output = <15>;
        };

        b_per_led_16_pin_89: b_per_led_16_pinmux {
            pins = <89>;
            function = <3>;
            crossbar-output = <16>;
        };

        b_per_led_17_pin_26: b_per_led_17_pinmux {
            pins = <26>;
            function = <2>;
            crossbar-output = <17>;
        };

        b_per_led_18_pin_27: b_per_led_18_pinmux {
            pins = <27>;
            function = <2>;
            crossbar-output = <18>;
        };

        b_per_led_19_pin_28: b_per_led_19_pinmux {
            pins = <28>;
            function = <3>;
            crossbar-output = <19>;
        };

        b_per_led_20_pin_40: b_per_led_20_pinmux {
            pins = <40>;
            function = <3>;
            crossbar-output = <20>;
        };

        b_per_led_21_pin_43: b_per_led_21_pinmux {
            pins = <43>;
            function = <3>;
            crossbar-output = <21>;
        };

        b_per_led_22_pin_44: b_per_led_22_pinmux {
            pins = <44>;
            function = <3>;
            crossbar-output = <22>;
        };

        b_per_led_23_pin_45: b_per_led_23_pinmux {
            pins = <45>;
            function = <3>;
            crossbar-output = <23>;
        };

        b_per_led_24_pin_46: b_per_led_24_pinmux {
            pins = <46>;
            function = <3>;
            crossbar-output = <24>;
        };

        b_per_led_25_pin_47: b_per_led_25_pinmux {
            pins = <47>;
            function = <3>;
            crossbar-output = <25>;
        };

        b_per_led_26_pin_48: b_per_led_26_pinmux {
            pins = <48>;
            function = <3>;
            crossbar-output = <26>;
        };

        b_per_led_27_pin_49: b_per_led_27_pinmux {
            pins = <49>;
            function = <3>;
            crossbar-output = <27>;
        };

        b_per_led_28_pin_50: b_per_led_28_pinmux {
            pins = <50>;
            function = <3>;
            crossbar-output = <28>;
        };

        b_per_led_29_pin_51: b_per_led_29_pinmux {
            pins = <51>;
            function = <3>;
            crossbar-output = <29>;
        };

        b_per_led_30_pin_52: b_per_led_30_pinmux {
            pins = <52>;
            function = <3>;
            crossbar-output = <30>;
        };

        b_per_led_31_pin_53: b_per_led_31_pinmux {
            pins = <53>;
            function = <3>;
            crossbar-output = <31>;
        };

        b_signal_detect_pin_21: b_signal_detect_pinmux {
            pins = <21>;
            function = <3>;
        };

        b_uart1_sin_pin_54: b_uart1_sin_pinmux {
            pins = <54>;
            function = <2>;
        };

        b_uart1_sout_pin_55: b_uart1_sout_pinmux {
            pins = <55>;
            function = <2>;
        };

        b_wan_nco_1pps_sig_pin_20: b_wan_nco_1pps_sig_pinmux {
            pins = <20>;
            function = <3>;
        };

        b_wl_gci_gpio_0_pin_58: b_wl_gci_gpio_0_pinmux {
            pins = <58>;
            function = <2>;
        };

        b_wl_gci_gpio_1_pin_59: b_wl_gci_gpio_1_pinmux {
            pins = <59>;
            function = <2>;
        };

        b_wl_gci_gpio_2_pin_63: b_wl_gci_gpio_2_pinmux {
            pins = <63>;
            function = <2>;
        };

        b_wl_gci_gpio_3_pin_64: b_wl_gci_gpio_3_pinmux {
            pins = <64>;
            function = <2>;
        };

        b_wl_gci_gpio_4_pin_65: b_wl_gci_gpio_4_pinmux {
            pins = <65>;
            function = <2>;
        };

        b_wl_seci_in_pin_23: b_wl_seci_in_pinmux {
            pins = <23>;
            function = <3>;
        };

        b_wl_seci_out_pin_22: b_wl_seci_out_pinmux {
            pins = <22>;
            function = <3>;
        };

        c0_femctrl_0_pin_84: c0_femctrl_0_pinmux {
            pins = <84>;
            function = <1>;
        };

        c0_femctrl_1_pin_85: c0_femctrl_1_pinmux {
            pins = <85>;
            function = <1>;
        };

        c0_femctrl_2_pin_86: c0_femctrl_2_pinmux {
            pins = <86>;
            function = <1>;
        };

        c0_femctrl_3_pin_87: c0_femctrl_3_pinmux {
            pins = <87>;
            function = <1>;
        };

        c0_femctrl_4_pin_88: c0_femctrl_4_pinmux {
            pins = <88>;
            function = <1>;
        };

        c0_femctrl_5_pin_89: c0_femctrl_5_pinmux {
            pins = <89>;
            function = <1>;
        };

        c1_femctrl_0_pin_90: c1_femctrl_0_pinmux {
            pins = <90>;
            function = <1>;
        };

        c1_femctrl_1_pin_91: c1_femctrl_1_pinmux {
            pins = <91>;
            function = <1>;
        };

        c1_femctrl_2_pin_92: c1_femctrl_2_pinmux {
            pins = <92>;
            function = <1>;
        };

        c1_femctrl_3_pin_93: c1_femctrl_3_pinmux {
            pins = <93>;
            function = <1>;
        };

        c1_femctrl_4_pin_94: c1_femctrl_4_pinmux {
            pins = <94>;
            function = <1>;
        };

        c1_femctrl_5_pin_95: c1_femctrl_5_pinmux {
            pins = <95>;
            function = <1>;
        };

        c_uart1_sin_pin_30: c_uart1_sin_pinmux {
            pins = <30>;
            function = <2>;
        };

        c_uart1_sout_pin_31: c_uart1_sout_pinmux {
            pins = <31>;
            function = <2>;
        };

        c_wl_gci_gpio_0_pin_39: c_wl_gci_gpio_0_pinmux {
            pins = <39>;
            function = <2>;
        };

        c_wl_gci_gpio_1_pin_38: c_wl_gci_gpio_1_pinmux {
            pins = <38>;
            function = <2>;
        };

        c_wl_gci_gpio_2_pin_54: c_wl_gci_gpio_2_pinmux {
            pins = <54>;
            function = <0>;
        };

        c_wl_gci_gpio_3_pin_55: c_wl_gci_gpio_3_pinmux {
            pins = <55>;
            function = <0>;
        };

        c_wl_gci_gpio_4_pin_28: c_wl_gci_gpio_4_pinmux {
            pins = <28>;
            function = <2>;
        };

        c_wl_seci_in_pin_19: c_wl_seci_in_pinmux {
            pins = <19>;
            function = <3>;
        };

        c_wl_seci_out_pin_13: c_wl_seci_out_pinmux {
            pins = <13>;
            function = <3>;
        };

        ddr_uart_rx_pin_22: ddr_uart_rx_pinmux {
            pins = <22>;
            function = <7>;
        };

        ddr_uart_tx_pin_23: ddr_uart_tx_pinmux {
            pins = <23>;
            function = <7>;
        };

        early_txen_pin_28: early_txen_pinmux {
            pins = <28>;
            function = <1>;
        };

        i2c_2_scl_pin_38: i2c_2_scl_pinmux {
            pins = <38>;
            function = <1>;
        };

        i2c_2_sda_pin_39: i2c_2_sda_pinmux {
            pins = <39>;
            function = <1>;
        };

        i2c_scl_pin_77: i2c_scl_pinmux {
            pins = <77>;
            function = <1>;
        };

        i2c_sda_pin_78: i2c_sda_pinmux {
            pins = <78>;
            function = <1>;
        };

        i2s_rx_lrck_pin_36: i2s_rx_lrck_pinmux {
            pins = <36>;
            function = <1>;
        };

        i2s_rx_mclk_pin_37: i2s_rx_mclk_pinmux {
            pins = <37>;
            function = <1>;
        };

        i2s_rx_sclk_pin_35: i2s_rx_sclk_pinmux {
            pins = <35>;
            function = <1>;
        };

        i2s_sdata_in_pin_32: i2s_sdata_in_pinmux {
            pins = <32>;
            function = <1>;
        };

        i2s_sdata_out_pin_33: i2s_sdata_out_pinmux {
            pins = <33>;
            function = <1>;
        };

        i2s_tx_lrck_pin_31: i2s_tx_lrck_pinmux {
            pins = <31>;
            function = <1>;
        };

        i2s_tx_mclk_pin_34: i2s_tx_mclk_pinmux {
            pins = <34>;
            function = <1>;
        };

        i2s_tx_sclk_pin_30: i2s_tx_sclk_pinmux {
            pins = <30>;
            function = <1>;
        };

        nand_wp_b_pin_11: nand_wp_b_pinmux {
            pins = <11>;
            function = <1>;
        };

        pcie0_clkreq_b_pin_96: pcie0_clkreq_b_pinmux {
            pins = <96>;
            function = <1>;
        };

        pcie0_rst_b_pin_97: pcie0_rst_b_pinmux {
            pins = <97>;
            function = <1>;
        };

        pcie1_clkreq_b_pin_98: pcie1_clkreq_b_pinmux {
            pins = <98>;
            function = <1>;
        };

        pcie1_rst_b_pin_99: pcie1_rst_b_pinmux {
            pins = <99>;
            function = <1>;
        };

        pcm_clk_pin_24: pcm_clk_pinmux {
            pins = <24>;
            function = <1>;
        };

        pcm_fs_pin_25: pcm_fs_pinmux {
            pins = <25>;
            function = <1>;
        };

        pcm_sdin_pin_22: pcm_sdin_pinmux {
            pins = <22>;
            function = <1>;
        };

        pcm_sdout_pin_23: pcm_sdout_pinmux {
            pins = <23>;
            function = <1>;
        };

        per_mdc_pin_68: per_mdc_pinmux {
            pins = <68>;
            function = <1>;
        };

        per_mdio_pin_69: per_mdio_pinmux {
            pins = <69>;
            function = <1>;
        };

        pll_byp_clk_00_pin_84: pll_byp_clk_00_pinmux {
            pins = <84>;
            function = <5>;
        };

        pll_byp_clk_01_pin_85: pll_byp_clk_01_pinmux {
            pins = <85>;
            function = <5>;
        };

        pll_byp_clk_02_pin_86: pll_byp_clk_02_pinmux {
            pins = <86>;
            function = <5>;
        };

        pll_byp_clk_03_pin_3: pll_byp_clk_03_pinmux {
            pins = <3>;
            function = <5>;
        };

        pll_byp_clk_04_pin_4: pll_byp_clk_04_pinmux {
            pins = <4>;
            function = <5>;
        };

        pll_byp_clk_05_pin_5: pll_byp_clk_05_pinmux {
            pins = <5>;
            function = <5>;
        };

        pll_byp_clk_06_pin_90: pll_byp_clk_06_pinmux {
            pins = <90>;
            function = <5>;
        };

        pll_byp_clk_07_pin_91: pll_byp_clk_07_pinmux {
            pins = <91>;
            function = <5>;
        };

        pll_byp_clk_08_pin_92: pll_byp_clk_08_pinmux {
            pins = <92>;
            function = <5>;
        };

        pll_byp_clk_09_pin_29: pll_byp_clk_09_pinmux {
            pins = <29>;
            function = <5>;
        };

        pll_byp_clk_10_pin_7: pll_byp_clk_10_pinmux {
            pins = <7>;
            function = <5>;
        };

        pll_byp_clk_11_pin_8: pll_byp_clk_11_pinmux {
            pins = <8>;
            function = <5>;
        };

        pon_lbe_n_pin_7: pon_lbe_n_pinmux {
            pins = <7>;
            function = <0>;
        };

        pon_lbe_p_pin_100: pon_lbe_p_pinmux {
            pins = <100>;
            function = <1>;
        };

        reset_out_b_pin_83: reset_out_b_pinmux {
            pins = <83>;
            function = <1>;
        };

        rogue_onu_in_pin_29: rogue_onu_in_pinmux {
            pins = <29>;
            function = <1>;
        };

        ser_led_clk_pin_1: ser_led_clk_pinmux {
            pins = <1>;
            function = <1>;
        };

        ser_led_data_pin_0: ser_led_data_pinmux {
            pins = <0>;
            function = <1>;
        };

        ser_led_mask_pin_2: ser_led_mask_pinmux {
            pins = <2>;
            function = <1>;
        };

        sgmii_fiber_detect_pin_13: sgmii_fiber_detect_pinmux {
            pins = <13>;
            function = <1>;
        };

        sgmii_serdes_mod_def_pin_14: sgmii_serdes_mod_def_pinmux {
            pins = <14>;
            function = <1>;
        };

        sim_clk_pin_35: sim_clk_pinmux {
            pins = <35>;
            function = <0>;
        };

        sim_dat_pin_34: sim_dat_pinmux {
            pins = <34>;
            function = <0>;
        };

        sim_presence_pin_36: sim_presence_pinmux {
            pins = <36>;
            function = <0>;
        };

        sim_rst_pin_32: sim_rst_pinmux {
            pins = <32>;
            function = <0>;
        };

        sim_vcc_en_pin_30: sim_vcc_en_pinmux {
            pins = <30>;
            function = <0>;
        };

        sim_vcc_vol_sel_pin_31: sim_vcc_vol_sel_pinmux {
            pins = <31>;
            function = <0>;
        };

        sim_vpp_en_pin_33: sim_vpp_en_pinmux {
            pins = <33>;
            function = <0>;
        };

        spim_ss0_b_pin_75: spim_ss0_b_pinmux {
            pins = <75>;
            function = <1>;
        };

        spim_ss1_b_pin_76: spim_ss1_b_pinmux {
            pins = <76>;
            function = <1>;
        };

        spim_ss2_b_pin_10: spim_ss2_b_pinmux {
            pins = <10>;
            function = <1>;
        };

        spim_ss3_b_pin_9: spim_ss3_b_pinmux {
            pins = <9>;
            function = <1>;
        };

        spim_ss4_b_pin_8: spim_ss4_b_pinmux {
            pins = <8>;
            function = <1>;
        };

        spim_ss5_b_pin_7: spim_ss5_b_pinmux {
            pins = <7>;
            function = <1>;
        };

        spis_clk_pin_18: spis_clk_pinmux {
            pins = <18>;
            function = <1>;
        };

        spis_miso_pin_20: spis_miso_pinmux {
            pins = <20>;
            function = <1>;
        };

        spis_mosi_pin_21: spis_mosi_pinmux {
            pins = <21>;
            function = <1>;
        };

        spis_ss_b_pin_19: spis_ss_b_pinmux {
            pins = <19>;
            function = <1>;
        };

        sys_irq_out_b_pin_9: sys_irq_out_b_pinmux {
            pins = <9>;
            function = <0>;
        };

        uart0_sdin_pin_70: uart0_sdin_pinmux {
            pins = <70>;
            function = <1>;
        };

        uart0_sdout_pin_71: uart0_sdout_pinmux {
            pins = <71>;
            function = <1>;
        };

        uart2_cts_pin_3: uart2_cts_pinmux {
            pins = <3>;
            function = <1>;
        };

        uart2_rts_pin_4: uart2_rts_pinmux {
            pins = <4>;
            function = <1>;
        };

        uart2_sin_pin_5: uart2_sin_pinmux {
            pins = <5>;
            function = <1>;
        };

        uart2_sout_pin_6: uart2_sout_pinmux {
            pins = <6>;
            function = <1>;
        };

        upi_clk_pin_24: upi_clk_pinmux {
            pins = <24>;
            function = <7>;
        };

        upi_ena_pin_14: upi_ena_pinmux {
            pins = <14>;
            function = <7>;
        };

        upi_enb_pin_15: upi_enb_pinmux {
            pins = <15>;
            function = <7>;
        };

        upi_out_pin_0: upi_out_pinmux {
            pins = <0>;
            function = <7>;
        };

        upi_sw_en_pin_6: upi_sw_en_pinmux {
            pins = <6>;
            function = <7>;
        };

        usbd_id_pin_17: usbd_id_pinmux {
            pins = <17>;
            function = <3>;
        };

        usbd_vbus_present_pin_16: usbd_vbus_present_pinmux {
            pins = <16>;
            function = <3>;
        };

        wan_mdc_pin_68: wan_mdc_pinmux {
            pins = <68>;
            function = <0>;
        };

        wan_mdio_pin_69: wan_mdio_pinmux {
            pins = <69>;
            function = <0>;
        };

        wan_nco_10m_clk_pin_11: wan_nco_10m_clk_pinmux {
            pins = <11>;
            function = <3>;
        };

        wan_nco_8k_clk_pin_18: wan_nco_8k_clk_pinmux {
            pins = <18>;
            function = <3>;
        };

        wan_nco_prog_clk_pin_37: wan_nco_prog_clk_pinmux {
            pins = <37>;
            function = <0>;
        };

        wifi_scl_pin_38: wifi_scl_pinmux {
            pins = <38>;
            function = <0>;
        };

        wifi_sda_pin_39: wifi_sda_pinmux {
            pins = <39>;
            function = <0>;
        };

        wl_gpio_0_pin_79: wl_gpio_0_pinmux {
            pins = <79>;
            function = <2>;
        };

        wl_gpio_1_pin_80: wl_gpio_1_pinmux {
            pins = <80>;
            function = <2>;
        };

        wl_gpio_10_pin_7: wl_gpio_10_pinmux {
            pins = <7>;
            function = <3>;
        };

        wl_gpio_11_pin_39: wl_gpio_11_pinmux {
            pins = <39>;
            function = <3>;
        };

        wl_gpio_12_pin_3: wl_gpio_12_pinmux {
            pins = <3>;
            function = <3>;
        };

        wl_gpio_13_pin_4: wl_gpio_13_pinmux {
            pins = <4>;
            function = <3>;
        };

        wl_gpio_14_pin_5: wl_gpio_14_pinmux {
            pins = <5>;
            function = <3>;
        };

        wl_gpio_15_pin_6: wl_gpio_15_pinmux {
            pins = <6>;
            function = <3>;
        };

        wl_gpio_2_pin_81: wl_gpio_2_pinmux {
            pins = <81>;
            function = <2>;
        };

        wl_gpio_3_pin_82: wl_gpio_3_pinmux {
            pins = <82>;
            function = <2>;
        };

        wl_gpio_4_pin_14: wl_gpio_4_pinmux {
            pins = <14>;
            function = <3>;
        };

        wl_gpio_5_pin_30: wl_gpio_5_pinmux {
            pins = <30>;
            function = <3>;
        };

        wl_gpio_6_pin_32: wl_gpio_6_pinmux {
            pins = <32>;
            function = <3>;
        };

        wl_gpio_7_pin_31: wl_gpio_7_pinmux {
            pins = <31>;
            function = <3>;
        };

        wl_gpio_8_pin_68: wl_gpio_8_pinmux {
            pins = <68>;
            function = <2>;
        };

        wl_gpio_9_pin_69: wl_gpio_9_pinmux {
            pins = <69>;
            function = <2>;
        };

};
