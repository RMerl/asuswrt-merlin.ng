/dts-v1/;

/ {
	compatible = "test_props";
	prop-hex32 = <0xdeadbeef>;
	prop-uint32 = <123>;
	prop-int32 = <0xfffffffe>;
	prop-hex64 = /bits/ 64 <0xdeadbeef01abcdef>;
	prop-uint64 = /bits/ 64 <9223372036854775807>;
	prop-int64 = /bits/ 64 <0xfffffffffffffffe>;
};
