## release/src-rt-5.04behnd.4916/bootloaders/u-boot-2024.04/configs/bcm963146_defconfig
```kconfig
CONFIG_ARM=y
CONFIG_SKIP_LOWLEVEL_INIT=y
CONFIG_COUNTER_FREQUENCY=50000000
# CONFIG_ARM64_SUPPORT_AARCH32 is not set
CONFIG_ARCH_BCMBCA=y
CONFIG_TEXT_BASE=0x01000000
CONFIG_SYS_MALLOC_F_LEN=0x8000
CONFIG_BCM63146=y
# CONFIG_BCMBCA_PMC_XRDP is not set
CONFIG_BCMBCA_DDRC=y
CONFIG_BCMBCA_DDR_LOADADDR=0x82000000
CONFIG_BOOT_BLOB_JTAG_LOAD_MAX_DDR_SIZE=0x5000
CONFIG_BCMBCA_HTTPD=y
CONFIG_BCMBCA_BOARD_SPECIFIC_DT=y
CONFIG_BCM_BOOTSTATE=y
CONFIG_BCM_BOOTSTATE_FALLBACK_SUPPORT=y
CONFIG_TARGET_BCM963146=y
CONFIG_SPL_LIBCOMMON_SUPPORT=y
CONFIG_SPL_LIBGENERIC_SUPPORT=y
CONFIG_NR_DRAM_BANKS=2
CONFIG_ENV_SIZE=0x2000
CONFIG_SPL_DM_SPI=y
CONFIG_DEFAULT_DEVICE_TREE="bcm963146"
CONFIG_SPL_TEXT_BASE=0x82010000
CONFIG_SPL_MMC=y
CONFIG_SPL_SERIAL=y
CONFIG_TPL_LDSCRIPT="arch/arm/cpu/armv8/u-boot.lds"
CONFIG_TPL_TEXT_BASE=0x05000000
CONFIG_TPL_LIBCOMMON_SUPPORT=y
CONFIG_TPL_LIBGENERIC_SUPPORT=y
CONFIG_TPL_SERIAL=y
CONFIG_TPL_SYS_MALLOC_F_LEN=0x800000
CONFIG_SPL_SYS_MALLOC_F_LEN=0x2000
CONFIG_SPL_SIZE_LIMIT=0x1c000
CONFIG_SPL=y
CONFIG_SPL_LIBDISK_SUPPORT=y
CONFIG_SPL_SPI=y
CONFIG_SYS_LOAD_ADDR=0x01000000
CONFIG_TPL_MAX_SIZE=1048576
CONFIG_ENV_VARS_UBOOT_CONFIG=y
CONFIG_FIT=y
CONFIG_FIT_CIPHER=y
CONFIG_FIT_VERBOSE=y
CONFIG_TPL_FIT_IMAGE_POST_PROCESS=y
CONFIG_LEGACY_IMAGE_FORMAT=y
CONFIG_SUPPORT_RAW_INITRD=y
CONFIG_OF_SYSTEM_SETUP=y
CONFIG_LOG=y
CONFIG_DISPLAY_BOARDINFO_LATE=y
CONFIG_BOARD_LATE_INIT=y
CONFIG_SPL_MAX_SIZE=0x1c000
CONFIG_SPL_HAS_BSS_LINKER_SECTION=y
CONFIG_SPL_BSS_START_ADDR=0xfff80000
CONFIG_SPL_BSS_MAX_SIZE=0x800
CONFIG_SPL_SYS_MALLOC_SIMPLE=y
CONFIG_SYS_MMCSD_RAW_MODE_U_BOOT_USE_SECTOR=y
CONFIG_SYS_MMCSD_RAW_MODE_U_BOOT_SECTOR=0
CONFIG_SYS_MMCSD_RAW_MODE_U_BOOT_DATA_PART_OFFSET=0
CONFIG_SPL_ENV_SUPPORT=y
CONFIG_SPL_FS_EXT4=y
# CONFIG_SYS_MMCSD_FS_BOOT is not set
CONFIG_SPL_MTD=y
CONFIG_TPL_MTD=y
CONFIG_SPL_UBI_MAX_VOL_LEBS=256
CONFIG_SPL_UBI_MAX_PEB_SIZE=262144
CONFIG_SPL_UBI_MAX_PEBS=8192
CONFIG_SPL_UBI_PEB_OFFSET=4
CONFIG_SPL_UBI_VID_OFFSET=512
CONFIG_SPL_UBI_LEB_START=2048
CONFIG_SPL_UBI_INFO_ADDR=0x6000000
CONFIG_SPL_UBI_VOL_IDS=8
CONFIG_SPL_UBI_LOAD_MONITOR_ID=0
CONFIG_SPL_WATCHDOG=y
CONFIG_TPL_ATF=y
CONFIG_SPL_STANDALONE=y
CONFIG_TPL=y
# CONFIG_TPL_SEPARATE_BSS is not set
CONFIG_TPL_ENV_SUPPORT=y
CONFIG_TPL_MMC=y
CONFIG_TPL_NAND_SUPPORT=y
CONFIG_TPL_SPI=y
CONFIG_TPL_DM_SPI=y
CONFIG_TPL_LOAD_FIT_ADDRESS=0x7000000
CONFIG_TPL_FIT_CIPHER=y
CONFIG_HUSH_PARSER=y
# CONFIG_CMD_UNZIP is not set
CONFIG_CMD_GPIO=y
CONFIG_CMD_GPT=y
CONFIG_CMD_GPT_RENAME=y
CONFIG_CMD_MMC=y
CONFIG_CMD_MTD=y
CONFIG_CMD_NAND=y
CONFIG_CMD_PART=y
CONFIG_CMD_SF_TEST=y
CONFIG_CMD_WDT=y
CONFIG_CMD_PING=y
CONFIG_CMD_CACHE=y
CONFIG_CMD_RNG=y
CONFIG_CMD_FAT=y
CONFIG_CMD_FS_GENERIC=y
CONFIG_CMD_MTDPARTS=y
CONFIG_CMD_UBI=y
# CONFIG_SPL_DOS_PARTITION is not set
CONFIG_PARTITION_TYPE_GUID=y
CONFIG_OF_BOARD=y
CONFIG_ENV_IS_IN_BOOT_MAGIC=y
CONFIG_NET_RANDOM_ETHADDR=y
CONFIG_TFTP_BLOCKSIZE=1024
CONFIG_TPL_DM=y
CONFIG_CLK=y
CONFIG_SPL_CLK=y
CONFIG_TPL_CLK=y
CONFIG_LED_BLINK=y
CONFIG_MISC=y
CONFIG_SUPPORT_EMMC_BOOT=y
CONFIG_MMC_SDHCI=y
CONFIG_MMC_SDHCI_BCMBCA=y
CONFIG_MTD=y
CONFIG_DM_MTD=y
CONFIG_MTD_RAW_NAND=y
CONFIG_SYS_MAX_NAND_DEVICE=2
CONFIG_NAND_BRCMNAND=y
CONFIG_NAND_BRCMNAND_BCMBCA=y
CONFIG_MTD_SPI_NAND=y
CONFIG_DM_SPI_FLASH=y
CONFIG_SPI_FLASH_MACRONIX=y
CONFIG_SPI_FLASH_MTD=y
CONFIG_UBI_SILENCE_MSG=y
CONFIG_PINCTRL=y
# CONFIG_PINCTRL_FULL is not set
CONFIG_PINCTRL_BCMBCA=y
CONFIG_DM_RNG=y
CONFIG_RNG_IPROC200=y
CONFIG_SPECIFY_CONSOLE_INDEX=y
CONFIG_CONS_INDEX=0
CONFIG_DM_SERIAL=y
CONFIG_SERIAL_SEARCH_ALL=y
CONFIG_PL01X_SERIAL=y
CONFIG_SYSRESET=y
CONFIG_SYSRESET_WATCHDOG=y
CONFIG_WDT_BCM6345=y
CONFIG_TPL_WDT=y
CONFIG_PANIC_HANG=y
# CONFIG_GENERATE_SMBIOS_TABLE is not set
```

## release/src-rt-5.04behnd.4916/bootloaders/u-boot-2024.04/configs/bcm96765_ikos_defconfig
```kconfig
CONFIG_ARM=y
CONFIG_SKIP_LOWLEVEL_INIT=y
CONFIG_COUNTER_FREQUENCY=80000000
CONFIG_ARCH_BCMBCA=y
CONFIG_TEXT_BASE=0x01000000
CONFIG_SYS_MALLOC_F_LEN=0x8000
CONFIG_BCM6765=y
CONFIG_BCMBCA_DDRC=y
CONFIG_BCMBCA_DDR_REGINIT=y
CONFIG_BCMBCA_DDR_SIMINIT=y
CONFIG_BCMBCA_DDR_LOADADDR=0x90280000
CONFIG_BOOT_BLOB_JTAG_LOAD_MAX_DDR_SIZE=0xa000
CONFIG_BCMBCA_IKOS=y
CONFIG_BCMBCA_IKOS_SPL_JUMP_TO_UBOOT=y
CONFIG_BCMBCA_IKOS_SKIP_PGTBL_CLEAN=y
CONFIG_BCMBCA_BOARD_SPECIFIC_DT=y
CONFIG_BCM_BOOTSTATE=y
CONFIG_TARGET_BCM96765=y
CONFIG_SPL_LIBCOMMON_SUPPORT=y
CONFIG_SPL_LIBGENERIC_SUPPORT=y
CONFIG_NR_DRAM_BANKS=2
CONFIG_ENV_SIZE=0x2000
CONFIG_DEFAULT_DEVICE_TREE="bcm96765"
CONFIG_SPL_TEXT_BASE=0x90200000
CONFIG_SPL_SERIAL=y
CONFIG_TPL_LDSCRIPT="arch/arm/cpu/armv8/u-boot.lds"
CONFIG_TPL_TEXT_BASE=0x05000000
CONFIG_TPL_LIBCOMMON_SUPPORT=y
CONFIG_TPL_LIBGENERIC_SUPPORT=y
CONFIG_TPL_SERIAL=y
CONFIG_TPL_SYS_MALLOC_F_LEN=0x800000
CONFIG_SPL_SYS_MALLOC_F_LEN=0x2000
CONFIG_SPL_SIZE_LIMIT=0x50000
CONFIG_SPL=y
CONFIG_SYS_LOAD_ADDR=0x01000000
CONFIG_TPL_MAX_SIZE=1048576
CONFIG_ENV_VARS_UBOOT_CONFIG=y
CONFIG_FIT=y
CONFIG_FIT_VERBOSE=y
CONFIG_SUPPORT_RAW_INITRD=y
CONFIG_OF_SYSTEM_SETUP=y
CONFIG_LOG=y
CONFIG_DISPLAY_BOARDINFO_LATE=y
CONFIG_BOARD_LATE_INIT=y
CONFIG_SPL_MAX_SIZE=0x50000
CONFIG_SPL_HAS_BSS_LINKER_SECTION=y
CONFIG_SPL_BSS_START_ADDR=0x90250000
CONFIG_SPL_BSS_MAX_SIZE=0x800
CONFIG_SPL_SYS_MALLOC_SIMPLE=y
CONFIG_SPL_ENV_SUPPORT=y
CONFIG_SPL_MTD=y
CONFIG_TPL_MTD=y
CONFIG_SPL_UBI_MAX_VOL_LEBS=256
CONFIG_SPL_UBI_MAX_PEB_SIZE=262144
CONFIG_SPL_UBI_MAX_PEBS=8192
CONFIG_SPL_UBI_PEB_OFFSET=4
CONFIG_SPL_UBI_VID_OFFSET=512
CONFIG_SPL_UBI_LEB_START=2048
CONFIG_SPL_UBI_INFO_ADDR=0x6000000
CONFIG_SPL_UBI_VOL_IDS=8
CONFIG_SPL_UBI_LOAD_MONITOR_ID=0
CONFIG_SPL_WATCHDOG=y
CONFIG_SPL_STANDALONE=y
CONFIG_TPL=y
# CONFIG_TPL_SEPARATE_BSS is not set
CONFIG_TPL_ENV_SUPPORT=y
CONFIG_TPL_NAND_SUPPORT=y
CONFIG_TPL_LOAD_FIT_ADDRESS=0x7000000
CONFIG_HUSH_PARSER=y
CONFIG_CMD_MTD=y
CONFIG_CMD_NAND=y
CONFIG_CMD_WDT=y
CONFIG_CMD_MTDPARTS=y
CONFIG_CMD_UBI=y
CONFIG_OF_BOARD=y
CONFIG_ENV_IS_IN_BOOT_MAGIC=y
CONFIG_TFTP_BLOCKSIZE=1024
CONFIG_TPL_DM=y
CONFIG_CLK=y
CONFIG_SPL_CLK=y
CONFIG_TPL_CLK=y
CONFIG_LED_BLINK=y
# CONFIG_MMC is not set
CONFIG_MTD=y
CONFIG_DM_MTD=y
CONFIG_MTD_RAW_NAND=y
CONFIG_SYS_MAX_NAND_DEVICE=2
CONFIG_NAND_BRCMNAND=y
CONFIG_NAND_BRCMNAND_BCMBCA=y
CONFIG_DM_SPI_FLASH=y
CONFIG_UBI_SILENCE_MSG=y
CONFIG_BAUDRATE=1500000
CONFIG_SPECIFY_CONSOLE_INDEX=y
CONFIG_CONS_INDEX=0
CONFIG_DM_SERIAL=y
CONFIG_SERIAL_SEARCH_ALL=y
CONFIG_PL01X_SERIAL=y
CONFIG_SYSRESET=y
CONFIG_SYSRESET_WATCHDOG=y
CONFIG_WDT_BCM6345=y
CONFIG_TPL_WDT=y
CONFIG_PANIC_HANG=y
```

## release/src-rt-5.04behnd.4916/bootloaders/u-boot-2024.04/configs/bcm968880_xip_defconfig
```kconfig
CONFIG_ARM=y
CONFIG_ENABLE_ARM_SOC_BOOT0_HOOK=y
# CONFIG_ARM64_SUPPORT_AARCH32 is not set
CONFIG_ARCH_BCMBCA=y
CONFIG_SYS_MALLOC_F_LEN=0x8000
CONFIG_BCM68880=y
CONFIG_BCMBCA_DDRC=y
CONFIG_BCMBCA_DDR_LOADADDR=0x82060000
CONFIG_BOOT_BLOB_JTAG_LOAD_MAX_DDR_SIZE=0x5000
CONFIG_BCMBCA_HTTPD=y
CONFIG_BCMBCA_NO_SMC_BOOT=y
CONFIG_ARM_A55=y
CONFIG_BCMBCA_BOARD_SPECIFIC_DT=y
CONFIG_BCM_BOOTSTATE=y
CONFIG_TARGET_BCM968880=y
CONFIG_SPL_LIBCOMMON_SUPPORT=y
CONFIG_SPL_LIBGENERIC_SUPPORT=y
CONFIG_NR_DRAM_BANKS=1
CONFIG_DEFAULT_DEVICE_TREE="bcm968880"
CONFIG_SPL_TEXT_BASE=0x82000000
CONFIG_SPL_MMC=y
CONFIG_TPL_LDSCRIPT="arch/arm/cpu/armv8/u-boot.lds"
CONFIG_TPL_TEXT_BASE=0x05000000
CONFIG_TPL_LIBCOMMON_SUPPORT=y
CONFIG_TPL_LIBGENERIC_SUPPORT=y
CONFIG_TPL_SYS_MALLOC_F_LEN=0x80000
CONFIG_SPL_SYS_MALLOC_F_LEN=0x2000
CONFIG_SPL=y
CONFIG_SPL_LIBDISK_SUPPORT=y
CONFIG_TPL_MAX_SIZE=1048576
CONFIG_ENV_VARS_UBOOT_CONFIG=y
CONFIG_FIT=y
CONFIG_FIT_VERBOSE=y
CONFIG_SUPPORT_RAW_INITRD=y
CONFIG_OF_SYSTEM_SETUP=y
CONFIG_LOG=y
CONFIG_DISPLAY_BOARDINFO_LATE=y
CONFIG_BOARD_LATE_INIT=y
CONFIG_SPL_SYS_MALLOC_SIMPLE=y
CONFIG_SYS_MMCSD_RAW_MODE_U_BOOT_USE_SECTOR=y
CONFIG_SYS_MMCSD_RAW_MODE_U_BOOT_SECTOR=0
CONFIG_SYS_MMCSD_RAW_MODE_U_BOOT_DATA_PART_OFFSET=0
CONFIG_SYS_MMCSD_RAW_MODE_U_BOOT_USE_PARTITION=y
CONFIG_SPL_ENV_SUPPORT=y
CONFIG_SPL_FS_EXT4=y
# CONFIG_SYS_MMCSD_FS_BOOT is not set
CONFIG_SPL_NAND_SUPPORT=y
CONFIG_SPL_STANDALONE=y
CONFIG_TPL=y
CONFIG_TPL_SYS_MALLOC_SIMPLE=y
CONFIG_TPL_ENV_SUPPORT=y
CONFIG_TPL_MMC=y
CONFIG_TPL_NAND_SUPPORT=y
CONFIG_HUSH_PARSER=y
# CONFIG_CMD_LZMADEC is not set
# CONFIG_CMD_UNZIP is not set
CONFIG_CMD_GPIO=y
CONFIG_CMD_GPT=y
CONFIG_CMD_GPT_RENAME=y
CONFIG_CMD_MMC=y
CONFIG_CMD_MTD=y
CONFIG_CMD_PART=y
CONFIG_CMD_WDT=y
CONFIG_CMD_PING=y
CONFIG_CMD_CACHE=y
CONFIG_CMD_RNG=y
CONFIG_CMD_FAT=y
CONFIG_CMD_FS_GENERIC=y
CONFIG_CMD_MTDPARTS=y
CONFIG_CMD_UBI=y
CONFIG_PARTITION_TYPE_GUID=y
CONFIG_ENV_IS_IN_BOOT_MAGIC=y
CONFIG_NET_RANDOM_ETHADDR=y
CONFIG_TFTP_BLOCKSIZE=1024
CONFIG_TPL_DM=y
CONFIG_CLK=y
CONFIG_SPL_CLK=y
CONFIG_TPL_CLK=y
CONFIG_MISC=y
CONFIG_SUPPORT_EMMC_BOOT=y
CONFIG_MMC_SDHCI=y
CONFIG_MMC_SDHCI_BCMBCA=y
CONFIG_MTD=y
CONFIG_UBI_SILENCE_MSG=y
CONFIG_PINCTRL=y
# CONFIG_PINCTRL_FULL is not set
CONFIG_PINCTRL_BCMBCA=y
CONFIG_DM_RNG=y
CONFIG_RNG_IPROC200=y
CONFIG_SPECIFY_CONSOLE_INDEX=y
CONFIG_CONS_INDEX=0
CONFIG_DM_SERIAL=y
CONFIG_SERIAL_SEARCH_ALL=y
CONFIG_SYS_NS16550=y
CONFIG_SYSRESET=y
CONFIG_SYSRESET_WATCHDOG=y
CONFIG_WDT_BCM6345=y
CONFIG_PANIC_HANG=y
CONFIG_LZMA=y
# CONFIG_GENERATE_SMBIOS_TABLE is not set
```

## release/src-rt-5.04behnd.4916/bootloaders/u-boot-2024.04/disk/Kconfig
```kconfig
menu "Partition Types"

config PARTITIONS
	bool
	help
	  Partition Labels (disklabels) Supported:
	  Zero or more of the following:
	  - CONFIG_MAC_PARTITION   Apple's MacOS partition table.
	  - CONFIG_DOS_PARTITION   MS Dos partition table, traditional on the
	                           Intel architecture, USB sticks, etc.
	  - CONFIG_ISO_PARTITION   ISO partition table, used on CDROM etc.
	  - CONFIG_EFI_PARTITION   GPT partition table, common when EFI is the
	                           bootloader.  Note 2TB partition limit; see
	                           disk/part_efi.c
	  - CONFIG_MTD_PARTITIONS  Memory Technology Device partition table.
	  If IDE or SCSI support is enabled (CONFIG_CMD_IDE or CONFIG_SCSI)
	  you must configure support for at least one non-MTD partition type
	  as well.

config SPL_PARTITIONS
	bool
	select SPL_SPRINTF
	select SPL_STRTO
	help
	  Enable this for base partition support in SPL. The required
	  partition table types shold be enabled separately. This adds a
	  small amount of size to SPL, typically 500 bytes.

config TPL_PARTITIONS
	bool
	select TPL_SPRINTF
	select TPL_STRTO
	help
	  Enable this for base partition support in TPL. The required
	  partition table types shold be enabled separately. This adds a
	  small amount of size to TPL, typically 500 bytes.

config MAC_PARTITION
	bool "Enable Apple's MacOS partition table"
	select PARTITIONS
	help
	  Say Y here if you would like to use device under U-Boot which
	  were partitioned on a Macintosh.

config SPL_MAC_PARTITION
	bool "Enable Apple's MacOS partition table for SPL"
	depends on SPL
	default y if MAC_PARTITION
	select SPL_PARTITIONS

config DOS_PARTITION
	bool "Enable MS Dos partition table"
	default y if BOOT_DEFAULTS
	default y if x86 || CMD_FAT || USB_STORAGE
	select PARTITIONS
	help
	  traditional on the Intel architecture, USB sticks, etc.

config SPL_DOS_PARTITION
	bool "Enable MS Dos partition table for SPL"
	depends on SPL
	default n if ARCH_MVEBU
	default n if ARCH_SUNXI
	default y if DOS_PARTITION
	select SPL_PARTITIONS

config TPL_DOS_PARTITION
	bool "Enable MS Dos partition table for TPL"
	depends on TPL
	default n if ARCH_MVEBU
	default n if ARCH_SUNXI
	default y if DOS_PARTITION
	select TPL_PARTITIONS

config ISO_PARTITION
	bool "Enable ISO partition table"
	default y if BOOT_DEFAULTS
	default y if MIPS || ARCH_TEGRA
	select PARTITIONS

config SPL_ISO_PARTITION
	bool "Enable ISO partition table for SPL"
	depends on SPL
	select SPL_PARTITIONS

config AMIGA_PARTITION
	bool "Enable AMIGA partition table"
	select PARTITIONS
	help
	  Say Y here if you would like to use device under U-Boot which
	  were partitioned under AmigaOS.

config SPL_AMIGA_PARTITION
	bool "Enable AMIGA partition table for SPL"
	depends on SPL
	default y if AMIGA_PARTITION
	select SPL_PARTITIONS

config EFI_PARTITION
	bool "Enable EFI GPT partition table"
	default y if BOOT_DEFAULTS
	default y if ARCH_TEGRA
	select PARTITIONS
	select LIB_UUID
	help
	  Say Y here if you would like to use device under U-Boot which
	  were partitioned using EFI GPT.
	  common when EFI is the bootloader.  Note 2TB partition limit;
	  see disk/part_efi.c

config EFI_PARTITION_ENTRIES_NUMBERS
	int "Number of the EFI partition entries"
	depends on EFI_PARTITION
	default 56 if ARCH_SUNXI
	default 128
	help
	  Specify the number of partition entries in the GPT. This is
	  meant to allow less than the standard specifies for devices
	  that might need to place their first-stage bootloader in the
	  middle of a regular GPT.

	  If unsure, leave at 128 entries, which is the standard
	  number.

config EFI_PARTITION_ENTRIES_OFF
        int "Offset (in bytes) of the EFI partition entries"
	depends on EFI_PARTITION
	default 0
	help
	  Specify an earliest location (in bytes) where the partition
	  entries may be located. This is meant to allow "punching a
	  hole into a device" to create a gap for an SPL, its payload
	  and the U-Boot environment.

	  If unsure, leave at 0 (which will locate the partition
	  entries at the first possible LBA following the GPT header).

config SPL_EFI_PARTITION
	bool "Enable EFI GPT partition table for SPL"
	depends on  SPL
	default n if ARCH_MVEBU
	default n if ARCH_SUNXI
	default y if EFI_PARTITION
	select SPL_PARTITIONS


config TPL_EFI_PARTITION
	bool "Enable EFI GPT partition table for TPL"
	depends on  SPL && PARTITIONS
	default y if EFI_PARTITION
	select TPL_PARTITIONS

config PARTITION_UUIDS
	bool "Enable support of UUID for partition"
	depends on PARTITIONS
	default y if BOOT_DEFAULTS
	default y if EFI_PARTITION
	select LIB_UUID
	help
	  Activate the configuration of UUID for partition

config SPL_PARTITION_UUIDS
	bool "Enable support of UUID for partition in SPL"
	depends on SPL_PARTITIONS
	default y if SPL_EFI_PARTITION
	select SPL_LIB_UUID


config TPL_PARTITION_UUIDS
	bool "Enable support of UUID for partition in TPL"
	depends on SPL && PARTITIONS
	default y if SPL_EFI_PARTITION

config PARTITION_TYPE_GUID
	bool "Enable support of GUID for partition type"
	depends on EFI_PARTITION
	help
	  Activate the configuration of GUID type
	  for EFI partition

config SPL_PARTITION_TYPE_GUID
	bool "Enable support of GUID for partition type (SPL)"
	depends on SPL_EFI_PARTITION
	help
	  Activate the configuration of GUID type
	  for EFI partition

endmenu
```
