## release/src-rt-5.04behnd.4916/bootloaders/u-boot-2024.04/arch/arm/mach-bcmbca/bcm68375/Kconfig
```kconfig
# SPDX-License-Identifier: GPL-2.0+
#
# (C) Copyright 2021 Broadcom Ltd
#

if BCM68375

config TARGET_BCM968375
	bool "Broadcom 68375 Reference Board"
	depends on ARCH_BCMBCA
	select BCMBCA_GPIO_SMC if PINCTRL_BCMBCA

config SYS_SOC
	default "bcm68375"



source "board/broadcom/bcmbca/Kconfig"

endif
```

## release/src-rt-5.04behnd.4916/bootloaders/u-boot-2024.04/arch/arm/mach-bcmbca/bcm6846/Kconfig
```kconfig
# SPDX-License-Identifier: GPL-2.0+
#
# (C) Copyright 2022 Broadcom Ltd
#

if BCM6846

config TARGET_BCM96846
	bool "Broadcom 6846 Reference Board"
	depends on ARCH_BCMBCA
	select BCMBCA_GPIO if PINCTRL_BCMBCA

config SYS_SOC
	default "bcm6846"

source "board/broadcom/bcmbca/Kconfig"

endif
```

## release/src-rt-5.04behnd.4916/bootloaders/u-boot-2024.04/arch/arm/mach-bcmbca/bcm6878/Kconfig
```kconfig
# SPDX-License-Identifier: GPL-2.0+
#
# (C) Copyright 2022 Broadcom Ltd
#

if BCM6878

config TARGET_BCM96878
	bool "Broadcom 6878 Reference Board"
	depends on ARCH_BCMBCA
	select BCMBCA_GPIO if PINCTRL_BCMBCA

config SYS_SOC
	default "bcm6878"

source "board/broadcom/bcmbca/Kconfig"

endif
```
