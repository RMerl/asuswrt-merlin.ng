## release/src-rt-5.04behnd.4916/bcmdrivers/broadcom/char/gpon/Kconfig.autodetect
```kconfig
config BCM_GPON
    tristate "Support for GPON"
    depends on BCM96858 || BCM963158 || BCM96856 || BCM96855 || BCM96888 || BCM96813 || BCM968880 || BCM96837 || BCM968375

config BCM_NGPON
    tristate "Support for XGPON/XGS/NGPON2 stack"
    depends on BCM96858 || BCM96856 || BCM963158 || BCM96855 || BCM96888 ||BCM96813 || BCM968880 || BCM96837 || BCM968375

config BCM_BUILD_NGPON_AMD2
    bool "989.3AMD2 / 9807.1AMD1 support"
    depends on (BCM96858 || BCM96856 || BCM963158 || BCM96855 || BCM96888 || BCM96813 || BCM968880 || BCM96837 || BCM968375)
    default y

config BCM_MAX_GEM_PORTS
    int "Number of Gem Ports"
    depends on BCM_GPON
    range 32 256
    default 32

config BCM_GPON_IMPL
    int "Implementation index for GPON"
    depends on BCM_GPON

config BCM_GPON_STACK
    tristate 'Support for GPON Stack Driver'
    depends on BCM96858 || BCM963158 || BCM6855 || BCM96888 || BCM96813 || BCM968880 || BCM96837 || BCM968375
    help
      Say 'M' to include support for GPON Stack driver.
      Static compile not supported.
```

## release/src-rt-5.04behnd.4916/bcmdrivers/broadcom/char/rng_shim/Kconfig.autodetect
```kconfig
config BCM_RNG_SHIM
	tristate "RNG Shim Driver"
	default n

config BCM_RNG_SHIM_IMPL
	int "Implementaion version of RNG Shim"
	depends on BCM_RNG_SHIM
	default 1
```

## release/src-rt-5.04behnd.4916/bcmdrivers/opensource/char/kqoe/Kconfig.autodetect
```kconfig
config BCM_KQOE
	tristate "Support Kernel Quality of Experience Manager"

config BCM_KQOE_IMPL
	int "Implementation index for KQOE module"
	depends on BCM_KQOE
	default 1
```

## release/src-rt-5.04behnd.4916/bcmdrivers/opensource/char/tc/Kconfig.autodetect
```kconfig
config BCM_TC
	tristate "TC kernel driver"
	default m

config BCM_TC_IMPL
	int "Implementaion version of tc driver"
	depends on BCM_TC
	default 1

config BRCM_TC_QCONF
	tristate "BRCM TC queue config"
	depends on BCM_TC
	default n
```

## release/src-rt-5.04behnd.4916/bcmdrivers/opensource/misc/button/Kconfig.autodetect
```kconfig
config BCM_BUTTON
	bool "Broadcom BCA Board Button driver"
	depends on BCM_BCA_EXTINTR || BCM_BCA_GPIO
	default n
	help
	  Add the BCM BCA External Interrup support.

config BCM_BUTTON_IMPL
	int "Implementation index for BCA Board Button module"
	depends on BCM_BUTTON
	default 1
```

## release/src-rt-5.04behnd.4916/bcmdrivers/opensource/misc/ftpm/Kconfig.autodetect
```kconfig
config BCM_FTPM_SMC_DRV
	bool "Broadcom TPM Driver for SMC based fTPM"
	depends on BRCM_SMC_BASED
	default n
	help
	  Add support for Broadcom SMC based fTPM device

config BCM_FTPM_SMC_DRV_IMPL
	int "Implementation index for Broadcom TPM Driver for SMC based fTPM"
	depends on BCM_FTPM_SMC_DRV
	default 1 
```

## release/src-rt-5.04behnd.4916/bcmdrivers/opensource/misc/ubus/Kconfig.autodetect
```kconfig
config BCM_UBUS
	bool "Broadcom BCA UBUS driver"
	default y if !BRCM_IKOS && !BRCM_SMC_BOOT  && !BCM_QEMU_SIM
	default y if BRCM_IKOS && !BRCM_QEMU && !BRCM_SMC_BOOT && (BCM94912 || BCM96756 || BCM96765 || BCM96888 || BCM96813 || BCM968880 || BCM96837 || BCM96766 || BCM96764)
	help
	  Broadcom BCA UBUS driver

config BCM_UBUS_IMPL
	int "Implementation index for BCA UBUS driver"
	depends on BCM_UBUS
	default 1
	help
	  Broadcom BCA UBUS driver implentation index. Index 1 for UBUS 4 and
	  Index 2 for UBUS 3

config BCM_FPM_COHERENCY_EXCLUDE
	bool "Keep FPM pool memory area non-coherent"
	default n
	depends on (BCM_GLB_COHERENCY && BCM96858)

config BCM_UBUS_DECODE_REMAP
	bool "Remap UBUS decode window"
	default n
	depends on !BRCM_QEMU && !BRCM_SMC_BOOT

config BCM_UBUS4_DCM
	bool "UBUS4 Dynamic Clock Management"
	default n
	depends on !BRCM_IKOS && !BRCM_SMC_BOOT
```

## release/src-rt-5.04behnd.4916/bcmdrivers/opensource/misc/voice/pwrctl/Kconfig.autodetect
```kconfig
config BCM_VOICE_PWRCTL
	bool "Broadcom Voice SLIC power On/Off"
	default n
	help
	  Enable voice SLIC power control on Broadcom DSL/PON SoCs

config BCM_VOICE_PWRCTL_IMPL
	int "Implementation index for voice SLIC power control"
	depends on BCM_VOICE_PWRCTL
	default 1
	
```

## release/src-rt-5.04behnd.4916/bcmdrivers/opensource/net/bnl/Kconfig.autodetect
```kconfig
config BCM_BNL
	tristate "Broadcom Network Latency Monitoring"
	depends on NF_CONNTRACK
	default m 
config BCM_BNL_IMPL
	int "BNL Implementation Selection"
	depends on BCM_BNL
	default 2 if BCM_SCORE
	default 1 
```

## release/src-rt-5.04behnd.4916/bcmdrivers/opensource/net/hwf/Kconfig.autodetect
```kconfig
config BCM_HW_FIREWALL
	tristate "Support for HW Firewall"
	depends on NF_CONNTRACK
	depends on BCM963146 || BCM94912 || BCM96813 || BCM968880 || BCM96837 || BCM96855 || BCM968375
	default n
config BCM_HW_FIREWALL_IMPL
	int "HW Firewall Implementation Selection"
	depends on BCM_HW_FIREWALL
	default 1
```

## release/src-rt-5.04behnd.4916/bcmdrivers/opensource/net/ovpn_dco/Kconfig.autodetect
```kconfig
config BCM_OPENVPN_DCO
	tristate "Support for OpenVPN Data Channel Offload"
	select OVPN_DCO_V2
	default n

config BCM_OPENVPN_DCO_IMPL
	int "Implementation index for BCM_OPENVPN_DCO"
	depends on BCM_OPENVPN_DCO
	default 1

source "../../bcmdrivers/opensource/net/ovpn_dco/impl1/ovpn-dco-0.2.20240712/drivers/net/Kconfig"
```

## release/src-rt-5.04behnd.4916/bcmdrivers/opensource/net/score/Kconfig.autodetect
```kconfig
config BCM_SCORE
	tristate "Statistics Collection Offload Reporting Engine"
	depends on NF_CONNTRACK
	depends on BCM968880 || BCM94912 || BCM96756 || BCM96765 || BCM96766 || BCM96764 || BCM96764L || BCM963146 || BCM96813  || BCM96837 || BCM96858 ||  BCM96856 ||  BCM96855 ||  BCM963158 || BCM968375

config BCM_SCORE_IMPL
	int "SCORE Implementation Selection"
	depends on BCM_SCORE
	default 1

config BCM_SCORE_LOAD
	tristate "Autoload score driver"
	depends on BCM_SCORE
	default n
```
