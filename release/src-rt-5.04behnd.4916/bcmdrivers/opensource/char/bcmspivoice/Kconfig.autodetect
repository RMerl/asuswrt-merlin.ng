## release/src-rt-5.04behnd.4916/bcmdrivers/opensource/char/bcmspivoice/Kconfig.autodetect
```kconfig
config BCM_SPIDEV_VOICE
	bool "SPI voice device driver"
	help
	  SPI voice kernel driver

config BCM_SPIDEV_VOICE_IMPL
	int "Implementation index for SPI voice driver"
	depends on BCM_SPIDEV_VOICE
	default 1
```

## release/src-rt-5.04behnd.4916/bcmdrivers/opensource/char/fpi/Kconfig.autodetect
```kconfig
config BCM_FPI
	tristate "Support for Broadcom Flow Provisioning Interface"
	depends on BCM_ACCEL && !BCM_PKFLOW
	depends on BCM94912 || BCM96813

config BCM_FPI_IMPL
	int "BCM Flow Provisioning Interface Implementation Selection"
	depends on BCM_FPI
	default 1

config BCM_FPI_BLOG
	tristate "BCM FPI Control Dataplane via Blog (sample)"
	depends on BCM_FPI
	default n
```

## release/src-rt-5.04behnd.4916/bcmdrivers/opensource/char/ndi/Kconfig.autodetect
```kconfig
config BCM_NDI
	tristate "Support Network Device Identification"

config BCM_NDI_IMPL
	int "Implementation index for NDI module"
	depends on BCM_NDI
	default 1
```

## release/src-rt-5.04behnd.4916/bcmdrivers/opensource/char/opticaldet/Kconfig.autodetect
```kconfig
config BCM_OPTICALDET
	tristate "Support for optical device detection"
	depends on BCM_SFP
	default m

config BCM_OPTICALDET_IMPL
	int "Implementation index for BRCM optical device detection"
	depends on BCM_OPTICALDET
	default 2
```

## release/src-rt-5.04behnd.4916/bcmdrivers/opensource/char/pcap/Kconfig.autodetect
```kconfig
config BCM_PCAP
	tristate "Packet capture utility from kernel driver"
	depends on NF_CONNTRACK
	default y

config BCM_PCAP_IMPL
	int "Implementaion version of pcap driver"
	depends on BCM_PCAP
	default 1
```

## release/src-rt-5.04behnd.4916/bcmdrivers/opensource/char/pcm/Kconfig.autodetect
```kconfig
config BCM_PCM
	bool "PCM verification test"
	help
	   Support for PCM verification test

config BCM_PCM_IMPL
	int "Implementation index for voice dsphal driver"
	depends on BCM_PCM
	default 1
```

## release/src-rt-5.04behnd.4916/bcmdrivers/opensource/char/smtc/Kconfig.autodetect
```kconfig
config BCM_SMTC
        tristate "Support SMTC PMD driver"
        depends on BCM_SFP
        default m

config BCM_SMTC_IMPL
        int "Implementation index for SMTC PMD driver"
        depends on BCM_SMTC
        default 1
```

## release/src-rt-5.04behnd.4916/bcmdrivers/opensource/char/synce_holdover/Kconfig.autodetect
```kconfig
config BCM_SYNCE_HOLDOVER
        tristate "Support SYNCE_HOLDOVER driver"
        depends on BCM96888 || BCM968880 || BCM96837
        default m

config BCM_SYNCE_HOLDOVER_IMPL
        int "Implementation index for SYNCE_HOLDOVER driver"
        depends on BCM_SYNCE_HOLDOVER
        default 1
```

## release/src-rt-5.04behnd.4916/bcmdrivers/opensource/misc/bca_extintr/Kconfig.autodetect
```kconfig
config BCM_BCA_EXTINTR
	bool "Broadcom BCA External Interrup Driver"
	depends on BCM_BCA_GPIO
	default n
	help
	  Add the BCM BCA External Interrup support.

config BCM_BCA_EXTINTR_IMPL
	int "Implementation index for BCA External Interrup module"
	depends on BCM_BCA_EXTINTR
	default 1
```

## release/src-rt-5.04behnd.4916/bcmdrivers/opensource/misc/bca_gpio/Kconfig.autodetect
```kconfig
config BCM_BCA_GPIO
	bool "Broadcom BCA GPIO Driver"
	depends on BCM_BCA_PINCTRL
	select GPIOLIB
	select GPIO_SYSFS
	select OF_GPIO
	select GPIO_DEVRES
	select GPIO_GENERIC_PLATFORM
	default n
	help
	  Add the BCM BCA GPIO support.

config BCM_BCA_GPIO_IMPL
	int "Implementation index for BCA GPIO module"
	depends on BCM_BCA_GPIO
	default 1
```

## release/src-rt-5.04behnd.4916/bcmdrivers/opensource/misc/bca_led_ctrl/Kconfig.autodetect
```kconfig
config BCM_BCA_LED
	bool "Broadcom BCA LED Controller Driver"
	depends on BCM_BCA_PINCTRL
	depends on BCM_BCA_GPIO
	select NEW_LEDS
	select LEDS_CLASS
	default n
	help
	  Add the BCM BCA LED support.

config BCM_BCA_LED_IMPL
	int "Implementation index for BCA LED module"
	depends on BCM_BCA_LED
	default 1
```

## release/src-rt-5.04behnd.4916/bcmdrivers/opensource/misc/bcmdsl/Kconfig.autodetect
```kconfig
config BCM_DSL_DT
	bool "DSL Driver Open Portion"
	default n
	depends on BCM963158 || BCM963178 || BCM963146 || BCM963138 || BCM963148
	help
	  This driver parses the DSL configuration and provide API to the core DSL
	  driver

config BCM_DSL_DT_IMPL
	int "Implementation index for DSL driver open portion"
	depends on BCM_DSL_DT
	default 1
```

## release/src-rt-5.04behnd.4916/bcmdrivers/opensource/misc/bcmgps/Kconfig.autodetect
```kconfig
config BCM_GPS
	bool "Broadcom GPS driver"
	depends on SPI_SPIDEV
	default n
	help
	  Broacom GPS driver.

config BCM_GPS_IMPL
	int "Implementation index for Broadcom GPS driver"
	depends on BCM_GPS
	default 1
```

## release/src-rt-5.04behnd.4916/bcmdrivers/opensource/misc/bcmsfp/Kconfig.autodetect
```kconfig
config BCM_SFP
	bool "Broadcom BCA SFP/TRX driver"
	depends on I2C
	default n
	help
	  BCMBCA SFP/TRX driver.

config BCM_SFP_IMPL
	int "Implementation index for Broadcom BCA SFP/TRX driver"
	depends on BCM_SFP
	default 1
```

## release/src-rt-5.04behnd.4916/bcmdrivers/opensource/misc/bmu/Kconfig.autodetect
```kconfig
config BCM_BMU
	bool "Broadcom BCA Battery Management Unit driver"
	default n
	help
	  Add the BCM BMU support.

config BCM_BMU_IMPL
	int "Implementation index for BCA BMU driver"
	depends on BCM_BMU
	default 1
```

## release/src-rt-5.04behnd.4916/bcmdrivers/opensource/misc/cpuidle/Kconfig.autodetect
```kconfig
config BCM_ARM_CPUIDLE
	bool "Broadcom cpuidle driver"
	default n
	select CPU_IDLE if !BCM963148
	help
	  Add Broadcom ARM and ARM64 cpuidle support

config BCM_ARM_CPUIDLE_IMPL
	int "Implementation index for Broadcom cpuidle driver"
	depends on BCM_ARM_CPUIDLE
	default 1

config BCM_CPUIDLE_CLK_DIVIDER
	bool "Support for CPU Clock Divider in CPUIDLE"
	default n

config BCM_B15_CPUIDLE
	bool "Broadcom B15 CPUIDLE driver"
	default n
	help
	  Add Broadcom B15 CPUIDLE support
```

## release/src-rt-5.04behnd.4916/bcmdrivers/opensource/misc/dgasp/Kconfig.autodetect
```kconfig
config BCM_DGASP_DRV
	bool "Broadcom BCA Dying Gasp driver"
	default n
	help
	  Add the BCM BCA Dying Gasp support.

config BCM_DGASP_DRV_IMPL
	int "Implementation index for BCA Dying Gasp module"
	depends on BCM_DGASP_DRV
	default 1
```

## release/src-rt-5.04behnd.4916/bcmdrivers/opensource/misc/dqm/Kconfig.autodetect
```kconfig
config BCM_DQM_DRV
	bool "Broadcom BCA DQM driver"
        depends on BCM_FPM_DRV
	default n
	help
	  Add the BCM BCA DQM support.

config BCM_DQM_DRV_IMPL
	int "Implementation index for BCA DQM module"
	depends on BCM_DQM_DRV
	default 1
```

## release/src-rt-5.04behnd.4916/bcmdrivers/opensource/misc/ext_pwr_ctrl/Kconfig.autodetect
```kconfig
config BCM_EXT_PWR_CTRL_DRV
	bool "Broadcom BCA EXT PWR CTRL driver"
	depends on BCM_RPC_SERVICES_DRV	
	default n
	help
	  Add the BCM EXT PWR CTRL support.

config BCM_EXT_PWR_CTRL_DRV_IMPL
	int "Implementation index for BCA EXT PWR CTRL module"
	depends on BCM_EXT_PWR_CTRL_DRV 
	default 1
```

## release/src-rt-5.04behnd.4916/bcmdrivers/opensource/misc/fpm/Kconfig.autodetect
```kconfig
config BCM_FPM_DRV
	bool "Broadcom BCA Dying FPM driver"
	default n
	help
	  Add the BCM BCA Dying FPM support.

config BCM_FPM_DRV_IMPL
	int "Implementation index for BCA Dying FPM module"
	depends on BCM_FPM_DRV
	default 1
```

## release/src-rt-5.04behnd.4916/bcmdrivers/opensource/misc/itc_rpc/Kconfig.autodetect
```kconfig
config BCM_ITC_RPC_DRV
	bool "Broadcom BCA ITC_RPC driver"
	default n
	help
	  Add the BCM BCA ITC_RPC support.

config BCM_ITC_RPC_DRV_IMPL
	int "Implementation index for BCA ITC_RPC module"
	depends on BCM_ITC_RPC_DRV
	default 1


config BCM_ITC_RPC_DQM
	bool "ITC RPC DQM Backend Support"
	depends on BCM_ITC_RPC_DRV && BCM_DQM_DRV
	default y
```

## release/src-rt-5.04behnd.4916/bcmdrivers/opensource/misc/memc/Kconfig.autodetect
```kconfig
config BCM_MEMC
	bool "Broadcom BCA memory controller driver"
	default y
	help
	  Provide limited access to the memory controller.

config BCM_MEMC_IMPL
	int "Implementation index for BCA MEMC driver"
	depends on BCM_MEMC
	default 1
```

## release/src-rt-5.04behnd.4916/bcmdrivers/opensource/misc/otp/Kconfig.autodetect
```kconfig
config BCM_OTP_DRV
	bool "Broadcom BCA OTP driver"
	default n
	help
	  Add the BCM BCA OTP support.

config BCM_OTP_DRV_IMPL
	int "Implementation index for BCA OTP module"
	depends on BCM_OTP_DRV
	default 2 if BCM968880
	default 2 if BCM96837
	default 1 
```

## release/src-rt-5.04behnd.4916/bcmdrivers/opensource/misc/pmc/Kconfig.autodetect
```kconfig
config BCM_PMC
	bool "Broadcom 63xx PMC driver"
	default n

config BCM_PMC_IMPL
	int "Implementation index for PMC driver"
	depends on BCM_PMC
	default 2 if BRCM_SMC_BOOT
	default 1 
	help
	  Broadcom PMC driver implentation index. Index 2 for System Management Controller boot

config BCM_PMC_AUX
    bool "pmc aux functionality"

config PMC_PCM_V1
	bool "pmc pcm v1"

config PMC_PCM_V2
    bool "pmc pcm v2"
```

## release/src-rt-5.04behnd.4916/bcmdrivers/opensource/misc/rpc_services/Kconfig.autodetect
```kconfig
config BCM_RPC_SERVICES_DRV
	bool "Broadcom BCA RPC_SERVICES driver"
	depends on BCM_ITC_RPC_DRV	
	default n
	help
	  Add the BCM BCA RPC_SERVICES support.

config BCM_RPC_SERVICES_DRV_IMPL
	int "Implementation index for BCA ITC_RPC module"
	depends on BCM_RPC_SERVICES_DRV 
	default 1
```
