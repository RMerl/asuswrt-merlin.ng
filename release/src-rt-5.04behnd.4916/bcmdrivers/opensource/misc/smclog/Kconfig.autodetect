## release/src-rt-5.04behnd.4916/bootloaders/u-boot-2019.07/arch/arm/mach-bcmbca/bcm6837/Kconfig
```kconfig
# SPDX-License-Identifier: GPL-2.0+
#
# (C) Copyright 2021 Broadcom Ltd
#

if BCM6837

config TARGET_BCM96837
	bool "Broadcom 6837 Reference Board"
	depends on ARCH_BCMBCA

config SYS_SOC
	default "bcm6837"

if BCMBCA_DDRC
config BCMBCA_LPDDR4_DEF_MCBSEL
    hex "default LPDDR4 mcb selector value"
    default 0x1001322

config BCMBCA_DDR4_DEF_MCBSEL
    hex "default DDR4 mcb selector value"
    default 0x141635

config BCMBCA_DDR_DEFAULT
	hex "default ddr mcb selector"
	default BCMBCA_DDR4_DEF_MCBSEL
endif

source "board/broadcom/bcmbca/Kconfig"

endif
```

## release/src-rt-5.04behnd.4916/bootloaders/u-boot-2019.07/arch/arm/mach-bcmbca/bcm6858/Kconfig
```kconfig
# SPDX-License-Identifier: GPL-2.0+
#
# (C) Copyright 2019 Broadcom Ltd
#

if BCM6858

config TARGET_BCM96858
	bool "Broadcom 6858 Reference Board"
	depends on ARCH_BCMBCA

config SYS_SOC
	default "bcm6858"

if BCMBCA_DDRC
config BCMBCA_DDR_DEF_MCBSEL
	hex "default DDR3 mcb selector value"
	default 0x527
endif

source "board/broadcom/bcmbca/Kconfig"

endif
```

## release/src-rt-5.04behnd.4916/bootloaders/u-boot-2019.07/arch/arm/mach-bcmbca/bcm6888/Kconfig
```kconfig
# SPDX-License-Identifier: GPL-2.0+
#
# (C) Copyright 2021 Broadcom Ltd
#

if BCM6888

config TARGET_BCM96888
	bool "Broadcom 6888 Reference Board"
	depends on ARCH_BCMBCA

config SYS_SOC
	default "bcm6888"

if BCMBCA_DDRC
config BCMBCA_LPDDR4_DEF_MCBSEL
	hex "default LPDDR4 mcb selector value"
	default 0x1001322

config BCMBCA_LPDDR5_DEF_MCBSEL
	hex "default LPDDR5 mcb selector value"
	default 0x1005329

config BCMBCA_DDR_DEFAULT
    hex "default ddr mcb selector"
    default BCMBCA_LPDDR4_DEF_MCBSEL
endif

source "board/broadcom/bcmbca/Kconfig"

endif
```
