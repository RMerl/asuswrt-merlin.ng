;**************************************************************
;              Attach script for BCM6846   
;      JTAG Scan-chain for 6846 is
;           TDI->MEMC(5)->DAP(4)->LV(32)->TDO                                  
;**************************************************************



AREA
AREA.CLEAR
SYSTEM.RESET
SYSTEM.JTAGCLOCK 20MHz

jtag.lock
jtag.pin.enable
jtag.pin.TDI LOW
jtag.SHIFTTMS 1 1 1 1 1 1 1 0 1 1 0 0
jtag.SHIFTTDI %Long 0x0 0x0 
jtag.shifttdi %Long 0xffffffff 0xffffffff
&a=jtag.SHIFT() 
&b=&a&0xfffff
jtag.SHIFTTMS 1 1 1 1 1 1 1 1 1
jtag.unlock

if (&b>0xfff00) 
(
	PRINT %ERROR   "ERROR: Scan chain is LV-only"
	AREA.select  A000
	PRINT %ERROR   "ERROR: Please remove pull-up from JTAG_CS0 pin to configure Full scan chain"
	ENDDO
)
else
(
	AREA.select
	print "+++++++++++++++++++++++ Full scan chain +++++++++++++++++++++++++++++++++++"
	print "             TDI->MEMC(5)->DAP(4)->LV(32)->TDO"
	print "+++++++++++++++++++++++++++++++++++++++++++++++++++++++++++++++++++++++++++"
	print "  "
	
	SYStem.CONFIG.DAPIRPOST  5.
	SYStem.CONFIG.DAPIRPRE   32.
	SYStem.CONFIG.DAPDRPOST  1.
	SYStem.CONFIG.DAPDRPRE   1.

	SYSTEM.CPU CORTEXA7MPCORE
	SYSTEM.CONFIG.CORENUMBER 2
	SYSTEM.CONFIG.CORE 1
	SYSTEM.CONFIG.DEBUGACCESSPORT 0
	SYStem.CONFIG AXIACCESSPORT  1

	SYSTEM.CONFIG.CTIBASE  0x81053000	
	SYSTEM.CONFIG.COREBASE 0x81810000	
	SYStem.CONFIG.BMC.Base 0x81811000

	CORE.ASSIGN 1	

	SYStem.option TRST     OFF 
	SYStem.option ENRESET  OFF

	print "             JTAG ATTACH CORE 0"
	print "   "
	print "+++++++++++++++++++++++++++++++++++++++++++++++++++++++++++++++++++++++++++"

	SYSTEM.MODE NODEBUG
	SYSTEM.MODE ATTACH
	ENDDO
)
ENDDO