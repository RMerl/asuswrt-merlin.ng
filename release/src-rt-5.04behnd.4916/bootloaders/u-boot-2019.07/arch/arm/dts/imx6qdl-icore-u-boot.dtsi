// SPDX-License-Identifier: GPL-2.0+
/*
 * Copyright (C) 2018 Jagan Teki <jagan@amarulasolutions.com>
 */

#include "imx6qdl-u-boot.dtsi"

&usdhc1 {
	u-boot,dm-spl;
};

&pinctrl_usdhc1 {
	u-boot,dm-spl;
};

&pinctrl_usdhc3 {
	u-boot,dm-spl;
};
