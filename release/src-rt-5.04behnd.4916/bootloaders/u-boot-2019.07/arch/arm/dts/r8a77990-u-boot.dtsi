// SPDX-License-Identifier: GPL-2.0
/*
 * Device Tree Source extras for U-Boot on RCar R8A77990 SoC
 *
 * Copyright (C) 2018 Marek Vasut <marek.vasut@gmail.com>
 */

#include "r8a779x-u-boot.dtsi"

/ {
	soc {
		rpc: rpc@0xee200000 {
			compatible = "renesas,rpc-r8a77990", "renesas,rpc";
			reg = <0 0xee200000 0 0x100>, <0 0x08000000 0 0>;
			clocks = <&cpg CPG_MOD 917>;
			bank-width = <2>;
			status = "disabled";
		};
	};
};
