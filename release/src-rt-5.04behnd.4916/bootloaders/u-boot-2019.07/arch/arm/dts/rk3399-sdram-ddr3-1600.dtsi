// SPDX-License-Identifier: GPL-2.0+
/*
 * (C) 2017 Theobroma Systems Design und Consulting GmbH
 */

&dmc {
        rockchip,sdram-params = <
		0x1
		0xa
		0x3
		0x2
		0x1
		0x0
		0xf
		0xf
		1
		0x80151015
		0x14040902
		0x00000002
		0x00006346
		0x0000004c
		0x00000000
		0x1
		0xa
		0x3
		0x2
		0x1
		0x0
		0xf
		0xf
		1
		0x80151015
		0x14040902
		0x00000002
		0x00006346
		0x0000004c
		0x00000000
		800
		3
		2
		9
		1
		0x00000600
		0x00000000
		0x00000000
		0x00000000
		0x00000000
		0x00000008
		0x00000000
		0x00000000
		0x00000000
		0x00000008
		0x00000000
		0x00000000
		0x00000000
		0x00000008
		0x00000000
		0x00000000
		0x01000000
		0x00000000
		0x00000101
		0x00020100
		0x00027100
		0x00061a80
		0x02000200
		0x08160200
		0x00081600
		0x04000816
		0x26050004
		0x1c0b061c
		0x1c260500
		0x001c0b06
		0x061c2605
		0x06001c0b
		0x00000c04
		0x0400db60
		0x0c040605
		0x0400db60
		0x0c040605
		0x0400db60
		0x02030005
		0x0b0c0b00
		0x000c0b0c
		0x14000a0a
		0x00000a0a
		0x00010000
		0x03171717
		0x000b0b0b
		0x00000000
		0x03010000
		0x18580118
		0x18580118
		0x18580118
		0x00000000
		0x00050005
		0x00140005
		0x00140014
		0x00000000
		0x00000000
		0x00000000
		0x00000000
		0x02000000
		0x02000120
		0x02000120
		0x00000120
		0x00000000
		0x00000000
		0x00000000
		0x00000000
		0x00000000
		0x00000000
		0x00000301
		0x00000001
		0x00000000
		0x00000000
		0x01000000
		0x80104002
		0x00040003
		0x00040005
		0x00030000
		0x00050004
		0x00000004
		0x00040003
		0x00040005
		0x61600000
		0x000030b0
		0x30b06160
		0x61600000
		0x000030b0
		0x00000000
		0x00000000
		0x00000000
		0x00000000
		0x00000000
		0x08080800
		0x00080808
		0x00030200
		0x00040700
		0x00000302
		0x02000407
		0x00000003
		0x00030f04
		0x00070004
		0x00000000
		0x00000000
		0x00000000
		0x00000000
		0x00000000
		0x00000000
		0x00010000
		0x00010000
		0x20040020
		0x00200400
		0x01000400
		0x00000b80
		0x00000000
		0x00000001
		0x00000002
		0x0000000e
		0x00000000
		0x00000000
		0x00000000
		0x00000000
		0x00000000
		0x00a00000
		0x00c80050
		0x00c80000
		0x005000a0
		0x000000c8
		0x00a000c8
		0x00c80050
		0x00c80000
		0x00000000
		0x00000000
		0x00000000
		0x00420c70
		0x0c700018
		0x00180042
		0x00420c70
		0x00000018
		0x00000000
		0x00000000
		0x00000000
		0x00000000
		0x00000000
		0x00000000
		0x00000000
		0x00000000
		0x00000000
		0x00420c70
		0x0c700018
		0x00180042
		0x00420c70
		0x00000018
		0x00000000
		0x00000000
		0x00000000
		0x00000000
		0x00000000
		0x00000000
		0x00000000
		0x00000000
		0x00000000
		0x01000000
		0x00000000
		0x00000000
		0x18151100
		0x0000000c
		0x00000000
		0x00000000
		0x00000000
		0x00000000
		0x00000000
		0x00000000
		0x00000000
		0x00000000
		0x00000000
		0x00000000
		0x00000000
		0x00000000
		0x00000000
		0x00020003
		0x00400100
		0x00000000
		0x01000200
		0x00000040
		0x00020000
		0x00400100
		0x00000000
		0x00000000
		0x00000000
		0x01010100
		0x00000202
		0x0a000001
		0x01000f0f
		0x00000000
		0x00000000
		0x00010003
		0x00000c03
		0x00000000
		0x00000000
		0x01000000
		0x00010000
		0x00000001
		0x00000000
		0x00000000
		0x00000000
		0x00000000
		0x00000000
		0x00000000
		0x00000000
		0x00000000
		0x00000000
		0x00010000
		0x07070702
		0x01010606
		0x00000001
		0x03030300
		0x03080808
		0x03050303
		0x03050303
		0x00050303
		0x00020202
		0x00000000
		0x00000000
		0x00000000
		0x00000000
		0x0d000001
		0x00010028
		0x00010000
		0x00000003
		0x00000000
		0x00000000
		0x00000000
		0x00000000
		0x00000000
		0x00000000
		0x00000000
		0x00000000
		0x00010100
		0x01000000
		0x00000001
		0x00000303
		0x00000000
		0x00000000
		0x00000000
		0x00000000
		0x00000000
		0x00000000
		0x00000000
		0x00000000
		0x00000000
		0x00000000
		0x00000000
		0x00000000
		0x00000000
		0x00000000
		0x00000000
		0x000556aa
		0x000aaaaa
		0x000aa955
		0x00055555
		0x000b3133
		0x0004cd33
		0x0004cecc
		0x000b32cc
		0x00010300
		0x03000100
		0x00000000
		0x00000000
		0x00000000
		0x00000000
		0x00000000
		0x00000000
		0x00000000
		0x00000000
		0x00ffff00
		0x15150000
		0x08000015
		0x000030b0
		0x00000200
		0x00000200
		0x00000200
		0x00000200
		0x000030b0
		0x0001e6e0
		0x30b00709
		0x00000200
		0x00000200
		0x00000200
		0x00000200
		0x000030b0
		0x0001e6e0
		0x30b00709
		0x00000200
		0x00000200
		0x00000200
		0x00000200
		0x000030b0
		0x0001e6e0
		0x02020709
		0x03030202
		0x00000014
		0x00000000
		0x00000000
		0x00001403
		0x00000000
		0x00000000
		0x00000000
		0x00030000
		0x00060018
		0x00060018
		0x00060018
		0x00000000
		0x00000000
		0x01000000
		0x02060206
		0x00050206
		0x00000000
		0x00000000
		0x00000000
		0x00000000
		0x00000000
		0x00000000
		0x00000000
		0x00000000
		0x01000100
		0x01010101
		0x01000101
		0x01000100
		0x00010001
		0x00010002
		0x00020100
		0x00000002
		0x00000600
		0x00000000
		0x00006160
		0x000030b0
		0x00006160
		0x000030b0
		0x00006160
		0x30b030b0
		0x00000200
		0x00000200
		0x00000200
		0x00000200
		0x000030b0
		0x00000200
		0x00000200
		0x00000200
		0x00000200
		0x000030b0
		0x00000200
		0x00000200
		0x00000200
		0x00000200
		0x00010000
		0x00000007
		0x110f0001
		0x3c020000
		0x3fffffff
		0x3c030000
		0x1dc0ffff
		0x3c010000
		0x1dc0ffff
		0x3c000000
		0x1dc0ffff
		0x3c300400
		0x1dc7ffff
		0x3c000000
		0x00000000
		0x3c000000
		0x00000000
		0x3c000000
		0x00000000
		0x03000101
		0x00242424
		0x08160008
		0x00081600
		0x00000016
		0x18580118
		0x18580118
		0x18580118
		0x00000500
		0x00000000
		0x00000000
		0x00000000
		0x00000000
		0x00000000
		0x00000000
		0x00000000
		0x00000000
		0x04040000
		0x0d000004
		0x00000128
		0x00000000
		0x00030003
		0x00000014
		0x00000000
		0x00000000
		0x07060002
		0x07010701
		0x00060601
		0x00020001
		0x00080004
		0x00000000
		0x00000000
		0x03030300
		0x00000000
		0x00000000
		0x00000000
		0x00030300
		0x00000014
		0x00000000
		0x01010300
		0x00000000
		0x00000000
		0x01000000
		0x00000101
		0x55555a5a
		0x55555a5a
		0x55555a5a
		0x55555a5a
		0x09090001
		0x07070009
		0x02020007
		0x00000102
		0x00030000
		0x17030000
		0x00060018
		0x00060018
		0x00060018
		0x00000000
		0x00000000
		0x00000000
		0x140a0000
		0x000a000a
		0x00000a00
		0x010a000a
		0x00000100
		0x01000000
		0x00000000
		0x00000100
		0x1e1a0000
		0x10010204
		0x07070705
		0x20000202
		0x00201000
		0x00201000
		0x04041000
		0x10100100
		0x00010110
		0x004b004a
		0x1a030000
		0x0102041e
		0x34000000
		0x00000000
		0x00000000
		0x00000000
		0x00004200
		0x00000018
		0x004d4d00
		0x00180042
		0x4d000000
		0x0000424d
		0x00000018
		0x004d4d00
		0x00180042
		0x4d000000
		0x0000424d
		0x00000018
		0x004d4d00
		0x00180042
		0x4d000000
		0x0042004d
		0x00000018
		0x004d4d00
		0x00180042
		0x4d000000
		0x0000424d
		0x00000018
		0x004d4d00
		0x00180042
		0x4d000000
		0x0000424d
		0x00000018
		0x004d4d00
		0x00180042
		0x4d000000
		0x0000004d
		0x00c800c8
		0x060400c8
		0x0c060b0b
		0x1c00d92e
		0x08042000
		0x0b0b060c
		0x00000c06
		0x1c00d92e
		0x08042000
		0x0b0b060c
		0x00000c06
		0x1c00d92e
		0x08042000
		0x0200020c
		0x02000200
		0x02000200
		0x02000200
		0x02000200
		0x00000000
		0x00000000
		0x00000000
		0x00000000
		0x00000000
		0x00000000
		0x00000000
		0x00000000
		0x00000000
		0x00000000
		0x00000000
		0x00000000
		0x01000300
		0x0030b000
		0x0001e6e0
		0x000030b0
		0x0001e6e0
		0x000030b0
		0x0001e6e0
		0x08000000
		0x00000100
		0x00000000
		0x00000000
		0x00000000
		0x00000000
		0x00000001
		0x76543210
		0x0004c008
		0x00000099
		0x00000000
		0x00000000
		0x00010000
		0x01665555
		0x00665555
		0x00010f00
		0x05010200
		0x00000001
		0x001700c0
		0x00cc0001
		0x00000066
		0x00000000
		0x00000000
		0x00000000
		0x00000000
		0x00000000
		0x00000000
		0x00000000
		0x00000000
		0x04080000
		0x04080400
		0x08000000
		0x0c00c007
		0x00000100
		0x00000100
		0x55555555
		0xaaaaaaaa
		0x55555555
		0xaaaaaaaa
		0x00005555
		0x00000000
		0x00000000
		0x00000000
		0x00000000
		0x00000000
		0x00000000
		0x00000000
		0x00000000
		0x00000000
		0x00000000
		0x00000000
		0x00000000
		0x00000000
		0x00000000
		0x00000000
		0x00000000
		0x00000000
		0x00000000
		0x00000000
		0x00200000
		0x00000000
		0x00000000
		0x00000000
		0x00000000
		0x00000000
		0x00000000
		0x02800280
		0x02800280
		0x02800280
		0x02800280
		0x00000280
		0x00000000
		0x00000000
		0x00000000
		0x00000000
		0x00800000
		0x00800080
		0x00800080
		0x00800080
		0x00800080
		0x00800080
		0x00800080
		0x00800080
		0x00800080
		0x00990080
		0x00000001
		0x00000000
		0x00000000
		0x00000200
		0x00000000
		0x51313152
		0x80013130
		0x02000080
		0x00100001
		0x07054208
		0x000f0c0f
		0x01000140
		0x00000c20
		0x00000000
		0x00000000
		0x00000000
		0x00000000
		0x00000000
		0x00000000
		0x00000000
		0x00000000
		0x00000000
		0x00000000
		0x00000000
		0x00000000
		0x00000000
		0x00000000
		0x00000000
		0x00000000
		0x00000000
		0x00000000
		0x00000000
		0x00000000
		0x00000000
		0x00000000
		0x00000000
		0x00000000
		0x00000000
		0x00000000
		0x00000000
		0x00000000
		0x00000000
		0x00000000
		0x00000000
		0x00000000
		0x00000000
		0x00000000
		0x00000000
		0x00000000
		0x00000000
		0x76543210
		0x0004c008
		0x00000099
		0x00000000
		0x00000000
		0x00010000
		0x01665555
		0x00665555
		0x00010f00
		0x05010200
		0x00000001
		0x001700c0
		0x00cc0001
		0x00000066
		0x00000000
		0x00000000
		0x00000000
		0x00000000
		0x00000000
		0x00000000
		0x00000000
		0x00000000
		0x04080000
		0x04080400
		0x08000000
		0x0c00c007
		0x00000100
		0x00000100
		0x55555555
		0xaaaaaaaa
		0x55555555
		0xaaaaaaaa
		0x00005555
		0x00000000
		0x00000000
		0x00000000
		0x00000000
		0x00000000
		0x00000000
		0x00000000
		0x00000000
		0x00000000
		0x00000000
		0x00000000
		0x00000000
		0x00000000
		0x00000000
		0x00000000
		0x00000000
		0x00000000
		0x00000000
		0x00000000
		0x00200000
		0x00000000
		0x00000000
		0x00000000
		0x00000000
		0x00000000
		0x00000000
		0x02800280
		0x02800280
		0x02800280
		0x02800280
		0x00000280
		0x00000000
		0x00000000
		0x00000000
		0x00000000
		0x00800000
		0x00800080
		0x00800080
		0x00800080
		0x00800080
		0x00800080
		0x00800080
		0x00800080
		0x00800080
		0x00990080
		0x00000001
		0x00000000
		0x00000000
		0x00000200
		0x00000000
		0x51313152
		0x80013130
		0x02000080
		0x00100001
		0x07054208
		0x000f0c0f
		0x01000140
		0x00000c20
		0x00000000
		0x00000000
		0x00000000
		0x00000000
		0x00000000
		0x00000000
		0x00000000
		0x00000000
		0x00000000
		0x00000000
		0x00000000
		0x00000000
		0x00000000
		0x00000000
		0x00000000
		0x00000000
		0x00000000
		0x00000000
		0x00000000
		0x00000000
		0x00000000
		0x00000000
		0x00000000
		0x00000000
		0x00000000
		0x00000000
		0x00000000
		0x00000000
		0x00000000
		0x00000000
		0x00000000
		0x00000000
		0x00000000
		0x00000000
		0x00000000
		0x00000000
		0x00000000
		0x76543210
		0x0004c008
		0x00000099
		0x00000000
		0x00000000
		0x00010000
		0x01665555
		0x00665555
		0x00010f00
		0x05010200
		0x00000001
		0x001700c0
		0x00cc0001
		0x00000066
		0x00000000
		0x00000000
		0x00000000
		0x00000000
		0x00000000
		0x00000000
		0x00000000
		0x00000000
		0x04080000
		0x04080400
		0x08000000
		0x0c00c007
		0x00000100
		0x00000100
		0x55555555
		0xaaaaaaaa
		0x55555555
		0xaaaaaaaa
		0x00005555
		0x00000000
		0x00000000
		0x00000000
		0x00000000
		0x00000000
		0x00000000
		0x00000000
		0x00000000
		0x00000000
		0x00000000
		0x00000000
		0x00000000
		0x00000000
		0x00000000
		0x00000000
		0x00000000
		0x00000000
		0x00000000
		0x00000000
		0x00200000
		0x00000000
		0x00000000
		0x00000000
		0x00000000
		0x00000000
		0x00000000
		0x02800280
		0x02800280
		0x02800280
		0x02800280
		0x00000280
		0x00000000
		0x00000000
		0x00000000
		0x00000000
		0x00800000
		0x00800080
		0x00800080
		0x00800080
		0x00800080
		0x00800080
		0x00800080
		0x00800080
		0x00800080
		0x00990080
		0x00000001
		0x00000000
		0x00000000
		0x00000200
		0x00000000
		0x51313152
		0x80013130
		0x02000080
		0x00100001
		0x07054208
		0x000f0c0f
		0x01000140
		0x00000c20
		0x00000000
		0x00000000
		0x00000000
		0x00000000
		0x00000000
		0x00000000
		0x00000000
		0x00000000
		0x00000000
		0x00000000
		0x00000000
		0x00000000
		0x00000000
		0x00000000
		0x00000000
		0x00000000
		0x00000000
		0x00000000
		0x00000000
		0x00000000
		0x00000000
		0x00000000
		0x00000000
		0x00000000
		0x00000000
		0x00000000
		0x00000000
		0x00000000
		0x00000000
		0x00000000
		0x00000000
		0x00000000
		0x00000000
		0x00000000
		0x00000000
		0x00000000
		0x00000000
		0x76543210
		0x0004c008
		0x00000099
		0x00000000
		0x00000000
		0x00010000
		0x01665555
		0x00665555
		0x00010f00
		0x05010200
		0x00000001
		0x001700c0
		0x00cc0001
		0x00000066
		0x00000000
		0x00000000
		0x00000000
		0x00000000
		0x00000000
		0x00000000
		0x00000000
		0x00000000
		0x04080000
		0x04080400
		0x08000000
		0x0c00c007
		0x00000100
		0x00000100
		0x55555555
		0xaaaaaaaa
		0x55555555
		0xaaaaaaaa
		0x00005555
		0x00000000
		0x00000000
		0x00000000
		0x00000000
		0x00000000
		0x00000000
		0x00000000
		0x00000000
		0x00000000
		0x00000000
		0x00000000
		0x00000000
		0x00000000
		0x00000000
		0x00000000
		0x00000000
		0x00000000
		0x00000000
		0x00000000
		0x00200000
		0x00000000
		0x00000000
		0x00000000
		0x00000000
		0x00000000
		0x00000000
		0x02800280
		0x02800280
		0x02800280
		0x02800280
		0x00000280
		0x00000000
		0x00000000
		0x00000000
		0x00000000
		0x00800000
		0x00800080
		0x00800080
		0x00800080
		0x00800080
		0x00800080
		0x00800080
		0x00800080
		0x00800080
		0x00990080
		0x00000001
		0x00000000
		0x00000000
		0x00000200
		0x00000000
		0x51313152
		0x80013130
		0x02000080
		0x00100001
		0x07054208
		0x000f0c0f
		0x01000140
		0x00000c20
		0x00000000
		0x00000000
		0x00000000
		0x00000000
		0x00000000
		0x00000000
		0x00000000
		0x00000000
		0x00000000
		0x00000000
		0x00000000
		0x00000000
		0x00000000
		0x00000000
		0x00000000
		0x00000000
		0x00000000
		0x00000000
		0x00000000
		0x00000000
		0x00000000
		0x00000000
		0x00000000
		0x00000000
		0x00000000
		0x00000000
		0x00000000
		0x00000000
		0x00000000
		0x00000000
		0x00000000
		0x00000000
		0x00000000
		0x00000000
		0x00000000
		0x00000000
		0x00000000
		0x00000000
		0x00800000
		0x00000000
		0x00000000
		0x00000000
		0x00000000
		0x00000000
		0x00000000
		0x00000000
		0x00000000
		0x00000000
		0x00400320
		0x00000040
		0x00dcba98
		0x00000000
		0x00dcba98
		0x01000000
		0x00020003
		0x00000000
		0x00000000
		0x00000000
		0x0000002a
		0x00000015
		0x00000015
		0x0000002a
		0x00000033
		0x0000000c
		0x0000000c
		0x00000033
		0x0a418820
		0x103f0000
		0x0000003f
		0x00030055
		0x03000300
		0x03000300
		0x00000300
		0x42080010
		0x00000003
		0x00000000
		0x00000000
		0x00000000
		0x00000000
		0x00000000
		0x00000000
		0x00000000
		0x00000000
		0x00000000
		0x00000000
		0x00000000
		0x00000000
		0x00000000
		0x00000000
		0x00000000
		0x00000000
		0x00000000
		0x00000000
		0x00000000
		0x00000000
		0x00000000
		0x00000000
		0x00000000
		0x00000000
		0x00000000
		0x00000000
		0x00000000
		0x00000000
		0x00000000
		0x00000000
		0x00000000
		0x00000000
		0x00000000
		0x00000000
		0x00000000
		0x00000000
		0x00000000
		0x00000000
		0x00000000
		0x00000000
		0x00000000
		0x00000000
		0x00000000
		0x00000000
		0x00000000
		0x00000000
		0x00000000
		0x00000000
		0x00000000
		0x00000000
		0x00000000
		0x00000000
		0x00000000
		0x00000000
		0x00000000
		0x00000000
		0x00000000
		0x00000000
		0x00000000
		0x00000000
		0x00000000
		0x00000000
		0x00000000
		0x00000000
		0x00000000
		0x00000000
		0x00000000
		0x00000000
		0x00000000
		0x00000000
		0x00000000
		0x00000000
		0x00000000
		0x00000000
		0x00000000
		0x00000000
		0x00000000
		0x00000000
		0x00000000
		0x00000000
		0x00000000
		0x00000000
		0x00000000
		0x00000000
		0x00000000
		0x00000000
		0x00000000
		0x00000000
		0x00000000
		0x00000000
		0x00000000
		0x00800000
		0x00000000
		0x00000000
		0x00000000
		0x00000000
		0x00000000
		0x00000000
		0x00000000
		0x00000000
		0x00000000
		0x00400320
		0x00000040
		0x00000000
		0x00000000
		0x00000000
		0x01000000
		0x00020003
		0x00000000
		0x00000000
		0x00000000
		0x0000002a
		0x00000015
		0x00000015
		0x0000002a
		0x00000033
		0x0000000c
		0x0000000c
		0x00000033
		0x16a4a0e6
		0x103f0000
		0x0000003f
		0x00030055
		0x03000300
		0x03000300
		0x00000300
		0x42080010
		0x00000003
		0x00000000
		0x00000000
		0x00000000
		0x00000000
		0x00000000
		0x00000000
		0x00000000
		0x00000000
		0x00000000
		0x00000000
		0x00000000
		0x00000000
		0x00000000
		0x00000000
		0x00000000
		0x00000000
		0x00000000
		0x00000000
		0x00000000
		0x00000000
		0x00000000
		0x00000000
		0x00000000
		0x00000000
		0x00000000
		0x00000000
		0x00000000
		0x00000000
		0x00000000
		0x00000000
		0x00000000
		0x00000000
		0x00000000
		0x00000000
		0x00000000
		0x00000000
		0x00000000
		0x00000000
		0x00000000
		0x00000000
		0x00000000
		0x00000000
		0x00000000
		0x00000000
		0x00000000
		0x00000000
		0x00000000
		0x00000000
		0x00000000
		0x00000000
		0x00000000
		0x00000000
		0x00000000
		0x00000000
		0x00000000
		0x00000000
		0x00000000
		0x00000000
		0x00000000
		0x00000000
		0x00000000
		0x00000000
		0x00000000
		0x00000000
		0x00000000
		0x00000000
		0x00000000
		0x00000000
		0x00000000
		0x00000000
		0x00000000
		0x00000000
		0x00000000
		0x00000000
		0x00000000
		0x00000000
		0x00000000
		0x00000000
		0x00000000
		0x00000000
		0x00000000
		0x00000000
		0x00000000
		0x00000000
		0x00000000
		0x00000000
		0x00000000
		0x00000000
		0x00000000
		0x00000000
		0x00000000
		0x00800000
		0x00000000
		0x00000000
		0x00000000
		0x00000000
		0x00000000
		0x00000000
		0x00000000
		0x00000000
		0x00000000
		0x00400320
		0x00000040
		0x00000000
		0x00000000
		0x00000000
		0x01000000
		0x00020003
		0x00000000
		0x00000000
		0x00000000
		0x0000002a
		0x00000015
		0x00000015
		0x0000002a
		0x00000033
		0x0000000c
		0x0000000c
		0x00000033
		0x1ee6b16a
		0x103f0000
		0x0000003f
		0x00030055
		0x03000300
		0x03000300
		0x00000300
		0x42080010
		0x00000003
		0x00000000
		0x00000000
		0x00000000
		0x00000000
		0x00000000
		0x00000000
		0x00000000
		0x00000000
		0x00000000
		0x00000000
		0x00000000
		0x00000000
		0x00000000
		0x00000000
		0x00000000
		0x00000000
		0x00000000
		0x00000000
		0x00000000
		0x00000000
		0x00000000
		0x00000000
		0x00000000
		0x00000000
		0x00000000
		0x00000000
		0x00000000
		0x00000000
		0x00000000
		0x00000000
		0x00000000
		0x00000000
		0x00000000
		0x00000000
		0x00000000
		0x00000000
		0x00000000
		0x00000000
		0x00000000
		0x00000000
		0x00000000
		0x00000000
		0x00000000
		0x00000000
		0x00000000
		0x00000000
		0x00000000
		0x00000000
		0x00000000
		0x00000000
		0x00000000
		0x00000000
		0x00000000
		0x00000000
		0x00000000
		0x00000000
		0x00000000
		0x00000000
		0x00000000
		0x00000000
		0x00000000
		0x00000000
		0x00000000
		0x00000000
		0x00000000
		0x00000000
		0x00000000
		0x00000000
		0x00000000
		0x00000000
		0x00000000
		0x00000000
		0x00000000
		0x00000000
		0x00000000
		0x00000000
		0x00000000
		0x00000000
		0x00000000
		0x00000000
		0x00000000
		0x00000000
		0x00000000
		0x00000000
		0x00000000
		0x00000000
		0x00000000
		0x00000000
		0x00000000
		0x00000000
		0x00000001
		0x00000000
		0x01000005
		0x04000f00
		0x00020040
		0x00020055
		0x00000000
		0x00000000
		0x00000000
		0x00000000
		0x00000000
		0x00010100
		0x00000601
		0x00000000
		0x00006400
		0x01221102
		0x00000000
		0x00031f00
		0x031f031f
		0x031f031f
		0x00030003
		0x03000300
		0x00000300
		0x01221102
		0x00000000
		0x00000000
		0x03020000
		0x00000001
		0x00008011
		0x00000011
		0x00000440
		0x00000040
		0x00004011
		0x00004011
		0x00004410
		0x00004410
		0x00004410
		0x00004410
		0x00004410
		0x00004011
		0x00004410
		0x00004011
		0x00004410
		0x00004011
		0x00004410
		0x00000000
		0x00000000
		0x00000000
		0x04000000
		0x00000000
		0x00000000
		0x00000508
		0x00000000
		0x00000000
		0x00000000
		0x00000000
		0x00000000
		0x00000000
		0xe4000000
		0x00000000
		0x00000000
		0x01010000
		0x00000000
	>;
};
