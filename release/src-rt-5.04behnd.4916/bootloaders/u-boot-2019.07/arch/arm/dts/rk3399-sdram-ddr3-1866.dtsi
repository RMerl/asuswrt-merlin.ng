// SPDX-License-Identifier: GPL-2.0+
/*
 * (C) 2017 Theobroma Systems Design und Consulting GmbH
 */

&dmc {
        rockchip,sdram-params = <
		0x1
		0xa
		0x3
		0x2
		0x1
		0x0
		0xf
		0xf
		1
		0x80181219
		0x17050a03
		0x00000002
		0x00006456
		0x0000004c
		0x00000000
		0x1
		0xa
		0x3
		0x2
		0x1
		0x0
		0xf
		0xf
		1
		0x80181219
		0x17050a03
		0x00000002
		0x00006456
		0x0000004c
		0x00000000
		933
		3
		2
		9
		1
		0x00000600
		0x00000000
		0x00000000
		0x00000000
		0x00000000
		0x0000000a
		0x00000000
		0x00000000
		0x00000000
		0x0000000a
		0x00000000
		0x00000000
		0x00000000
		0x0000000a
		0x00000000
		0x00000000
		0x01000000
		0x00000000
		0x00000101
		0x00020100
		0x0002d976
		0x00071fa6
		0x02000200
		0x091a0200
		0x00091a00
		0x0400091a
		0x2c060004
		0x210c0820
		0x202c0600
		0x00210c08
		0x08202c06
		0x0800210c
		0x00000f04
		0x0501000a
		0x0f040805
		0x0501000a
		0x0f040805
		0x0501000a
		0x02030005
		0x0c0f0c00
		0x000f0c0f
		0x14000a0a
		0x00000a0a
		0x00010000
		0x031c1c1c
		0x000c0c0c
		0x00000000
		0x03010000
		0x1c6a0147
		0x1c6a0147
		0x1c6a0147
		0x00000000
		0x00060006
		0x00170006
		0x00170017
		0x00000000
		0x00000000
		0x00000000
		0x00000000
		0x02000000
		0x02000151
		0x02000151
		0x00000151
		0x00000000
		0x00000000
		0x00000000
		0x00000000
		0x00000000
		0x00000000
		0x00000301
		0x00000001
		0x00000000
		0x00000000
		0x01000000
		0x80104002
		0x00040003
		0x00040005
		0x00030000
		0x00050004
		0x00000004
		0x00040003
		0x00040005
		0x71a80000
		0x000038d4
		0x38d471a8
		0x71a80000
		0x000038d4
		0x00000000
		0x00000000
		0x00000000
		0x00000000
		0x00000000
		0x0a0a0a00
		0x000a0a0a
		0x00030200
		0x00040700
		0x00000302
		0x02000407
		0x00000003
		0x00030f04
		0x00070004
		0x00000000
		0x00000000
		0x00000000
		0x00000000
		0x00000000
		0x00000000
		0x00010000
		0x00010000
		0x20040020
		0x00200400
		0x01000400
		0x00000b80
		0x00000000
		0x00000001
		0x00000002
		0x0000000e
		0x00000000
		0x00000000
		0x00000000
		0x00000000
		0x00000000
		0x00bb0000
		0x00ea005e
		0x00ea0000
		0x005e00bb
		0x000000ea
		0x00bb00ea
		0x00ea005e
		0x00ea0000
		0x00000000
		0x00000000
		0x00000000
		0x00420014
		0x00140020
		0x00200042
		0x00420014
		0x00000020
		0x00000000
		0x00000000
		0x00000000
		0x00000000
		0x00000000
		0x00000000
		0x00000000
		0x00000000
		0x00000000
		0x00420014
		0x00140020
		0x00200042
		0x00420014
		0x00000020
		0x00000000
		0x00000000
		0x00000000
		0x00000000
		0x00000000
		0x00000000
		0x00000000
		0x00000000
		0x00000000
		0x01000000
		0x00000000
		0x00000000
		0x18151100
		0x0000000c
		0x00000000
		0x00000000
		0x00000000
		0x00000000
		0x00000000
		0x00000000
		0x00000000
		0x00000000
		0x00000000
		0x00000000
		0x00000000
		0x00000000
		0x00000000
		0x00025603
		0x004b012b
		0x00000000
		0x012b0256
		0x0000004b
		0x00025600
		0x004b012b
		0x00000000
		0x00000000
		0x00000000
		0x01010100
		0x00000202
		0x0a000001
		0x01000f0f
		0x00000000
		0x00000000
		0x00010003
		0x00000c03
		0x00000000
		0x00000000
		0x01000000
		0x00010000
		0x00000001
		0x00000000
		0x00000000
		0x00000000
		0x00000000
		0x00000000
		0x00000000
		0x00000000
		0x00000000
		0x00000000
		0x00010000
		0x08080802
		0x01010606
		0x00000001
		0x04040400
		0x03080808
		0x03050303
		0x03050303
		0x00050303
		0x00020202
		0x00000000
		0x00000000
		0x00000000
		0x00000000
		0x0d000001
		0x00010028
		0x00010000
		0x00000003
		0x00000000
		0x00000000
		0x00000000
		0x00000000
		0x00000000
		0x00000000
		0x00000000
		0x00000000
		0x00010100
		0x01000000
		0x00000001
		0x00000303
		0x00000000
		0x00000000
		0x00000000
		0x00000000
		0x00000000
		0x00000000
		0x00000000
		0x00000000
		0x00000000
		0x00000000
		0x00000000
		0x00000000
		0x00000000
		0x00000000
		0x00000000
		0x000556aa
		0x000aaaaa
		0x000aa955
		0x00055555
		0x000b3133
		0x0004cd33
		0x0004cecc
		0x000b32cc
		0x00010300
		0x03000100
		0x00000000
		0x00000000
		0x00000000
		0x00000000
		0x00000000
		0x00000000
		0x00000000
		0x00000000
		0x00ffff00
		0x15150000
		0x08000015
		0x000038d4
		0x00000200
		0x00000200
		0x00000200
		0x00000200
		0x000038d4
		0x00023848
		0x38d4080b
		0x00000200
		0x00000200
		0x00000200
		0x00000200
		0x000038d4
		0x00023848
		0x38d4080b
		0x00000200
		0x00000200
		0x00000200
		0x00000200
		0x000038d4
		0x00023848
		0x0202080b
		0x03030202
		0x00000014
		0x00000000
		0x00000000
		0x00001403
		0x00000000
		0x00000000
		0x00000000
		0x00030000
		0x00060018
		0x00060018
		0x00060018
		0x00000000
		0x00000000
		0x01000000
		0x03080308
		0x00050308
		0x00000000
		0x00000000
		0x00000000
		0x00000000
		0x00000000
		0x00000000
		0x00000000
		0x00000000
		0x01000100
		0x01010101
		0x01000101
		0x01000100
		0x00010001
		0x00010002
		0x00020100
		0x00000002
		0x00000600
		0x00000000
		0x000071a8
		0x000038d4
		0x000071a8
		0x000038d4
		0x000071a8
		0x38d438d4
		0x00000200
		0x00000200
		0x00000200
		0x00000200
		0x000038d4
		0x00000200
		0x00000200
		0x00000200
		0x00000200
		0x000038d4
		0x00000200
		0x00000200
		0x00000200
		0x00000200
		0x00010000
		0x00000007
		0x110f0001
		0x3c020000
		0x3fffffff
		0x3c030000
		0x1dc0ffff
		0x3c010000
		0x1dc0ffff
		0x3c000000
		0x1dc0ffff
		0x3c300400
		0x1dc7ffff
		0x3c000000
		0x00000000
		0x3c000000
		0x00000000
		0x3c000000
		0x00000000
		0x03000101
		0x00262626
		0x091a0009
		0x00091a00
		0x0000001a
		0x1c6a0147
		0x1c6a0147
		0x1c6a0147
		0x00000500
		0x00000000
		0x00000000
		0x00000000
		0x00000000
		0x00000000
		0x00000000
		0x00000000
		0x00000000
		0x04040000
		0x0d000004
		0x00000128
		0x00000000
		0x00030003
		0x00000014
		0x00000000
		0x00000000
		0x08060002
		0x08010801
		0x00060601
		0x00020001
		0x00080004
		0x00000000
		0x00000000
		0x04040400
		0x00000000
		0x00000000
		0x00000000
		0x00030300
		0x00000014
		0x00000000
		0x01010300
		0x00000000
		0x00000000
		0x01000000
		0x00000101
		0x55555a5a
		0x55555a5a
		0x55555a5a
		0x55555a5a
		0x0b0b0001
		0x0808000b
		0x03030008
		0x00000103
		0x00030000
		0x17030000
		0x00060018
		0x00060018
		0x00060018
		0x00000000
		0x00000000
		0x00000000
		0x140a0000
		0x000a000a
		0x00000a00
		0x010a000a
		0x00000100
		0x01000000
		0x00000000
		0x00000100
		0x1e1a0000
		0x10010204
		0x07070705
		0x20000202
		0x00201000
		0x00201000
		0x04041000
		0x12120100
		0x00010112
		0x004b004a
		0x1a030000
		0x0102041e
		0x34000000
		0x00000000
		0x00000000
		0x00000000
		0x00004200
		0x00000020
		0x004d4d00
		0x00200042
		0x4d000000
		0x0000424d
		0x00000020
		0x004d4d00
		0x00200042
		0x4d000000
		0x0000424d
		0x00000020
		0x004d4d00
		0x00200042
		0x4d000000
		0x0042004d
		0x00000020
		0x004d4d00
		0x00200042
		0x4d000000
		0x0000424d
		0x00000020
		0x004d4d00
		0x00200042
		0x4d000000
		0x0000424d
		0x00000020
		0x004d4d00
		0x00200042
		0x4d000000
		0x0000004d
		0x00ea00ea
		0x080400ea
		0x0f080c0c
		0x2000fd7a
		0x0a042000
		0x0c0c080f
		0x00000f08
		0x2000fd7a
		0x0a042000
		0x0c0c080f
		0x00000f08
		0x2000fd7a
		0x0a042000
		0x0200020f
		0x02000200
		0x02000200
		0x02000200
		0x02000200
		0x00000000
		0x00000000
		0x00000000
		0x00000000
		0x00000000
		0x00000000
		0x00000000
		0x00000000
		0x00000000
		0x00000000
		0x00000000
		0x00000000
		0x01000300
		0x0038d400
		0x00023848
		0x000038d4
		0x00023848
		0x000038d4
		0x00023848
		0x08000000
		0x00000100
		0x00000000
		0x00000000
		0x00000000
		0x00000000
		0x00000001
		0x76543210
		0x0004c008
		0x000000de
		0x00000000
		0x00000000
		0x00010000
		0x01665555
		0x00665555
		0x00010f00
		0x06010200
		0x00000001
		0x001700c0
		0x00cc0001
		0x00000066
		0x00000000
		0x00000000
		0x00000000
		0x00000000
		0x00000000
		0x00000000
		0x00000000
		0x00000000
		0x04080000
		0x04080400
		0x08000000
		0x0c00c007
		0x00000100
		0x00000100
		0x55555555
		0xaaaaaaaa
		0x55555555
		0xaaaaaaaa
		0x00005555
		0x00000000
		0x00000000
		0x00000000
		0x00000000
		0x00000000
		0x00000000
		0x00000000
		0x00000000
		0x00000000
		0x00000000
		0x00000000
		0x00000000
		0x00000000
		0x00000000
		0x00000000
		0x00000000
		0x00000000
		0x00000000
		0x00000000
		0x00200000
		0x00000000
		0x00000000
		0x00000000
		0x00000000
		0x00000000
		0x00000000
		0x02800280
		0x02800280
		0x02800280
		0x02800280
		0x00000280
		0x00000000
		0x00000000
		0x00000000
		0x00000000
		0x00800000
		0x00800080
		0x00800080
		0x00800080
		0x00800080
		0x00800080
		0x00800080
		0x00800080
		0x00800080
		0x00de0080
		0x00000001
		0x00000000
		0x00000000
		0x00000200
		0x00000000
		0x51313152
		0x80013130
		0x02000080
		0x00100001
		0x07064208
		0x000f0c0f
		0x01000140
		0x00000c20
		0x00000000
		0x00000000
		0x00000000
		0x00000000
		0x00000000
		0x00000000
		0x00000000
		0x00000000
		0x00000000
		0x00000000
		0x00000000
		0x00000000
		0x00000000
		0x00000000
		0x00000000
		0x00000000
		0x00000000
		0x00000000
		0x00000000
		0x00000000
		0x00000000
		0x00000000
		0x00000000
		0x00000000
		0x00000000
		0x00000000
		0x00000000
		0x00000000
		0x00000000
		0x00000000
		0x00000000
		0x00000000
		0x00000000
		0x00000000
		0x00000000
		0x00000000
		0x00000000
		0x76543210
		0x0004c008
		0x000000de
		0x00000000
		0x00000000
		0x00010000
		0x01665555
		0x00665555
		0x00010f00
		0x06010200
		0x00000001
		0x001700c0
		0x00cc0001
		0x00000066
		0x00000000
		0x00000000
		0x00000000
		0x00000000
		0x00000000
		0x00000000
		0x00000000
		0x00000000
		0x04080000
		0x04080400
		0x08000000
		0x0c00c007
		0x00000100
		0x00000100
		0x55555555
		0xaaaaaaaa
		0x55555555
		0xaaaaaaaa
		0x00005555
		0x00000000
		0x00000000
		0x00000000
		0x00000000
		0x00000000
		0x00000000
		0x00000000
		0x00000000
		0x00000000
		0x00000000
		0x00000000
		0x00000000
		0x00000000
		0x00000000
		0x00000000
		0x00000000
		0x00000000
		0x00000000
		0x00000000
		0x00200000
		0x00000000
		0x00000000
		0x00000000
		0x00000000
		0x00000000
		0x00000000
		0x02800280
		0x02800280
		0x02800280
		0x02800280
		0x00000280
		0x00000000
		0x00000000
		0x00000000
		0x00000000
		0x00800000
		0x00800080
		0x00800080
		0x00800080
		0x00800080
		0x00800080
		0x00800080
		0x00800080
		0x00800080
		0x00de0080
		0x00000001
		0x00000000
		0x00000000
		0x00000200
		0x00000000
		0x51313152
		0x80013130
		0x02000080
		0x00100001
		0x07064208
		0x000f0c0f
		0x01000140
		0x00000c20
		0x00000000
		0x00000000
		0x00000000
		0x00000000
		0x00000000
		0x00000000
		0x00000000
		0x00000000
		0x00000000
		0x00000000
		0x00000000
		0x00000000
		0x00000000
		0x00000000
		0x00000000
		0x00000000
		0x00000000
		0x00000000
		0x00000000
		0x00000000
		0x00000000
		0x00000000
		0x00000000
		0x00000000
		0x00000000
		0x00000000
		0x00000000
		0x00000000
		0x00000000
		0x00000000
		0x00000000
		0x00000000
		0x00000000
		0x00000000
		0x00000000
		0x00000000
		0x00000000
		0x76543210
		0x0004c008
		0x000000de
		0x00000000
		0x00000000
		0x00010000
		0x01665555
		0x00665555
		0x00010f00
		0x06010200
		0x00000001
		0x001700c0
		0x00cc0001
		0x00000066
		0x00000000
		0x00000000
		0x00000000
		0x00000000
		0x00000000
		0x00000000
		0x00000000
		0x00000000
		0x04080000
		0x04080400
		0x08000000
		0x0c00c007
		0x00000100
		0x00000100
		0x55555555
		0xaaaaaaaa
		0x55555555
		0xaaaaaaaa
		0x00005555
		0x00000000
		0x00000000
		0x00000000
		0x00000000
		0x00000000
		0x00000000
		0x00000000
		0x00000000
		0x00000000
		0x00000000
		0x00000000
		0x00000000
		0x00000000
		0x00000000
		0x00000000
		0x00000000
		0x00000000
		0x00000000
		0x00000000
		0x00200000
		0x00000000
		0x00000000
		0x00000000
		0x00000000
		0x00000000
		0x00000000
		0x02800280
		0x02800280
		0x02800280
		0x02800280
		0x00000280
		0x00000000
		0x00000000
		0x00000000
		0x00000000
		0x00800000
		0x00800080
		0x00800080
		0x00800080
		0x00800080
		0x00800080
		0x00800080
		0x00800080
		0x00800080
		0x00de0080
		0x00000001
		0x00000000
		0x00000000
		0x00000200
		0x00000000
		0x51313152
		0x80013130
		0x02000080
		0x00100001
		0x07064208
		0x000f0c0f
		0x01000140
		0x00000c20
		0x00000000
		0x00000000
		0x00000000
		0x00000000
		0x00000000
		0x00000000
		0x00000000
		0x00000000
		0x00000000
		0x00000000
		0x00000000
		0x00000000
		0x00000000
		0x00000000
		0x00000000
		0x00000000
		0x00000000
		0x00000000
		0x00000000
		0x00000000
		0x00000000
		0x00000000
		0x00000000
		0x00000000
		0x00000000
		0x00000000
		0x00000000
		0x00000000
		0x00000000
		0x00000000
		0x00000000
		0x00000000
		0x00000000
		0x00000000
		0x00000000
		0x00000000
		0x00000000
		0x76543210
		0x0004c008
		0x000000de
		0x00000000
		0x00000000
		0x00010000
		0x01665555
		0x00665555
		0x00010f00
		0x06010200
		0x00000001
		0x001700c0
		0x00cc0001
		0x00000066
		0x00000000
		0x00000000
		0x00000000
		0x00000000
		0x00000000
		0x00000000
		0x00000000
		0x00000000
		0x04080000
		0x04080400
		0x08000000
		0x0c00c007
		0x00000100
		0x00000100
		0x55555555
		0xaaaaaaaa
		0x55555555
		0xaaaaaaaa
		0x00005555
		0x00000000
		0x00000000
		0x00000000
		0x00000000
		0x00000000
		0x00000000
		0x00000000
		0x00000000
		0x00000000
		0x00000000
		0x00000000
		0x00000000
		0x00000000
		0x00000000
		0x00000000
		0x00000000
		0x00000000
		0x00000000
		0x00000000
		0x00200000
		0x00000000
		0x00000000
		0x00000000
		0x00000000
		0x00000000
		0x00000000
		0x02800280
		0x02800280
		0x02800280
		0x02800280
		0x00000280
		0x00000000
		0x00000000
		0x00000000
		0x00000000
		0x00800000
		0x00800080
		0x00800080
		0x00800080
		0x00800080
		0x00800080
		0x00800080
		0x00800080
		0x00800080
		0x00de0080
		0x00000001
		0x00000000
		0x00000000
		0x00000200
		0x00000000
		0x51313152
		0x80013130
		0x02000080
		0x00100001
		0x07064208
		0x000f0c0f
		0x01000140
		0x00000c20
		0x00000000
		0x00000000
		0x00000000
		0x00000000
		0x00000000
		0x00000000
		0x00000000
		0x00000000
		0x00000000
		0x00000000
		0x00000000
		0x00000000
		0x00000000
		0x00000000
		0x00000000
		0x00000000
		0x00000000
		0x00000000
		0x00000000
		0x00000000
		0x00000000
		0x00000000
		0x00000000
		0x00000000
		0x00000000
		0x00000000
		0x00000000
		0x00000000
		0x00000000
		0x00000000
		0x00000000
		0x00000000
		0x00000000
		0x00000000
		0x00000000
		0x00000000
		0x00000000
		0x00000000
		0x00800000
		0x00000000
		0x00000000
		0x00000000
		0x00000000
		0x00000000
		0x00000000
		0x00000000
		0x00000000
		0x00000000
		0x00400320
		0x00000040
		0x00dcba98
		0x00000000
		0x00dcba98
		0x01000000
		0x00020003
		0x00000000
		0x00000000
		0x00000000
		0x0000002a
		0x00000015
		0x00000015
		0x0000002a
		0x00000033
		0x0000000c
		0x0000000c
		0x00000033
		0x0a418820
		0x103f0000
		0x0000003f
		0x00030055
		0x03000300
		0x03000300
		0x00000300
		0x42080010
		0x00000003
		0x00000000
		0x00000000
		0x00000000
		0x00000000
		0x00000000
		0x00000000
		0x00000000
		0x00000000
		0x00000000
		0x00000000
		0x00000000
		0x00000000
		0x00000000
		0x00000000
		0x00000000
		0x00000000
		0x00000000
		0x00000000
		0x00000000
		0x00000000
		0x00000000
		0x00000000
		0x00000000
		0x00000000
		0x00000000
		0x00000000
		0x00000000
		0x00000000
		0x00000000
		0x00000000
		0x00000000
		0x00000000
		0x00000000
		0x00000000
		0x00000000
		0x00000000
		0x00000000
		0x00000000
		0x00000000
		0x00000000
		0x00000000
		0x00000000
		0x00000000
		0x00000000
		0x00000000
		0x00000000
		0x00000000
		0x00000000
		0x00000000
		0x00000000
		0x00000000
		0x00000000
		0x00000000
		0x00000000
		0x00000000
		0x00000000
		0x00000000
		0x00000000
		0x00000000
		0x00000000
		0x00000000
		0x00000000
		0x00000000
		0x00000000
		0x00000000
		0x00000000
		0x00000000
		0x00000000
		0x00000000
		0x00000000
		0x00000000
		0x00000000
		0x00000000
		0x00000000
		0x00000000
		0x00000000
		0x00000000
		0x00000000
		0x00000000
		0x00000000
		0x00000000
		0x00000000
		0x00000000
		0x00000000
		0x00000000
		0x00000000
		0x00000000
		0x00000000
		0x00000000
		0x00000000
		0x00000000
		0x00800000
		0x00000000
		0x00000000
		0x00000000
		0x00000000
		0x00000000
		0x00000000
		0x00000000
		0x00000000
		0x00000000
		0x00400320
		0x00000040
		0x00000000
		0x00000000
		0x00000000
		0x01000000
		0x00020003
		0x00000000
		0x00000000
		0x00000000
		0x0000002a
		0x00000015
		0x00000015
		0x0000002a
		0x00000033
		0x0000000c
		0x0000000c
		0x00000033
		0x16a4a0e6
		0x103f0000
		0x0000003f
		0x00030055
		0x03000300
		0x03000300
		0x00000300
		0x42080010
		0x00000003
		0x00000000
		0x00000000
		0x00000000
		0x00000000
		0x00000000
		0x00000000
		0x00000000
		0x00000000
		0x00000000
		0x00000000
		0x00000000
		0x00000000
		0x00000000
		0x00000000
		0x00000000
		0x00000000
		0x00000000
		0x00000000
		0x00000000
		0x00000000
		0x00000000
		0x00000000
		0x00000000
		0x00000000
		0x00000000
		0x00000000
		0x00000000
		0x00000000
		0x00000000
		0x00000000
		0x00000000
		0x00000000
		0x00000000
		0x00000000
		0x00000000
		0x00000000
		0x00000000
		0x00000000
		0x00000000
		0x00000000
		0x00000000
		0x00000000
		0x00000000
		0x00000000
		0x00000000
		0x00000000
		0x00000000
		0x00000000
		0x00000000
		0x00000000
		0x00000000
		0x00000000
		0x00000000
		0x00000000
		0x00000000
		0x00000000
		0x00000000
		0x00000000
		0x00000000
		0x00000000
		0x00000000
		0x00000000
		0x00000000
		0x00000000
		0x00000000
		0x00000000
		0x00000000
		0x00000000
		0x00000000
		0x00000000
		0x00000000
		0x00000000
		0x00000000
		0x00000000
		0x00000000
		0x00000000
		0x00000000
		0x00000000
		0x00000000
		0x00000000
		0x00000000
		0x00000000
		0x00000000
		0x00000000
		0x00000000
		0x00000000
		0x00000000
		0x00000000
		0x00000000
		0x00000000
		0x00000000
		0x00800000
		0x00000000
		0x00000000
		0x00000000
		0x00000000
		0x00000000
		0x00000000
		0x00000000
		0x00000000
		0x00000000
		0x00400320
		0x00000040
		0x00000000
		0x00000000
		0x00000000
		0x01000000
		0x00020003
		0x00000000
		0x00000000
		0x00000000
		0x0000002a
		0x00000015
		0x00000015
		0x0000002a
		0x00000033
		0x0000000c
		0x0000000c
		0x00000033
		0x1ee6b16a
		0x103f0000
		0x0000003f
		0x00030055
		0x03000300
		0x03000300
		0x00000300
		0x42080010
		0x00000003
		0x00000000
		0x00000000
		0x00000000
		0x00000000
		0x00000000
		0x00000000
		0x00000000
		0x00000000
		0x00000000
		0x00000000
		0x00000000
		0x00000000
		0x00000000
		0x00000000
		0x00000000
		0x00000000
		0x00000000
		0x00000000
		0x00000000
		0x00000000
		0x00000000
		0x00000000
		0x00000000
		0x00000000
		0x00000000
		0x00000000
		0x00000000
		0x00000000
		0x00000000
		0x00000000
		0x00000000
		0x00000000
		0x00000000
		0x00000000
		0x00000000
		0x00000000
		0x00000000
		0x00000000
		0x00000000
		0x00000000
		0x00000000
		0x00000000
		0x00000000
		0x00000000
		0x00000000
		0x00000000
		0x00000000
		0x00000000
		0x00000000
		0x00000000
		0x00000000
		0x00000000
		0x00000000
		0x00000000
		0x00000000
		0x00000000
		0x00000000
		0x00000000
		0x00000000
		0x00000000
		0x00000000
		0x00000000
		0x00000000
		0x00000000
		0x00000000
		0x00000000
		0x00000000
		0x00000000
		0x00000000
		0x00000000
		0x00000000
		0x00000000
		0x00000000
		0x00000000
		0x00000000
		0x00000000
		0x00000000
		0x00000000
		0x00000000
		0x00000000
		0x00000000
		0x00000000
		0x00000000
		0x00000000
		0x00000000
		0x00000000
		0x00000000
		0x00000000
		0x00000000
		0x00000000
		0x00000001
		0x00000000
		0x01000005
		0x04000f00
		0x00020040
		0x00020055
		0x00000000
		0x00000000
		0x00000000
		0x00000000
		0x00000000
		0x00010100
		0x00000601
		0x00000000
		0x00006400
		0x01221102
		0x00000000
		0x00031f00
		0x031f031f
		0x031f031f
		0x00030003
		0x03000300
		0x00000300
		0x01221102
		0x00000000
		0x00000000
		0x04020000
		0x00000001
		0x00008011
		0x00000011
		0x00000440
		0x00000040
		0x00004011
		0x00004011
		0x00004410
		0x00004410
		0x00004410
		0x00004410
		0x00004410
		0x00004011
		0x00004410
		0x00004011
		0x00004410
		0x00004011
		0x00004410
		0x00000000
		0x00000000
		0x00000000
		0x04000000
		0x00000000
		0x00000000
		0x00000508
		0x00000000
		0x00000000
		0x00000000
		0x00000000
		0x00000000
		0x00000000
		0xe4000000
		0x00000000
		0x00000000
		0x01010000
		0x00000000
	>;
};

