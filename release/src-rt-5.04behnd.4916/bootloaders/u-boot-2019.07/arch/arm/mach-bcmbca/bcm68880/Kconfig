## release/src-rt-5.04behnd.4916/bootloaders/u-boot-2019.07/arch/arm/mach-bcmbca/bcm68880/Kconfig
```kconfig
# SPDX-License-Identifier: GPL-2.0+
#
# (C) Copyright 2021 Broadcom Ltd
#

if BCM68880

config TARGET_BCM968880
	bool "Broadcom 68880 Reference Board"
	depends on ARCH_BCMBCA

config SYS_SOC
	default "bcm68880"

if BCMBCA_DDRC
config BCMBCA_LPDDR4_DEF_MCBSEL
    hex "default LPDDR4 mcb selector value"
    default 0x1001324

config BCMBCA_LPDDR5_DEF_MCBSEL
    hex "default LPDDR5 mcb selector value"
    default 0x1005329

config BCMBCA_DDR_DEFAULT
    hex "default ddr mcb selector"
    default BCMBCA_LPDDR4_DEF_MCBSEL
endif

source "board/broadcom/bcmbca/Kconfig"

endif
```

## release/src-rt-5.04behnd.4916/bootloaders/u-boot-2019.07/arch/arm/mach-exynos/Kconfig
```kconfig
if ARCH_EXYNOS

choice
	prompt "EXYNOS architecture type select"
	optional

config ARCH_EXYNOS4
	bool "Exynos4 SoC family"
	select BOARD_EARLY_INIT_F
	select CPU_V7A
	select BLK
	select DM_MMC
	help
	  Samsung Exynos4 SoC family are based on ARM Cortex-A9 CPU. There
	  are multiple SoCs in this family including Exynos4210, Exynos4412,
	  and Exynos4212.

config ARCH_EXYNOS5
	bool "Exynos5 SoC family"
	select BOARD_EARLY_INIT_F
	select CPU_V7A
	select SHA_HW_ACCEL
	imply CMD_HASH
	imply CRC32_VERIFY
	imply HASH_VERIFY
	imply USB_ETHER_ASIX
	imply USB_ETHER_RTL8152
	imply USB_ETHER_SMSC95XX
	select BLK
	select DM_MMC

	help
	  Samsung Exynos5 SoC family are based on ARM Cortex-A15 CPU (and
	  Cortex-A7 CPU in big.LITTLE configuration). There are multiple SoCs
	  in this family including Exynos5250, Exynos5420 and Exynos5800.

config ARCH_EXYNOS7
	bool "Exynos7 SoC family"
	select ARM64
	select BOARD_EARLY_INIT_F
	select BLK
	select DM_MMC
	help
	  Samsung Exynos7 SoC family are based on ARM Cortex-A57 CPU or
	  Cortex-A53 CPU (and some in a big.LITTLE configuration). There are
	  multiple SoCs in this family including Exynos7420.

endchoice

if ARCH_EXYNOS4

choice
	prompt "EXYNOS4 board select"

config TARGET_SMDKV310
	bool "Exynos4210 SMDKV310 board"
	select OF_CONTROL
	select SUPPORT_SPL

config TARGET_TRATS
	bool "Exynos4210 Trats board"

config TARGET_S5PC210_UNIVERSAL
	bool "EXYNOS4210 Universal C210 board"

config TARGET_ORIGEN
	bool "Exynos4412 Origen board"
	select SUPPORT_SPL

config TARGET_TRATS2
	bool "Exynos4412 Trat2 board"

config TARGET_ODROID
	bool "Exynos4412 Odroid board"

endchoice
endif

if ARCH_EXYNOS5

config SPL_GPIO_SUPPORT
	default y

config SPL_LIBCOMMON_SUPPORT
	default y

config SPL_LIBGENERIC_SUPPORT
	default y

choice
	prompt "EXYNOS5 board select"

config TARGET_ODROID_XU3
	bool "Exynos5422 Odroid board"
	select OF_CONTROL

config TARGET_ARNDALE
	bool "Exynos5250 Arndale board"
	select ARM_ERRATA_773022
	select ARM_ERRATA_774769
	select CPU_V7_HAS_NONSEC
	select CPU_V7_HAS_VIRT
	select OF_CONTROL
	select SUPPORT_SPL

config TARGET_SMDK5250
	bool "SMDK5250 board"
	select OF_CONTROL
	select SUPPORT_SPL

config TARGET_SNOW
	bool "Snow board"
	select OF_CONTROL
	select SUPPORT_SPL

config TARGET_SPRING
	bool "Spring board"
	select OF_CONTROL
	select SUPPORT_SPL

config TARGET_SMDK5420
	bool "SMDK5420 board"
	select OF_CONTROL
	select SUPPORT_SPL

config TARGET_PEACH_PI
	bool "Peach Pi board"
	select OF_CONTROL
	select SUPPORT_SPL

config TARGET_PEACH_PIT
	bool "Peach Pit board"
	select OF_CONTROL
	select SUPPORT_SPL

endchoice
endif

if ARCH_EXYNOS7

choice
	prompt "EXYNOS7 board select"

config  TARGET_ESPRESSO7420
	bool "ESPRESSO7420 board"
	select ARM64
	select ARMV8_MULTIENTRY
	select CLK_EXYNOS
	select OF_CONTROL
	select PINCTRL
	select PINCTRL_EXYNOS7420
	select SUPPORT_SPL

endchoice
endif

config SYS_SOC
	default "exynos"

source "board/samsung/smdkv310/Kconfig"
source "board/samsung/trats/Kconfig"
source "board/samsung/universal_c210/Kconfig"
source "board/samsung/origen/Kconfig"
source "board/samsung/trats2/Kconfig"
source "board/samsung/odroid/Kconfig"
source "board/samsung/arndale/Kconfig"
source "board/samsung/smdk5250/Kconfig"
source "board/samsung/smdk5420/Kconfig"
source "board/samsung/espresso7420/Kconfig"

config SPL_LDSCRIPT
	default "board/samsung/common/exynos-uboot-spl.lds" if ARCH_EXYNOS5 || ARCH_EXYNOS4

endif
```

## release/src-rt-5.04behnd.4916/bootloaders/u-boot-2019.07/arch/arm/mach-imx/imx8/Kconfig
```kconfig
if ARCH_IMX8

config IMX8
	bool

config MU_BASE_SPL
	hex "MU base address used in SPL"
	default 0x5d1b0000
	help
	  SPL runs in EL3 mode, it use MU0_A to communicate with SCU.
	  So we could not reuse the one in dts which is for normal U-Boot.

config IMX8QM
	select IMX8
	select SUPPORT_SPL
	bool

config IMX8QXP
	select IMX8
	select SUPPORT_SPL
	bool

config SYS_SOC
	default "imx8"

choice
	prompt "i.MX8 board select"
	optional

config TARGET_APALIS_IMX8
	bool "Support Apalis iMX8 module"
	select BOARD_LATE_INIT
	select IMX8QM

config TARGET_COLIBRI_IMX8X
	bool "Support Colibri iMX8X module"
	select BOARD_LATE_INIT
	select IMX8QXP

config TARGET_IMX8QM_MEK
	bool "Support i.MX8QM MEK board"
	select BOARD_LATE_INIT
	select IMX8QM

config TARGET_IMX8QXP_MEK
	bool "Support i.MX8QXP MEK board"
	select BOARD_LATE_INIT
	select IMX8QXP

endchoice

source "board/freescale/imx8qm_mek/Kconfig"
source "board/freescale/imx8qxp_mek/Kconfig"
source "board/toradex/apalis-imx8/Kconfig"
source "board/toradex/colibri-imx8x/Kconfig"

endif
```

## release/src-rt-5.04behnd.4916/bootloaders/u-boot-2019.07/arch/arm/mach-imx/mx2/Kconfig
```kconfig
if ARCH_MX25

config MX25
	bool
	default y
	select SYS_FSL_ERRATUM_ESDHC_A001
choice
	prompt "MX25 board select"
	optional

config TARGET_MX25PDK
	bool "Support mx25pdk"
	select BOARD_LATE_INIT
	select CPU_ARM926EJS
	select BOARD_EARLY_INIT_F

config TARGET_ZMX25
	bool "Support zmx25"
	select BOARD_LATE_INIT
	select CPU_ARM926EJS

endchoice

config SYS_SOC
	default "mx25"

source "board/freescale/mx25pdk/Kconfig"
source "board/syteco/zmx25/Kconfig"

endif
```

## release/src-rt-5.04behnd.4916/bootloaders/u-boot-2019.07/arch/arm/mach-imx/mx3/Kconfig
```kconfig
if ARCH_MX31

config MX31
       bool
       default y
choice
	prompt "MX31 board select"
	optional

config TARGET_MX31PDK
	bool "Support the i.MX31 PDK board from Freescale/NXP"
	select BOARD_EARLY_INIT_F
	select BOARD_LATE_INIT
	select SUPPORT_SPL

endchoice

config MX31_HCLK_FREQ
       int "i.MX31 HCLK frequency"
       default 26000000
       help
         Frequency in Hz of the high frequency input clock. Typically
	 26000000 Hz.

config MX31_CLK32
       int "i.MX31 CLK32 Frequency"
       default 32768
       help
         Frequency in Hz of the low frequency input clock. Typically
	 32768 or 32000 Hz.

source "board/freescale/mx31pdk/Kconfig"

endif
```

## release/src-rt-5.04behnd.4916/bootloaders/u-boot-2019.07/arch/arm/mach-imx/mx7ulp/Kconfig
```kconfig
if ARCH_MX7ULP

config SYS_SOC
	default "mx7ulp"

choice
	prompt "MX7ULP board select"
	optional

config TARGET_MX7ULP_EVK
        bool "Support mx7ulp EVK board"
	select SYS_ARCH_TIMER

endchoice

source "board/freescale/mx7ulp_evk/Kconfig"

endif
```

## release/src-rt-5.04behnd.4916/bootloaders/u-boot-2019.07/arch/arm/mach-imx/mxs/Kconfig
```kconfig
if ARCH_MX23

config MX23
	bool
	default y

choice
	prompt "MX23 board select"
	optional

config TARGET_MX23_OLINUXINO
	bool "Support mx23_olinuxino"
	select BOARD_EARLY_INIT_F

config TARGET_MX23EVK
	bool "Support mx23evk"
	select BOARD_EARLY_INIT_F

config TARGET_SANSA_FUZE_PLUS
	bool "Support sansa_fuze_plus"

config TARGET_XFI3
	bool "Support xfi3"

endchoice

config SYS_SOC
	default "mxs"

source "board/olimex/mx23_olinuxino/Kconfig"
source "board/freescale/mx23evk/Kconfig"
source "board/sandisk/sansa_fuze_plus/Kconfig"
source "board/creative/xfi3/Kconfig"

endif

if ARCH_MX28

config MX28
	bool
	default y

choice
	prompt "MX28 board select"
	optional

config TARGET_APX4DEVKIT
	bool "Support apx4devkit"

config TARGET_BG0900
	bool "Support bg0900"

config TARGET_MX28EVK
	bool "Support mx28evk"
	select BOARD_EARLY_INIT_F

config TARGET_SC_SPS_1
	bool "Support sc_sps_1"

config TARGET_TS4600
	bool "Support TS4600"

endchoice

config SYS_SOC
	default "mxs"

source "board/bluegiga/apx4devkit/Kconfig"
source "board/freescale/mx28evk/Kconfig"
source "board/ppcag/bg0900/Kconfig"
source "board/schulercontrol/sc_sps_1/Kconfig"
source "board/technologic/ts4600/Kconfig"

endif
```

## release/src-rt-5.04behnd.4916/bootloaders/u-boot-2019.07/arch/arm/mach-integrator/Kconfig
```kconfig
menu "Integrator Options"
	depends on ARCH_INTEGRATOR

choice
	prompt "Integrator platform select"
	optional

config ARCH_INTEGRATOR_AP
	bool "Support Integrator/AP platform"

config ARCH_INTEGRATOR_CP
	bool "Support Integrator/CP platform"
	select ARCH_CINTEGRATOR

endchoice

config ARCH_CINTEGRATOR
	bool

choice
	prompt "Integrator core module select"
	optional

config CM720T
	bool "Core Module for ARM720T"
	select CPU_ARM720T

config CM920T
	bool "Core Module for ARM920T"
	select CPU_ARM920T

config CM926EJ_S
	bool "Core Module for ARM926EJ-STM"
	select CPU_ARM926EJS

config CM946ES
	bool "Core Module for ARM946E-STM"
	select CPU_ARM946ES

config CM1136
	bool "Core Module for ARM1136JF-STM"
	select CPU_ARM1136

endchoice

config SYS_BOARD
	default "integrator"

config SYS_VENDOR
	default "armltd"

config SYS_CONFIG_NAME
	default "integratorap" if ARCH_INTEGRATOR_AP
	default "integratorcp" if ARCH_INTEGRATOR_CP

config SYS_MALLOC_F_LEN
	default 0x2000

endmenu
```

## release/src-rt-5.04behnd.4916/bootloaders/u-boot-2019.07/arch/arm/mach-k3/Kconfig
```kconfig
if ARCH_K3

choice
	prompt "Texas Instruments' K3 based SoC select"
	optional

config SOC_K3_AM6
	bool "TI's K3 based AM6 SoC Family Support"

endchoice

config SYS_SOC
	default "k3"

config SYS_K3_NON_SECURE_MSRAM_SIZE
	hex
	default 0x80000
	help
	  Describes the total size of the MCU MSRAM. This doesn't
	  specify the total size of SPL as ROM can use some part
	  of this RAM. Once ROM gives control to SPL then this
	  complete size can be usable.

config SYS_K3_MAX_DOWNLODABLE_IMAGE_SIZE
	hex
	default 0x58000
	help
	  Describes the maximum size of the image that ROM can download
	  from any boot media.

config SYS_K3_MCU_SCRATCHPAD_BASE
	hex
	default 0x40280000 if SOC_K3_AM6
	help
	  Describes the base address of MCU Scratchpad RAM.

config SYS_K3_MCU_SCRATCHPAD_SIZE
	hex
	default 0x200 if SOC_K3_AM6
	help
	  Describes the size of MCU Scratchpad RAM.

config SYS_K3_BOOT_PARAM_TABLE_INDEX
	hex
	default 0x41c7fbfc if SOC_K3_AM6
	help
	  Address at which ROM stores the value which determines if SPL
	  is booted up by primary boot media or secondary boot media.

config SYS_K3_KEY
	string "Key used to generate x509 certificate"
	help
	  This option enables to provide a custom key that can be used for
	  generating x509 certificate for spl binary. If not needed leave
	  it blank so that a random key is generated and used.

config SYS_K3_BOOT_CORE_ID
	int
	default 16

config SYS_K3_SPL_ATF
	bool "Start Cortex-A from SPL"
	depends on SPL && CPU_V7R
	help
	  Enabling this will try to start Cortex-A (typically with ATF)
	  after SPL from R5.

source "board/ti/am65x/Kconfig"
endif
```

## release/src-rt-5.04behnd.4916/bootloaders/u-boot-2019.07/arch/arm/mach-kirkwood/Kconfig
```kconfig
if KIRKWOOD

choice
	prompt "Marvell Kirkwood board select"
	optional

config TARGET_OPENRD
	bool "Marvell OpenRD Board"

config TARGET_DREAMPLUG
	bool "DreamPlug Board"

config TARGET_DS109
	bool "Synology DS109"

config TARGET_GURUPLUG
	bool "GuruPlug Board"

config TARGET_SHEEVAPLUG
	bool "SheevaPlug Board"

config TARGET_LSXL
	bool "lsxl Board"

config TARGET_POGO_E02
	bool "pogo_e02 Board"

config TARGET_DNS325
	bool "dns325 Board"

config TARGET_ICONNECT
	bool "iconnect Board"

config TARGET_KM_KIRKWOOD
	bool "KM_KIRKWOOD Board"
	select BOARD_LATE_INIT
	imply CMD_CRAMFS
	imply CMD_DIAG
	imply FS_CRAMFS

config TARGET_NET2BIG_V2
	bool "LaCie 2Big Network v2 NAS Board"

config TARGET_NETSPACE_V2
	bool "LaCie netspace_v2 Board"

config TARGET_IB62X0
	bool "ib62x0 Board"

config TARGET_DOCKSTAR
	bool "Dockstar Board"

config TARGET_GOFLEXHOME
	bool "GoFlex Home Board"

config TARGET_NAS220
	bool "BlackArmor NAS220"

config TARGET_NSA310S
	bool "Zyxel NSA310S"

config TARGET_SBx81LIFKW
	bool "Allied Telesis SBx81GS24/SBx81GT40/SBx81XS6/SBx81XS16"

config TARGET_SBx81LIFXCAT
	bool "Allied Telesis SBx81GP24/SBx81GT24"

config TARGET_DB_88F6281_BP
	bool "Marvell DB-88F6281-BP"

endchoice

config SYS_SOC
	default "kirkwood"

source "board/Marvell/openrd/Kconfig"
source "board/Marvell/dreamplug/Kconfig"
source "board/Synology/ds109/Kconfig"
source "board/Marvell/guruplug/Kconfig"
source "board/Marvell/sheevaplug/Kconfig"
source "board/buffalo/lsxl/Kconfig"
source "board/cloudengines/pogo_e02/Kconfig"
source "board/d-link/dns325/Kconfig"
source "board/iomega/iconnect/Kconfig"
source "board/keymile/km_arm/Kconfig"
source "board/LaCie/net2big_v2/Kconfig"
source "board/LaCie/netspace_v2/Kconfig"
source "board/raidsonic/ib62x0/Kconfig"
source "board/Seagate/dockstar/Kconfig"
source "board/Seagate/goflexhome/Kconfig"
source "board/Seagate/nas220/Kconfig"
source "board/zyxel/nsa310s/Kconfig"
source "board/alliedtelesis/SBx81LIFKW/Kconfig"
source "board/alliedtelesis/SBx81LIFXCAT/Kconfig"
source "board/Marvell/db-88f6281-bp/Kconfig"

endif
```

## release/src-rt-5.04behnd.4916/bootloaders/u-boot-2019.07/arch/arm/mach-mediatek/Kconfig
```kconfig
if ARCH_MEDIATEK

config SYS_SOC
	default "mediatek"

config SYS_VENDOR
	default "mediatek"

choice
	prompt "MediaTek board select"

config TARGET_MT7623
	bool "MediaTek MT7623 SoC"
	select CPU_V7A
	help
	  The MediaTek MT7623 is a ARM-based SoC with a quad-core Cortex-A7
	  including NEON and GPU, Mali-450 graphics, several DDR3 options,
	  crypto engine, built-in Wi-Fi / Bluetooth combo chip, JPEG decoder,
	  video interfaces supporting HDMI and MIPI, and video codec support.
	  Peripherals include Gigabit Ethernet, switch, USB3.0 and OTG, PCIe,
	  I2S, PCM, S/PDIF, UART, SPI, I2C, IR TX/RX, and PWM.

config TARGET_MT7629
	bool "MediaTek MT7629 SoC"
	select CPU_V7A
	select SPL
	help
	  The MediaTek MT7629 is a ARM-based SoC with a dual-core Cortex-A7
	  including DDR3, crypto engine, 3x3 11n/ac Wi-Fi, Gigabit Ethernet,
	  switch, USB3.0, PCIe, UART, SPI, I2C and PWM.

config TARGET_MT8516
	bool "MediaTek MT8516 SoC"
	select ARM64
	help
	  The MediaTek MT8516 is a ARM64-based SoC with a quad-core Cortex-A35.
	  including UART, SPI, USB2.0 and OTG, SD and MMC cards, NAND, PWM,
	  Ethernet, IR TX/RX, I2C, I2S, S/PDIF, and built-in Wi-Fi / Bluetooth combo
	  chip and several DDR3 and DDR4 options.

endchoice

source "board/mediatek/mt7623/Kconfig"
source "board/mediatek/mt7629/Kconfig"

endif
```
