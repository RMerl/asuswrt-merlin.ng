## release/src-rt-5.04behnd.4916/bootloaders/u-boot-2019.07/arch/arm/mach-orion5x/Kconfig
```kconfig
if ORION5X

choice
	prompt "Marvell Orion board select"
	optional

config TARGET_EDMINIV2
	bool "LaCie Ethernet Disk mini V2"
	select SUPPORT_SPL

endchoice

config SYS_SOC
	default "orion5x"

source "board/LaCie/edminiv2/Kconfig"

config SPL_LDSCRIPT
	default "$(CPUDIR)/orion5x/u-boot-spl.lds" if ORION5X

endif
```

## release/src-rt-5.04behnd.4916/bootloaders/u-boot-2019.07/arch/arm/mach-owl/Kconfig
```kconfig
if ARCH_OWL

config SYS_SOC
	default "owl"

choice
        prompt "Actions Semi OWL SoCs board select"
        optional

config TARGET_BUBBLEGUM_96
	bool "96Boards Bubblegum-96"
	help
	  Support for 96Boards Bubblegum-96. This board complies with
	  96Board Consumer Edition Specification. Features:
	  - Actions Semi S900 SoC (4xCortex A53, Power VR G6230 GPU)
	  - 2GiB RAM
	  - 8GiB eMMC, uSD slot
	  - WiFi, Bluetooth and GPS module
	  - 2x Host, 1x Device USB port
	  - HDMI
	  - 20-pin low speed and 40-pin high speed expanders, 6 LED, 3 buttons

endchoice

source "board/ucRobotics/bubblegum_96/Kconfig"

endif
```

## release/src-rt-5.04behnd.4916/bootloaders/u-boot-2019.07/arch/arm/mach-rmobile/Kconfig
```kconfig
if ARCH_RMOBILE

choice
	prompt "Target Renesas SoC select"
	default RCAR_32

config RCAR_32
	bool "Renesas ARM SoCs R-Car Gen1/Gen2 (32bit)"
	select CPU_V7A

config RCAR_GEN3
	bool "Renesas ARM SoCs R-Car Gen3 (64bit)"
	select ARM64
	select PHY
	select CMD_CACHE
	select PINCTRL
	select PINCONF
	select PINCTRL_PFC
	select SUPPORT_SPL
	imply CMD_FS_UUID
	imply CMD_GPT
	imply CMD_UUID
	imply CMD_MMC_SWRITE if MMC
	imply SUPPORT_EMMC_RPMB if MMC
	imply SPL
	imply SPL_BOARD_INIT
	imply SPL_GZIP
	imply SPL_LIBCOMMON_SUPPORT
	imply SPL_LIBGENERIC_SUPPORT
	imply SPL_SERIAL_SUPPORT
	imply SPL_SYS_MALLOC_SIMPLE
	imply SPL_TINY_MEMSET
	imply SPL_YMODEM_SUPPORT
	imply USE_TINY_PRINTF

config RZA1
	prompt "Renesas ARM SoCs RZ/A1 (32bit)"
	select CPU_V7A

endchoice

source "arch/arm/mach-rmobile/Kconfig.32"
source "arch/arm/mach-rmobile/Kconfig.64"
source "arch/arm/mach-rmobile/Kconfig.rza1"

endif
```

## release/src-rt-5.04behnd.4916/bootloaders/u-boot-2019.07/arch/arm/mach-rmobile/Kconfig.32
```kconfig
if RCAR_32

config ARCH_RMOBILE_BOARD_STRING
	string "Renesas RCar Gen2 board name"
	default "Board"

config RCAR_GEN2
	bool "Renesas RCar Gen2"
	select PHY
	select PHY_RCAR_GEN2

config R8A7740
	bool "Renesas SoC R8A7740"

config R8A7790
	bool "Renesas SoC R8A7790"
	select RCAR_GEN2
	select ARM_CORTEX_A15_CVE_2017_5715
	imply CLK_R8A7790
	imply PINCTRL_PFC_R8A7790

config R8A7791
	bool "Renesas SoC R8A7791"
	select RCAR_GEN2
	select ARM_CORTEX_A15_CVE_2017_5715
	imply CLK_R8A7791
	imply PINCTRL_PFC_R8A7791

config R8A7792
	bool "Renesas SoC R8A7792"
	select RCAR_GEN2
	select ARM_CORTEX_A15_CVE_2017_5715
	imply CLK_R8A7792
	imply PINCTRL_PFC_R8A7792

config R8A7793
	bool "Renesas SoC R8A7793"
	select RCAR_GEN2
	select ARM_CORTEX_A15_CVE_2017_5715
	imply CLK_R8A7793
	imply PINCTRL_PFC_R8A7793

config R8A7794
	bool "Renesas SoC R8A7794"
	select RCAR_GEN2
	imply CLK_R8A7794
	imply PINCTRL_PFC_R8A7794

choice
	prompt "Renesas ARM SoCs board select"
	optional

config TARGET_ARMADILLO_800EVA
	bool "armadillo 800 eva board"

config TARGET_BLANCHE
	bool "Blanche board"
	select DM
	select DM_SERIAL
	select USE_TINY_PRINTF
	imply CMD_DM

config TARGET_GOSE
	bool "Gose board"
	select DM
	select DM_SERIAL
	select SPL_TINY_MEMSET
	select SUPPORT_SPL
	select USE_TINY_PRINTF
	imply CMD_DM

config TARGET_KOELSCH
	bool "Koelsch board"
	select DM
	select DM_SERIAL
	select SPL_TINY_MEMSET
	select SUPPORT_SPL
	select USE_TINY_PRINTF
	imply CMD_DM

config TARGET_LAGER
	bool "Lager board"
	select DM
	select DM_SERIAL
	select SPL_TINY_MEMSET
	select SUPPORT_SPL
	select USE_TINY_PRINTF
	imply CMD_DM

config TARGET_KZM9G
	bool "KZM9D board"

config TARGET_ALT
	bool "Alt board"
	select DM
	select DM_SERIAL
	select SPL_TINY_MEMSET
	select SUPPORT_SPL
	select USE_TINY_PRINTF
	imply CMD_DM

config TARGET_SILK
	bool "Silk board"
	select DM
	select DM_SERIAL
	select SPL_TINY_MEMSET
	select SUPPORT_SPL
	select USE_TINY_PRINTF
	imply CMD_DM

config TARGET_PORTER
	bool "Porter board"
	select DM
	select DM_SERIAL
	select SPL_TINY_MEMSET
	select SUPPORT_SPL
	select USE_TINY_PRINTF
	imply CMD_DM

config TARGET_STOUT
	bool "Stout board"
	select DM
	select DM_SERIAL
	select SPL_TINY_MEMSET
	select SUPPORT_SPL
	select USE_TINY_PRINTF
	imply CMD_DM

endchoice

config SYS_SOC
	default "rmobile"

config RMOBILE_EXTRAM_BOOT
	bool "Enable boot from RAM"
	depends on TARGET_ALT || TARGET_BLANCHE || TARGET_KOELSCH || TARGET_LAGER || TARGET_PORTER || TARGET_SILK || TARGET_STOUT
	default n

choice
	prompt "Qos setting primary"
	depends on TARGET_ALT || TARGET_BLANCHE || TARGET_GOSE || TARGET_KOELSCH || TARGET_LAGER
	default QOS_PRI_NORMAL

config QOS_PRI_NORMAL
	bool "Non primary"
	help
	   Select normal mode for QoS setting.

config QOS_PRI_MEDIA
	bool "Media primary"
	help
	   Select multimedia primary mode for QoS setting.

config QOS_PRI_GFX
	bool "GFX primary"
	help
	   Select GFX(graphics) primary mode for QoS setting.

endchoice

source "board/atmark-techno/armadillo-800eva/Kconfig"
source "board/renesas/blanche/Kconfig"
source "board/renesas/gose/Kconfig"
source "board/renesas/koelsch/Kconfig"
source "board/renesas/lager/Kconfig"
source "board/kmc/kzm9g/Kconfig"
source "board/renesas/alt/Kconfig"
source "board/renesas/silk/Kconfig"
source "board/renesas/porter/Kconfig"
source "board/renesas/stout/Kconfig"

endif
```

## release/src-rt-5.04behnd.4916/bootloaders/u-boot-2019.07/arch/arm/mach-rockchip/fit_spl_optee.its
```
/*
 * Copyright (C) 2017 Rockchip Electronic Co.,Ltd
 *
 * Simple U-boot fit source file containing U-Boot, dtb and optee
 */

/dts-v1/;

/ {
	description = "Simple image with OP-TEE support";
	#address-cells = <1>;

	images {
		uboot@1 {
			description = "U-Boot";
			data = /incbin/("../../../u-boot-nodtb.bin");
			type = "standalone";
			os = "U-Boot";
			arch = "arm";
			compression = "none";
			load = <0x61000000>;
		};
		optee@1 {
			description = "OP-TEE";
			data = /incbin/("../../../tee.bin");
			type = "firmware";
			arch = "arm";
			os = "tee";
			compression = "none";
			load = <0x68400000>;
			entry = <0x68400000>;
		};
		fdt@1 {
			description = "dtb";
			data = /incbin/("../../../u-boot.dtb");
			type = "flat_dt";
			compression = "none";
		};
	};

	configurations {
		default = "conf@1";
		conf@1 {
			description = "Rockchip armv7 with OP-TEE";
			firmware = "optee@1";
			loadables = "uboot@1";
			fdt = "fdt@1";
		};
	};
};
```

## release/src-rt-5.04behnd.4916/bootloaders/u-boot-2019.07/arch/arm/mach-rockchip/rk3128/Kconfig
```kconfig
if ROCKCHIP_RK3128

choice
	prompt "RK3128 board select"

config TARGET_EVB_RK3128
	bool "RK3128 evaluation board"
	select BOARD_LATE_INIT
	help
	  RK3128evb is a evaluation board for Rockchip rk3128,
	  with full function and phisical connectors support like
	  usb2.0 host ports, LVDS, JTAG, MAC, SDcard, HDMI, USB-2-serial...

endchoice

config SYS_SOC
	default "rk3128"

config SYS_MALLOC_F_LEN
	default 0x0800

source "board/rockchip/evb_rk3128/Kconfig"

endif
```

## release/src-rt-5.04behnd.4916/bootloaders/u-boot-2019.07/arch/arm/mach-rockchip/rk3399/Kconfig
```kconfig
if ROCKCHIP_RK3399

choice
	prompt "RK3399 board select"

config TARGET_EVB_RK3399
	bool "RK3399 evaluation board"
	help
	  RK3399evb is a evaluation board for Rockchp rk3399,
	  with full function and phisical connectors support like type-C ports,
	  usb2.0 host ports, LVDS, JTAG, MAC, SDcard, HDMI, USB-2-serial...

config TARGET_PUMA_RK3399
	bool "Theobroma Systems RK3399-Q7 (Puma)"
	help
	  The RK3399-Q7 (Puma) is a system-on-module (designed and
	  marketed by Theobroma Systems) featuring the Rockchip RK3399
	  in a Qseven-compatible form-factor (running of a single 5V
	  supply and exposing its external interfaces on a MXM-230
	  connector).

	  Key features of the RK3399-Q7 include:
	   * on-module USB 3.0 hub (2x USB 3.0 host + 1x USB 2.0 host)
	   * USB 3.0 dual-role
	   * on-module Micrel KSZ9031 GbE PHY
	   * on-module eMMC (up to 256GB configurations available)
	   * on-module DDR3 (1GB, 2GB and 4GB configurations available)
	   * HDMI, eDP, MIPI-DSI, MIPI-DSI/CSI and MIPI-CSI
	   * SPI, I2C, I2S, UART, GPIO, ...

config TARGET_ROCK960_RK3399
	bool "Vamrs Limited Rock960 board family"
	help
	  Support for Rock960 board family by Vamrs Limited. This board
	  family consists of Rock960 (Consumer Edition) and Ficus
	  (Enterprise Edition) 96Boards.

	  Common features implemented on both boards:
	   * Rockchip RK3399 SoC (2xCortex A72, 4xCortex A53, ARM Mali T860MP4)
	   * 16/32GB eMMC, uSD slot
	   * HDMI/DP/MIPI
	   * 20-pin low speed and 40-pin high speed expanders, 6 LED, 3 buttons

	  Additional features of Rock960:
	   * 2GiB/4GiB LPDDR3 RAM
	   * 1x USB 3.0 type A, 1x USB 2.0 type A (host mode only),
	     1x USB 3.0 type C OTG

	  Additional features of Ficus:
	   * 2GiB/4GiB DDR3 RAM
	   * Ethernet
	   * Dual SATA
	   * 2x USB 3.0 type A, 2x USB 2.0 type A (host mode only),
	     1x USB 3.0 type C OTG

config TARGET_CHROMEBOOK_BOB
	bool "Asus Flip C101PA Chromebook (RK3399)"
	help
	  Bob is a small RK3299-based device similar in apperance to Minnie.
	  It has two USB 3.0 type-C ports, 4GB of SDRAM, WiFi and a 10.1",
	  1280x800 display. It uses its USB ports for both power and external
	  display. It includes a Chrome OS EC (Cortex-M3) to provide access to
	  the keyboard and battery functions.

endchoice

config SYS_SOC
	default "rk3399"

config SYS_MALLOC_F_LEN
	default 0x0800

source "board/rockchip/evb_rk3399/Kconfig"
source "board/theobroma-systems/puma_rk3399/Kconfig"
source "board/vamrs/rock960_rk3399/Kconfig"
source "board/google/gru/Kconfig"

endif
```

## release/src-rt-5.04behnd.4916/bootloaders/u-boot-2019.07/arch/arm/mach-rockchip/rv1108/Kconfig
```kconfig
if ROCKCHIP_RV1108

config TARGET_EVB_RV1108
	bool "EVB_RV1108"
	help
	  RV1108 EVB is a evaluation board for Rockchp RV1108.

	  Key features of the board include:
	   * one macro USB OTG port
	   * one USB HOST port
	   * one RS232 to USB port route to UART2 as debug port
	   * MIPI screen with resolution 720 x 1280
	   * 128M DDR3
	   * 64M SPI Nor Flash
	   * macro SD card interface
	   * HDMI output
	   * 10/100 Mbps Ethernet
	   * camera interface compatible with imx323 / ov2710 / ov4689

config TARGET_ELGIN_RV1108
	bool "ELGIN_RV1108"
	help
	  RV1108 ELGIN is a board based on the Rockchip RV1108.

config SYS_SOC
	default "rv1108"

config SYS_MALLOC_F_LEN
	default 0x400

source board/rockchip/evb_rv1108/Kconfig
source board/elgin/elgin_rv1108/Kconfig

endif
```

## release/src-rt-5.04behnd.4916/bootloaders/u-boot-2019.07/arch/arm/mach-s5pc1xx/Kconfig
```kconfig
if ARCH_S5PC1XX

choice
	prompt "S5PC1XX board select"
	optional

config TARGET_S5P_GONI
	bool "S5P Goni board"
	select OF_CONTROL
	select BLK
	select DM_MMC

config TARGET_SMDKC100
	bool "Support smdkc100 board"
	select OF_CONTROL

endchoice

config SYS_SOC
	default "s5pc1xx"

source "board/samsung/goni/Kconfig"
source "board/samsung/smdkc100/Kconfig"

endif
```

## release/src-rt-5.04behnd.4916/bootloaders/u-boot-2019.07/arch/arm/mach-stm32/stm32h7/Kconfig
```kconfig
if STM32H7

config TARGET_STM32H743_DISCO
	bool "STM32H743 Discovery board"

config TARGET_STM32H743_EVAL
	bool "STM32H743 Evaluation board"

source "board/st/stm32h743-eval/Kconfig"
source "board/st/stm32h743-disco/Kconfig"

endif
```
