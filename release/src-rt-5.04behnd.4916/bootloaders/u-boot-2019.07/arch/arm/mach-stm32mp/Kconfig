## release/src-rt-5.04behnd.4916/bootloaders/u-boot-2019.07/arch/arm/mach-tegra/tegra114/Kconfig
```kconfig
if TEGRA114

choice
	prompt "Tegra114 board select"
	optional

config TARGET_DALMORE
	bool "NVIDIA Tegra114 Dalmore evaluation board"
	select BOARD_LATE_INIT

endchoice

config SYS_SOC
	default "tegra114"

source "board/nvidia/dalmore/Kconfig"

endif
```

## release/src-rt-5.04behnd.4916/bootloaders/u-boot-2019.07/arch/arm/mach-tegra/tegra210/Kconfig
```kconfig
if TEGRA210

choice
	prompt "Tegra210 board select"

config TARGET_E2220_1170
	bool "NVIDIA Tegra210 E2220-1170 board"
	select BOARD_LATE_INIT
	help
	  E2220-1170 is a Tegra210 bringup board with onboard SoC, DRAM,
	  eMMC, SD card slot, HDMI, USB micro-B port, and sockets for various
	  expansion modules.

config TARGET_P2371_0000
	bool "NVIDIA Tegra210 P2371-0000 board"
	select BOARD_LATE_INIT
	help
	  P2371-0000 is a P2581 or P2530 CPU board married to a P2595 I/O
	  board. The combination contains SoC, DRAM, eMMC, SD card slot,
	  HDMI, USB micro-B port, Ethernet via USB3, USB3 host port, SATA,
	  a GPIO expansion header, and an analog audio jack.

config TARGET_P2371_2180
	bool "NVIDIA Tegra210 P2371-2180 (Jetson TX1) board"
	select BOARD_LATE_INIT
	help
	  P2371-2180 (Jetson TX1 developer kit) is a P2180 CPU board married
	  to a P2597 I/O board. The combination contains SoC, DRAM, eMMC, SD
	  card slot, HDMI, USB micro-B port, Ethernet via USB3, USB3 host
	  port, SATA, PCIe, and two GPIO expansion headers.

config TARGET_P2571
	bool "NVIDIA Tegra210 P2571 base board"
	select BOARD_LATE_INIT
	help
	  P2571 is a P2530 married to a P1963 I/O board

endchoice

config SYS_SOC
	default "tegra210"

config SYS_INIT_SP_BSS_OFFSET
	default 524288

source "board/nvidia/e2220-1170/Kconfig"
source "board/nvidia/p2371-0000/Kconfig"
source "board/nvidia/p2371-2180/Kconfig"
source "board/nvidia/p2571/Kconfig"

endif
```

## release/src-rt-5.04behnd.4916/bootloaders/u-boot-2019.07/arch/arm/mach-tegra/tegra30/Kconfig
```kconfig
if TEGRA30

choice
	prompt "Tegra30 board select"
	optional

config TARGET_APALIS_T30
	bool "Toradex Apalis T30 board"
	select BOARD_LATE_INIT

config TARGET_BEAVER
	bool "NVIDIA Tegra30 Beaver evaluation board"
	select BOARD_LATE_INIT

config TARGET_CARDHU
	bool "NVIDIA Tegra30 Cardhu evaluation board"
	select BOARD_LATE_INIT

config TARGET_COLIBRI_T30
	bool "Toradex Colibri T30 board"
	select BOARD_LATE_INIT

config TARGET_TEC_NG
	bool "Avionic Design TEC-NG board"
	select BOARD_LATE_INIT

endchoice

config SYS_SOC
	default "tegra30"

source "board/toradex/apalis_t30/Kconfig"
source "board/nvidia/beaver/Kconfig"
source "board/nvidia/cardhu/Kconfig"
source "board/toradex/colibri_t30/Kconfig"
source "board/avionic-design/tec-ng/Kconfig"

endif
```

## release/src-rt-5.04behnd.4916/bootloaders/u-boot-2019.07/arch/arm/mach-uniphier/Kconfig
```kconfig
if ARCH_UNIPHIER

config SYS_CONFIG_NAME
	default "uniphier"

config ARCH_UNIPHIER_32BIT
	bool
	select ARCH_SUPPORT_PSCI
	select ARMV7_NONSEC
	select CPU_V7A
	select CPU_V7_HAS_NONSEC

choice
        prompt "UniPhier SoC select"
        default ARCH_UNIPHIER_V7_MULTI

config ARCH_UNIPHIER_LD4_SLD8
	bool "UniPhier LD4/sLD8 SoCs"
	select ARCH_UNIPHIER_32BIT

config ARCH_UNIPHIER_V7_MULTI
	bool "UniPhier Pro4/Pro5/PXs2/LD6b SoCs"
	select ARCH_UNIPHIER_32BIT

config ARCH_UNIPHIER_V8_MULTI
	bool "UniPhier V8 SoCs"
	depends on !SPL
	select ARM64
	select CMD_UNZIP

endchoice

config ARCH_UNIPHIER_LD4
	bool "Enable UniPhier LD4 SoC support"
	depends on ARCH_UNIPHIER_LD4_SLD8
	default y

config ARCH_UNIPHIER_SLD8
	bool "Enable UniPhier sLD8 SoC support"
	depends on ARCH_UNIPHIER_LD4_SLD8
	default y

config ARCH_UNIPHIER_PRO4
	bool "Enable UniPhier Pro4 SoC support"
	depends on ARCH_UNIPHIER_V7_MULTI
	default y

config ARCH_UNIPHIER_PRO5
	bool "Enable UniPhier Pro5 SoC support"
	depends on ARCH_UNIPHIER_V7_MULTI
	default y

config ARCH_UNIPHIER_PXS2
	bool "Enable UniPhier Pxs2 SoC support"
	depends on ARCH_UNIPHIER_V7_MULTI
	default y

config ARCH_UNIPHIER_LD6B
	bool "Enable UniPhier LD6b SoC support"
	depends on ARCH_UNIPHIER_V7_MULTI
	default y

config ARCH_UNIPHIER_LD11
	bool "Enable UniPhier LD11 SoC support"
	depends on ARCH_UNIPHIER_V8_MULTI
	default y

config ARCH_UNIPHIER_LD20
	bool "Enable UniPhier LD20 SoC support"
	depends on ARCH_UNIPHIER_V8_MULTI
	default y
	select OF_BOARD_SETUP

config ARCH_UNIPHIER_PXS3
	bool "Enable UniPhier PXs3 SoC support"
	depends on ARCH_UNIPHIER_V8_MULTI
	default y

config CACHE_UNIPHIER
	bool "Enable the UniPhier L2 cache controller"
	depends on ARCH_UNIPHIER_32BIT
	default y
	select SYS_CACHE_SHIFT_7
	help
	  This option allows to use the UniPhier System Cache as L2 cache.

config MICRO_SUPPORT_CARD
	bool "Use Micro Support Card"
	help
	  This option provides support for the expansion board, available
	  on some UniPhier reference boards.

	  Say Y to use the on-board UART, Ether, LED devices.

config CMD_PINMON
	bool "Enable boot mode pins monitor command"
	default y
	help
	  The command "pinmon" shows the state of the boot mode pins.
	  The boot mode pins are latched when the system reset is deasserted
	  and determine which device the system should load a boot image from.

config CMD_DDRPHY_DUMP
	bool "Enable dump command of DDR PHY parameters"
	depends on ARCH_UNIPHIER_LD4 || ARCH_UNIPHIER_PRO4 || \
		ARCH_UNIPHIER_SLD8 || ARCH_UNIPHIER_LD11
	default y
	help
	  The command "ddrphy" shows the resulting parameters of DDR PHY
	  training; it is useful for the evaluation of DDR PHY training.

config CMD_DDRMPHY_DUMP
	bool "Enable dump command of DDR Multi PHY parameters"
	depends on ARCH_UNIPHIER_PXS2 || ARCH_UNIPHIER_LD6B
	default y
	help
	  The command "ddrmphy" shows the resulting parameters of DDR Multi PHY
	  training; it is useful for the evaluation of DDR Multi PHY training.

config SYS_SOC
	default "uniphier-v7" if ARCH_UNIPHIER_LD4_SLD8 || ARCH_UNIPHIER_V7_MULTI
endif
```

## release/src-rt-5.04behnd.4916/bootloaders/u-boot-2019.07/arch/microblaze/Kconfig
```kconfig
menu "MicroBlaze architecture"
	depends on MICROBLAZE

config SYS_ARCH
	default "microblaze"

choice
	prompt "Target select"
	optional

config TARGET_MICROBLAZE_GENERIC
	bool "Support microblaze-generic"
	select BOARD_LATE_INIT
	select DM
	select DM_SERIAL
	select OF_CONTROL
	select SUPPORT_SPL
	select SYSRESET
	imply CMD_DM

endchoice

source "board/xilinx/microblaze-generic/Kconfig"

config SPL_LDSCRIPT
	default "arch/microblaze/cpu/u-boot-spl.lds"

endmenu
```

## release/src-rt-5.04behnd.4916/bootloaders/u-boot-2019.07/arch/mips/mach-ath79/Kconfig
```kconfig
menu "QCA/Atheros 7xxx/9xxx platforms"
	depends on ARCH_ATH79

config SYS_SOC
	default "ath79"

config SOC_AR933X
	bool
	select MIPS_TUNE_24KC
	select ROM_EXCEPTION_VECTORS
	select SUPPORTS_BIG_ENDIAN
	select SUPPORTS_CPU_MIPS32_R1
	select SUPPORTS_CPU_MIPS32_R2
	help
	  This supports QCA/Atheros ar933x family SOCs.

config SOC_AR934X
	bool
	select MIPS_TUNE_74KC
	select SUPPORTS_BIG_ENDIAN
	select SUPPORTS_CPU_MIPS32_R1
	select SUPPORTS_CPU_MIPS32_R2
	help
	  This supports QCA/Atheros ar934x family SOCs.

config SOC_QCA953X
	bool
	select MIPS_TUNE_24KC
	select ROM_EXCEPTION_VECTORS
	select SUPPORTS_BIG_ENDIAN
	select SUPPORTS_CPU_MIPS32_R1
	select SUPPORTS_CPU_MIPS32_R2
	help
	  This supports QCA/Atheros qca953x family SOCs.

config SOC_QCA956X
	bool
	select MIPS_TUNE_74KC
	select SUPPORTS_BIG_ENDIAN
	select SUPPORTS_CPU_MIPS32_R1
	select SUPPORTS_CPU_MIPS32_R2
	help
	  This supports QCA/Atheros qca956x family SOCs.

choice
	prompt "Board select"

config TARGET_AP121
	bool "AP121 Reference Board"
	select SOC_AR933X

config TARGET_AP143
	bool "AP143 Reference Board"
	select SOC_QCA953X

config TARGET_AP152
	bool "AP152 Reference Board"
	select SOC_QCA956X

config BOARD_TPLINK_WDR4300
	bool "TP-Link WDR4300 Board"
	select SOC_AR934X

endchoice

source "board/qca/ap121/Kconfig"
source "board/qca/ap143/Kconfig"
source "board/qca/ap152/Kconfig"
source "board/tplink/wdr4300/Kconfig"

endmenu
```

## release/src-rt-5.04behnd.4916/bootloaders/u-boot-2019.07/arch/nds32/Kconfig
```kconfig
menu "NDS32 architecture"
	depends on NDS32

config SYS_ARCH
	default "nds32"

choice
	prompt "Target select"
	optional

config TARGET_ADP_AG101P
	bool "Support adp-ag101p"

config TARGET_ADP_AE3XX
	bool "Support adp-ae3xx"

endchoice

config SYS_ICACHE_OFF
	bool "Do not enable icache"
	default n
	help
	  Do not enable instruction cache in U-Boot.

config SPL_SYS_ICACHE_OFF
	bool "Do not enable icache in SPL"
	depends on SPL
	default SYS_ICACHE_OFF
	help
	  Do not enable instruction cache in SPL.

config SYS_DCACHE_OFF
	bool "Do not enable dcache"
	default n
	help
	  Do not enable data cache in U-Boot.

config SPL_SYS_DCACHE_OFF
	bool "Do not enable dcache in SPL"
	depends on SPL
	default SYS_DCACHE_OFF
	help
	  Do not enable data cache in SPL.

source "board/AndesTech/adp-ag101p/Kconfig"
source "board/AndesTech/adp-ae3xx/Kconfig"

endmenu
```
