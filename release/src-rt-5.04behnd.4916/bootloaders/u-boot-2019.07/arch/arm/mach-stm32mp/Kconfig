## release/src-rt-5.04behnd.4916/bootloaders/u-boot-2019.07/arch/powerpc/cpu/mpc86xx/Kconfig
```kconfig
menu "mpc86xx CPU"
	depends on MPC86xx

config SYS_CPU
	default "mpc86xx"

choice
	prompt "Target select"
	optional

config TARGET_SBC8641D
	bool "Support sbc8641d"
	select ARCH_MPC8641
	select BOARD_EARLY_INIT_F

config TARGET_MPC8610HPCD
	bool "Support MPC8610HPCD"
	select ARCH_MPC8610
	select BOARD_EARLY_INIT_F

config TARGET_MPC8641HPCN
	bool "Support MPC8641HPCN"
	select ARCH_MPC8641
	select FSL_DDR_INTERACTIVE
	imply SCSI

config TARGET_XPEDITE517X
	bool "Support xpedite517x"
	select ARCH_MPC8641

endchoice

config ARCH_MPC8610
	bool
	select FSL_LAW
	select SYS_FSL_HAS_DDR1
	select SYS_FSL_HAS_DDR2

config ARCH_MPC8641
	bool
	select FSL_LAW
	select SYS_FSL_HAS_DDR1
	select SYS_FSL_HAS_DDR2

config FSL_LAW
	bool
	help
		Use Freescale common code for Local Access Window

config SYS_CCSRBAR_DEFAULT
	hex "Default CCSRBAR address"
	default 0xff700000 if ARCH_MPC8610 || ARCH_MPC8641
	help
		Default value of CCSRBAR comes from power-on-reset. It
		is fixed on each SoC. Some SoCs can have different value
		if changed by pre-boot regime. The value here must match
		the current value in SoC. If not sure, do not change.
config SYS_FSL_NUM_LAWS
	int "Number of local access windows"
	default 10 if ARCH_MPC8610 || ARCH_MPC8641
	help
		Number of local access windows. This is fixed per SoC.
		If not sure, do not change.

source "board/freescale/mpc8610hpcd/Kconfig"
source "board/freescale/mpc8641hpcn/Kconfig"
source "board/sbc8641d/Kconfig"
source "board/xes/xpedite517x/Kconfig"

endmenu
```

## release/src-rt-5.04behnd.4916/bootloaders/u-boot-2019.07/arch/powerpc/cpu/mpc8xx/Kconfig
```kconfig
menu "mpc8xx CPU"
	depends on MPC8xx

config SYS_CPU
	default "mpc8xx"

choice
	prompt "Target select"
	optional

config TARGET_MCR3000
	bool "Support MCR3000 board from CSSI"

endchoice

choice
	prompt "CPU select"
	default MPC866

config MPC866
	bool "MPC866"

config MPC885
	bool "MPC885"

endchoice

#config MPC8xx_WATCHDOG
#	bool "Watchdog"
#	select HW_WATCHDOG

config 8xx_GCLK_FREQ
	int "CPU GCLK Frequency"

comment "Specific commands"

config CMD_IMMAP
	bool "Enable various commands to dump IMMR information"
	help
	  This enables various commands such as:

	    siuinfo - print System Interface Unit (SIU) registers
	    memcinfo - print Memory Controller registers

comment "Configuration Registers"

config SYS_SIUMCR
	hex "SIUMCR register"
	help
	  SIU Module Configuration (11-6)

config SYS_SYPCR
	hex "SYPCR register"
	help
	  System Protection Control (11-9)

config SYS_TBSCR
	hex "TBSCR register"
	help
	  Time Base Status and Control (11-26)

config SYS_PISCR
	hex "PISCR register"
	help
	  Periodic Interrupt Status and Control (11-31)

config SYS_PLPRCR_BOOL
	bool "Customise PLPRCR"

config SYS_PLPRCR
	hex "PLPRCR register"
	depends on SYS_PLPRCR_BOOL
	help
	  PLL, Low-Power, and Reset Control Register (15-30)

config SYS_SCCR
	hex "SCCR register"
	help
	  System Clock and reset Control Register (15-27)

config SYS_SCCR_MASK
	hex "MASK for setting SCCR register"

config SYS_DER
	hex "DER register"
	help
	  Debug Event Register (37-47)

comment "Memory mapping"

config SYS_BR0_PRELIM
	hex "Preliminary value for BR0"

config SYS_OR0_PRELIM
	hex "Preliminary value for OR0"

config SYS_BR1_PRELIM_BOOL
	bool "Define Bank 1"

config SYS_BR1_PRELIM
	hex "Preliminary value for BR1"
	depends on SYS_BR1_PRELIM_BOOL

config SYS_OR1_PRELIM
	hex "Preliminary value for OR1"
	depends on SYS_BR1_PRELIM_BOOL

config SYS_BR2_PRELIM_BOOL
	bool "Define Bank 2"

config SYS_BR2_PRELIM
	hex "Preliminary value for BR2"
	depends on SYS_BR2_PRELIM_BOOL

config SYS_OR2_PRELIM
	hex "Preliminary value for OR2"
	depends on SYS_BR2_PRELIM_BOOL

config SYS_BR3_PRELIM_BOOL
	bool "Define Bank 3"

config SYS_BR3_PRELIM
	hex "Preliminary value for BR3"
	depends on SYS_BR3_PRELIM_BOOL

config SYS_OR3_PRELIM
	hex "Preliminary value for OR3"
	depends on SYS_BR3_PRELIM_BOOL

config SYS_BR4_PRELIM_BOOL
	bool "Define Bank 4"

config SYS_BR4_PRELIM
	hex "Preliminary value for BR4"
	depends on SYS_BR4_PRELIM_BOOL

config SYS_OR4_PRELIM
	hex "Preliminary value for OR4"
	depends on SYS_BR4_PRELIM_BOOL

config SYS_BR5_PRELIM_BOOL
	bool "Define Bank 5"

config SYS_BR5_PRELIM
	hex "Preliminary value for BR5"
	depends on SYS_BR5_PRELIM_BOOL

config SYS_OR5_PRELIM
	hex "Preliminary value for OR5"
	depends on SYS_BR5_PRELIM_BOOL

config SYS_BR6_PRELIM_BOOL
	bool "Define Bank 6"

config SYS_BR6_PRELIM
	hex "Preliminary value for BR6"
	depends on SYS_BR6_PRELIM_BOOL

config SYS_OR6_PRELIM
	hex "Preliminary value for OR6"
	depends on SYS_BR6_PRELIM_BOOL

config SYS_BR7_PRELIM_BOOL
	bool "Define Bank 7"

config SYS_BR7_PRELIM
	hex "Preliminary value for BR7"
	depends on SYS_BR7_PRELIM_BOOL

config SYS_OR7_PRELIM
	hex "Preliminary value for OR7"
	depends on SYS_BR7_PRELIM_BOOL

config SYS_IMMR
	hex "Value for IMMR"

source "board/cssi/MCR3000/Kconfig"

endmenu
```

## release/src-rt-5.04behnd.4916/bootloaders/u-boot-2019.07/arch/riscv/Kconfig
```kconfig
menu "RISC-V architecture"
	depends on RISCV

config SYS_ARCH
	default "riscv"

choice
	prompt "Target select"
	optional

config TARGET_AX25_AE350
	bool "Support ax25-ae350"

config TARGET_MICROCHIP_ICICLE
	bool "Support Microchip PolarFire-SoC Icicle Board"

config TARGET_QEMU_VIRT
	bool "Support QEMU Virt Board"

config TARGET_SIFIVE_FU540
	bool "Support SiFive FU540 Board"

endchoice

config SYS_ICACHE_OFF
	bool "Do not enable icache"
	default n
	help
	  Do not enable instruction cache in U-Boot.

config SPL_SYS_ICACHE_OFF
	bool "Do not enable icache in SPL"
	depends on SPL
	default SYS_ICACHE_OFF
	help
	  Do not enable instruction cache in SPL.

config SYS_DCACHE_OFF
	bool "Do not enable dcache"
	default n
	help
	  Do not enable data cache in U-Boot.

config SPL_SYS_DCACHE_OFF
	bool "Do not enable dcache in SPL"
	depends on SPL
	default SYS_DCACHE_OFF
	help
	  Do not enable data cache in SPL.

# board-specific options below
source "board/AndesTech/ax25-ae350/Kconfig"
source "board/emulation/qemu-riscv/Kconfig"
source "board/microchip/mpfs_icicle/Kconfig"
source "board/sifive/fu540/Kconfig"

# platform-specific options below
source "arch/riscv/cpu/ax25/Kconfig"
source "arch/riscv/cpu/generic/Kconfig"

# architecture-specific options below

choice
	prompt "Base ISA"
	default ARCH_RV32I

config ARCH_RV32I
	bool "RV32I"
	select 32BIT
	help
	  Choose this option to target the RV32I base integer instruction set.

config ARCH_RV64I
	bool "RV64I"
	select 64BIT
	select PHYS_64BIT
	help
	  Choose this option to target the RV64I base integer instruction set.

endchoice

choice
	prompt "Code Model"
	default CMODEL_MEDLOW

config CMODEL_MEDLOW
	bool "medium low code model"
	help
	  U-Boot and its statically defined symbols must lie within a single 2 GiB
	  address range and must lie between absolute addresses -2 GiB and +2 GiB.

config CMODEL_MEDANY
	bool "medium any code model"
	help
	  U-Boot and its statically defined symbols must be within any single 2 GiB
	  address range.

endchoice

choice
	prompt "Run Mode"
	default RISCV_MMODE

config RISCV_MMODE
	bool "Machine"
	help
	  Choose this option to build U-Boot for RISC-V M-Mode.

config RISCV_SMODE
	bool "Supervisor"
	help
	  Choose this option to build U-Boot for RISC-V S-Mode.

endchoice

config RISCV_ISA_C
	bool "Emit compressed instructions"
	default y
	help
	  Adds "C" to the ISA subsets that the toolchain is allowed to emit
	  when building U-Boot, which results in compressed instructions in the
	  U-Boot binary.

config RISCV_ISA_A
	def_bool y

config 32BIT
	bool

config 64BIT
	bool

config SIFIVE_CLINT
	bool
	depends on RISCV_MMODE
	select REGMAP
	select SYSCON
	help
	  The SiFive CLINT block holds memory-mapped control and status registers
	  associated with software and timer interrupts.

config ANDES_PLIC
	bool
	depends on RISCV_MMODE
	select REGMAP
	select SYSCON
	help
	  The Andes PLIC block holds memory-mapped claim and pending registers
	  associated with software interrupt.

config ANDES_PLMT
	bool
	depends on RISCV_MMODE
	select REGMAP
	select SYSCON
	help
	  The Andes PLMT block holds memory-mapped mtime register
	  associated with timer tick.

config RISCV_RDTIME
	bool
	default y if RISCV_SMODE
	help
	  The provides the riscv_get_time() API that is implemented using the
	  standard rdtime instruction. This is the case for S-mode U-Boot, and
	  is useful for processors that support rdtime in M-mode too.

config SYS_MALLOC_F_LEN
	default 0x1000

config SMP
	bool "Symmetric Multi-Processing"
	help
	  This enables support for systems with more than one CPU. If
	  you say N here, U-Boot will run on single and multiprocessor
	  machines, but will use only one CPU of a multiprocessor
	  machine. If you say Y here, U-Boot will run on many, but not
	  all, single processor machines.

config NR_CPUS
	int "Maximum number of CPUs (2-32)"
	range 2 32
	depends on SMP
	default 8
	help
	  On multiprocessor machines, U-Boot sets up a stack for each CPU.
	  Stack memory is pre-allocated. U-Boot must therefore know the
	  maximum number of CPUs that may be present.

config SBI_IPI
	bool
	default y if RISCV_SMODE
	depends on SMP

config XIP
	bool "XIP mode"
	help
	  XIP (eXecute In Place) is a method for executing code directly
	  from a NOR flash memory without copying the code to ram.
	  Say yes here if U-Boot boots from flash directly.

config STACK_SIZE_SHIFT
	int
	default 13

endmenu
```

## release/src-rt-5.04behnd.4916/bootloaders/u-boot-2019.07/arch/sandbox/Kconfig
```kconfig
menu "Sandbox architecture"
	depends on SANDBOX

config SYS_ARCH
	default "sandbox"

config SYS_BOARD
	default "sandbox"

config SYS_CPU
	default "sandbox"

config SANDBOX64
	bool "Use 64-bit addresses"
	select PHYS_64BIT
	select HOST_64BIT

config SANDBOX_SPL
	bool "Enable SPL for sandbox"
	select SUPPORT_SPL

config SYS_CONFIG_NAME
	default "sandbox_spl" if SANDBOX_SPL
	default "sandbox" if !SANDBOX_SPL

choice
	prompt "Run sandbox on 32/64-bit host"
	default HOST_64BIT
	help
	  Sandbox can be built on 32-bit and 64-bit hosts.
	  The default is to build on a 64-bit host and run
	  on a 64-bit host. If you want to run sandbox on
	  a 32-bit host, change it here.

config HOST_32BIT
	bool "32-bit host"
	depends on !PHYS_64BIT

config HOST_64BIT
	bool "64-bit host"

endchoice

config SANDBOX_BITS_PER_LONG
	int
	default 32 if HOST_32BIT
	default 64 if HOST_64BIT

endmenu
```

## release/src-rt-5.04behnd.4916/bootloaders/u-boot-2019.07/arch/x86/cpu/coreboot/Kconfig
```kconfig
if TARGET_COREBOOT

config SYS_COREBOOT
	bool
	default y
	imply SYS_NS16550
	imply SCSI
	imply SCSI_AHCI
	imply AHCI_PCI
	imply MMC
	imply MMC_PCI
	imply MMC_SDHCI
	imply MMC_SDHCI_SDMA
	imply USB
	imply USB_EHCI_HCD
	imply USB_XHCI_HCD
	imply USB_STORAGE
	imply USB_KEYBOARD
	imply VIDEO_COREBOOT
	imply E1000
	imply ETH_DESIGNWARE
	imply PCH_GBE
	imply RTL8169
	imply CMD_CBFS
	imply FS_CBFS
	imply CBMEM_CONSOLE

endif
```

## release/src-rt-5.04behnd.4916/bootloaders/u-boot-2019.07/arch/x86/cpu/efi/Kconfig
```kconfig
if EFI

config SYS_CAR_ADDR
	hex
	default 0x100000

config SYS_CAR_SIZE
	hex
	default 0x20000

endif
```

## release/src-rt-5.04behnd.4916/bootloaders/u-boot-2019.07/arch/x86/cpu/ivybridge/Kconfig
```kconfig
# SPDX-License-Identifier: GPL-2.0
#
# From Coreboot src/northbridge/intel/sandybridge/Kconfig
#
# Copyright (C) 2010 Google Inc.
#

config NORTHBRIDGE_INTEL_IVYBRIDGE
	bool
	select CACHE_MRC_BIN if HAVE_MRC
	imply HAVE_INTEL_ME
	imply ENABLE_MRC_CACHE
	imply AHCI_PCI
	imply ICH_SPI
	imply INTEL_ICH6_GPIO
	imply PINCTRL_ICH6
	imply SCSI
	imply SCSI_AHCI
	imply SPI_FLASH
	imply USB
	imply USB_EHCI_HCD
	imply USB_XHCI_HCD
	imply VIDEO_VESA
	imply SOUND_IVYBRIDGE

if NORTHBRIDGE_INTEL_IVYBRIDGE

config DCACHE_RAM_BASE
	default 0xff7e0000

config DCACHE_RAM_SIZE
	default 0x20000

config DCACHE_RAM_MRC_VAR_SIZE
	default 0x4000

config CPU_SPECIFIC_OPTIONS
	def_bool y
	select SMM_TSEG
	select X86_RAMTEST

config SMM_TSEG_SIZE
	hex
	default 0x800000

config ENABLE_VMX
	bool "Enable VMX for virtualization"
	default n
	help
	  Virtual Machine Extensions are provided in many x86 CPUs. These
	  provide various facilities for allowing a host OS to provide an
	  environment where potentially several guest OSes have only
	  limited access to the underlying hardware. This is achieved
	  without resorting to software trapping and/or instruction set
	  emulation (which would be very slow).

	  Intel's implementation of this is called VT-x. This option enables
	  VT-x this so that the OS that is booted by U-Boot can make use of
	  these facilities. If this option is not enabled, then the host OS
	  will be unable to support virtualisation, or it will run very
	  slowly.

config FSP_ADDR
	hex
	default 0xfff80000

config FSP_USE_UPD
	bool
	default n

config FSP_BROKEN_HOB
	bool
	default y

endif
```

## release/src-rt-5.04behnd.4916/bootloaders/u-boot-2019.07/arch/x86/cpu/queensbay/Kconfig
```kconfig
# SPDX-License-Identifier: GPL-2.0+
#
# Copyright (C) 2014, Bin Meng <bmeng.cn@gmail.com>

config INTEL_QUEENSBAY
	bool
	select HAVE_FSP
	select HAVE_CMC
	select ARCH_EARLY_INIT_R
	imply AHCI_PCI
	imply ICH_SPI
	imply INTEL_ICH6_GPIO
	imply MMC
	imply MMC_PCI
	imply MMC_SDHCI
	imply MMC_SDHCI_SDMA
	imply PCH_GBE
	imply SCSI
	imply SCSI_AHCI
	imply SPI_FLASH
	imply SYS_NS16550
	imply USB
	imply USB_EHCI_HCD
	imply VIDEO_VESA

if INTEL_QUEENSBAY

config HAVE_CMC
	bool "Add a Chipset Micro Code state machine binary"
	help
	  Select this option to add a Chipset Micro Code state machine binary
	  to the resulting U-Boot image. It is a 64K data block of machine
	  specific code which must be put in the flash for the processor to
	  access when powered up before system BIOS is executed.

config CMC_FILE
	string "Chipset Micro Code state machine filename"
	depends on HAVE_CMC
	default "cmc.bin"
	help
	  The filename of the file to use as Chipset Micro Code state machine
	  binary in the board directory.

config CMC_ADDR
	hex "Chipset Micro Code state machine binary location"
	depends on HAVE_CMC
	default 0xfffb0000
	help
	  The location of the CMC binary is determined by a strap. It must be
	  put in flash at a location matching the strap-determined base address.

	  The default base address of 0xfffb0000 indicates that the binary must
	  be located at offset 0xb0000 from the beginning of a 1MB flash device.

config CPU_ADDR_BITS
	int
	default 32

config DISABLE_IGD
	bool "Disable Integrated Graphics Device (IGD)"
	help
	  Disable the Integrated Graphics Device (IGD) so that it does not
	  show in the PCI configuration space as a VGA disaplay controller.
	  This gives a chance for U-Boot to run PCI/PCIe based graphics
	  card's VGA BIOS and use that card for the graphics console.

endif
```

## release/src-rt-5.04behnd.4916/bootloaders/u-boot-2019.07/board/Arcturus/ucp1020/Kconfig
```kconfig
if TARGET_UCP1020

config SYS_BOARD
	string
	default "ucp1020"

config SYS_VENDOR
	string
	default "Arcturus"

config SYS_CONFIG_NAME
	string
	default "UCP1020"

choice
	prompt "Target image select"

config TARGET_UCP1020_NOR
	bool "NOR flash u-boot image"

config TARGET_UCP1020_SPIFLASH
	bool "SPI flash u-boot image"

endchoice

if TARGET_UCP1020_SPIFLASH
config UCBOOT
	bool
	default y

config SPIFLASH
	bool
	default y
endif

endif
```

## release/src-rt-5.04behnd.4916/bootloaders/u-boot-2019.07/board/BuR/brppt1/Kconfig
```kconfig
if TARGET_BRPPT1

config SYS_BOARD
	default "brppt1"

config SYS_VENDOR
	default "BuR"

config SYS_SOC
	default "am33xx"

config SYS_CONFIG_NAME
	default "brppt1"

endif
```
