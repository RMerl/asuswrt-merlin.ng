// SPDX-License-Identifier: GPL-2.0+
/*
 * Copyright (C) 2018 Angelo Dureghello <angelo@sysam.it>
 */

/dts-v1/;
/include/ "mcf5441x.dtsi"

/ {
	model = "Freescale M54418TWR";
	compatible = "fsl,M54418TWR";

	chosen {
		stdout-path = "serial0:115200n8";
	};
};

&uart0 {
	u-boot,dm-pre-reloc;
	status = "okay";
};

&dspi0 {
	status = "okay";
};
