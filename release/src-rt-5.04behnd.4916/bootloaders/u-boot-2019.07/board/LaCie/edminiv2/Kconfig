## release/src-rt-5.04behnd.4916/bootloaders/u-boot-2019.07/board/LaCie/edminiv2/Kconfig
```kconfig
if TARGET_EDMINIV2

config SYS_BOARD
	default "edminiv2"

config SYS_VENDOR
	default "LaCie"

config SYS_CONFIG_NAME
	default "edminiv2"

endif
```

## release/src-rt-5.04behnd.4916/bootloaders/u-boot-2019.07/board/LaCie/netspace_v2/Kconfig
```kconfig
if TARGET_NETSPACE_V2

config SYS_BOARD
	default "netspace_v2"

config SYS_VENDOR
	default "LaCie"

config SYS_CONFIG_NAME
	default "lacie_kw"

endif
```

## release/src-rt-5.04behnd.4916/bootloaders/u-boot-2019.07/board/Marvell/aspenite/Kconfig
```kconfig
if TARGET_ASPENITE

config SYS_BOARD
	default "aspenite"

config SYS_VENDOR
	default "Marvell"

config SYS_SOC
	default "armada100"

config SYS_CONFIG_NAME
	default "aspenite"

endif
```

## release/src-rt-5.04behnd.4916/bootloaders/u-boot-2019.07/board/Marvell/db-88f6281-bp/Kconfig
```kconfig
if TARGET_DB_88F6281_BP

config SYS_BOARD
	default "db-88f6281-bp"

config SYS_VENDOR
	default "Marvell"

config SYS_CONFIG_NAME
	default "db-88f6281-bp"

endif
```

## release/src-rt-5.04behnd.4916/bootloaders/u-boot-2019.07/board/Marvell/guruplug/Kconfig
```kconfig
if TARGET_GURUPLUG

config SYS_BOARD
	default "guruplug"

config SYS_VENDOR
	default "Marvell"

config SYS_CONFIG_NAME
	default "guruplug"

endif
```

## release/src-rt-5.04behnd.4916/bootloaders/u-boot-2019.07/board/Marvell/openrd/Kconfig
```kconfig
if TARGET_OPENRD

config SYS_BOARD
	default "openrd"

config SYS_VENDOR
	default "Marvell"

config SYS_CONFIG_NAME
	default "openrd"

endif
```

## release/src-rt-5.04behnd.4916/bootloaders/u-boot-2019.07/board/abilis/tb100/Kconfig
```kconfig
if TARGET_TB100

config SYS_CPU
	default "arc700"

config SYS_BOARD
	default "tb100"

config SYS_VENDOR
	default "abilis"

config SYS_CONFIG_NAME
	default "tb100"

endif
```

## release/src-rt-5.04behnd.4916/bootloaders/u-boot-2019.07/board/advantech/Kconfig
```kconfig
if VENDOR_ADVANTECH

choice
	prompt "Mainboard model"
	optional

config TARGET_SOM_DB5800_SOM_6867
	bool "Advantech SOM-DB5800 & SOM-6867"
	help
	  Advantech SOM-DB5800 COM Express development board with SOM-6867
	  installed.

	  SOM-6867 is a COM Express Type 6 Compact Module with either an Intel
	  Atom E3845 or Celeron N2920 processor.

	  SOM-DB5800 is a COM Express Development board with:
	    10/100/1000 Ethernet
	    PCIe slots
	    4x USB ports
	    HDMI/DisplayPort/DVI, LVDS, VGA
	    SATA ports
	    ALC892 HD Audio Codec

endchoice

source "board/advantech/som-db5800-som-6867/Kconfig"

endif
```

## release/src-rt-5.04behnd.4916/bootloaders/u-boot-2019.07/board/alliedtelesis/SBx81LIFKW/Kconfig
```kconfig
if TARGET_SBx81LIFKW

config SYS_BOARD
       default "SBx81LIFKW"

config SYS_VENDOR
       default "alliedtelesis"

config SYS_CONFIG_NAME
       default "SBx81LIFKW"

endif
```

## release/src-rt-5.04behnd.4916/bootloaders/u-boot-2019.07/board/alliedtelesis/SBx81LIFXCAT/Kconfig
```kconfig
if TARGET_SBx81LIFXCAT

config SYS_BOARD
       default "SBx81LIFXCAT"

config SYS_VENDOR
       default "alliedtelesis"

config SYS_CONFIG_NAME
       default "SBx81LIFXCAT"

endif
```

## release/src-rt-5.04behnd.4916/bootloaders/u-boot-2019.07/board/amarula/vyasa-rk3288/Kconfig
```kconfig
if TARGET_VYASA_RK3288

config SYS_BOARD
	default "vyasa-rk3288"

config SYS_VENDOR
	default "amarula"

config SYS_CONFIG_NAME
	default "vyasa-rk3288"

endif
```

## release/src-rt-5.04behnd.4916/bootloaders/u-boot-2019.07/board/amazon/kc1/Kconfig
```kconfig
if TARGET_KC1

config SYS_BOARD
	default "kc1"

config SYS_VENDOR
	default "amazon"

config SYS_CONFIG_NAME
	default "kc1"

endif
```

## release/src-rt-5.04behnd.4916/bootloaders/u-boot-2019.07/board/aristainetos/Kconfig
```kconfig
if TARGET_ARISTAINETOS

config SYS_BOARD
	default "aristainetos"

config SYS_CONFIG_NAME
	default "aristainetos"

endif

if TARGET_ARISTAINETOS2

config SYS_BOARD
	default "aristainetos"

config SYS_CONFIG_NAME
	default "aristainetos2"

endif

if TARGET_ARISTAINETOS2B

config SYS_BOARD
	default "aristainetos"

config SYS_CONFIG_NAME
	default "aristainetos2b"

endif
```

## release/src-rt-5.04behnd.4916/bootloaders/u-boot-2019.07/board/armadeus/apf27/Kconfig
```kconfig
if TARGET_APF27

config SPL_LDSCRIPT
	default "arch/$(ARCH)/cpu/u-boot-spl.lds"

config SYS_BOARD
	default "apf27"

config SYS_VENDOR
	default "armadeus"

config SYS_SOC
	default "mx27"

config SYS_CONFIG_NAME
	default "apf27"

endif
```

## release/src-rt-5.04behnd.4916/bootloaders/u-boot-2019.07/board/armadeus/opos6uldev/Kconfig
```kconfig
if TARGET_OPOS6ULDEV

config SYS_BOARD
	default "opos6uldev"

config SYS_VENDOR
	default "armadeus"

config SYS_CONFIG_NAME
	default "opos6uldev"

config IMX_CONFIG
	default "arch/arm/mach-imx/spl_sd.cfg"

endif
```

## release/src-rt-5.04behnd.4916/bootloaders/u-boot-2019.07/board/armltd/vexpress/Kconfig
```kconfig
if TARGET_VEXPRESS_CA15_TC2

config SYS_BOARD
	default "vexpress"

config SYS_VENDOR
	default "armltd"

config SYS_CONFIG_NAME
	default "vexpress_ca15_tc2"

endif

if TARGET_VEXPRESS_CA5X2

config SYS_BOARD
	default "vexpress"

config SYS_VENDOR
	default "armltd"

config SYS_CONFIG_NAME
	default "vexpress_ca5x2"

endif

if TARGET_VEXPRESS_CA9X4

config SYS_BOARD
	default "vexpress"

config SYS_VENDOR
	default "armltd"

config SYS_CONFIG_NAME
	default "vexpress_ca9x4"

endif
```

## release/src-rt-5.04behnd.4916/bootloaders/u-boot-2019.07/board/armltd/vexpress64/Kconfig
```kconfig
if TARGET_VEXPRESS64_BASE_FVP || TARGET_VEXPRESS64_JUNO || TARGET_VEXPRESS64_BASE_FVP_DRAM

config SYS_BOARD
	default "vexpress64"

config SYS_VENDOR
	default "armltd"

config SYS_CONFIG_NAME
	default "vexpress_aemv8a"

endif
```

## release/src-rt-5.04behnd.4916/bootloaders/u-boot-2019.07/board/atmark-techno/armadillo-800eva/Kconfig
```kconfig
if TARGET_ARMADILLO_800EVA

config SYS_BOARD
	default "armadillo-800eva"

config SYS_VENDOR
	default "atmark-techno"

config SYS_CONFIG_NAME
	default "armadillo-800eva"

endif
```

## release/src-rt-5.04behnd.4916/bootloaders/u-boot-2019.07/board/atmel/at91sam9m10g45ek/Kconfig
```kconfig
if TARGET_AT91SAM9M10G45EK

config SYS_BOARD
	default "at91sam9m10g45ek"

config SYS_VENDOR
	default "atmel"

config SYS_CONFIG_NAME
	default "at91sam9m10g45ek"

endif
```

## release/src-rt-5.04behnd.4916/bootloaders/u-boot-2019.07/board/atmel/at91sam9rlek/Kconfig
```kconfig
if TARGET_AT91SAM9RLEK

config SYS_BOARD
	default "at91sam9rlek"

config SYS_VENDOR
	default "atmel"

config SYS_CONFIG_NAME
	default "at91sam9rlek"

endif
```

## release/src-rt-5.04behnd.4916/bootloaders/u-boot-2019.07/board/atmel/sama5d2_ptc_ek/Kconfig
```kconfig
if TARGET_SAMA5D2_PTC_EK

config SYS_BOARD
	default "sama5d2_ptc_ek"

config SYS_VENDOR
	default "atmel"

config SYS_SOC
	default "at91"

config SYS_CONFIG_NAME
	default "sama5d2_ptc_ek"

endif
```

## release/src-rt-5.04behnd.4916/bootloaders/u-boot-2019.07/board/atmel/sama5d3xek/Kconfig
```kconfig
if TARGET_SAMA5D3XEK

config SYS_BOARD
	default "sama5d3xek"

config SYS_VENDOR
	default "atmel"

config SYS_CONFIG_NAME
	default "sama5d3xek"

endif
```

## release/src-rt-5.04behnd.4916/bootloaders/u-boot-2019.07/board/avionic-design/medcom-wide/Kconfig
```kconfig
if TARGET_MEDCOM_WIDE

config SYS_BOARD
	default "medcom-wide"

config SYS_VENDOR
	default "avionic-design"

config SYS_CONFIG_NAME
	default "medcom-wide"

endif
```

## release/src-rt-5.04behnd.4916/bootloaders/u-boot-2019.07/board/avionic-design/tec/Kconfig
```kconfig
if TARGET_TEC

config SYS_BOARD
	default "tec"

config SYS_VENDOR
	default "avionic-design"

config SYS_CONFIG_NAME
	default "tec"

endif
```

## release/src-rt-5.04behnd.4916/bootloaders/u-boot-2019.07/board/beckhoff/mx53cx9020/Kconfig
```kconfig
if TARGET_MX53CX9020

config SYS_BOARD
	default "mx53cx9020"

config SYS_VENDOR
	default "beckhoff"

config SYS_CONFIG_NAME
	default "mx53cx9020"

endif
```
