## release/src-rt-5.04behnd.4916/bootloaders/u-boot-2019.07/board/birdland/bav335x/Kconfig
```kconfig
if TARGET_BAV335X

config SYS_BOARD
	default "bav335x"

config SYS_VENDOR
	default "birdland"

config SYS_SOC
	default "am33xx"

config SYS_CONFIG_NAME
	default "bav335x"

config BAV_VERSION
	int "BAV335x Version (1=A, 2=B)"
	range 1 2
	help
	  The BAV335x has various version of the board. Rev.A (mostly obsolete)
	  used 10/100 Ethernet PHY while Rev.B uses a Gigabit Ethernet PHY.
	  Overwrite this if you have an older Rev.A and want ethernet support.

endif
```

## release/src-rt-5.04behnd.4916/bootloaders/u-boot-2019.07/board/bluewater/snapper9260/Kconfig
```kconfig
if TARGET_SNAPPER9260

config SYS_BOARD
	default "snapper9260"

config SYS_VENDOR
	default "bluewater"

config SYS_CONFIG_NAME
	default "snapper9260"

endif
```

## release/src-rt-5.04behnd.4916/bootloaders/u-boot-2019.07/board/boundary/nitrogen6x/Kconfig
```kconfig
if TARGET_NITROGEN6X

config SYS_BOARD
	default "nitrogen6x"

config SYS_VENDOR
	default "boundary"

config SYS_CONFIG_NAME
	default "nitrogen6x"

endif
```

## release/src-rt-5.04behnd.4916/bootloaders/u-boot-2019.07/board/broadcom/bcm23550_w1d/Kconfig
```kconfig
if TARGET_BCM23550_W1D

config SYS_BOARD
	default "bcm23550_w1d"

config SYS_VENDOR
	default "broadcom"

config SYS_SOC
	default "bcm235xx"

config SYS_CONFIG_NAME
	default "bcm23550_w1d"

endif
```

## release/src-rt-5.04behnd.4916/bootloaders/u-boot-2019.07/board/broadcom/bcm968580xref/Kconfig
```kconfig
if ARCH_BCM6858

config SYS_VENDOR
	default "broadcom"

config SYS_BOARD
	default "bcm968580xref"

config SYS_CONFIG_NAME
	default "broadcom_bcm968580xref"

endif

config TARGET_BCM968580XREF
	bool "Support Broadcom bcm968580xref"
	depends on ARCH_BCM6858
	select ARM64
```

## release/src-rt-5.04behnd.4916/bootloaders/u-boot-2019.07/board/broadcom/bcmbca/Kconfig
```kconfig
# SPDX-License-Identifier: GPL-2.0+
#
# (C) Copyright 2019 Broadcom Ltd
#

config SYS_VENDOR
	default "broadcom"

config SYS_BOARD
	default "bcmbca"

if TARGET_BCM963158
config SYS_CONFIG_NAME
	default "bcm963158"
endif

if TARGET_BCM96858
config SYS_CONFIG_NAME
	default "bcm96858"
endif

if TARGET_BCM96856
config SYS_CONFIG_NAME
	default "bcm96856"
endif

if TARGET_BCM963178
config SYS_CONFIG_NAME
	default "bcm963178"
endif

if TARGET_BCM947622
config SYS_CONFIG_NAME
	default "bcm947622"
endif

if TARGET_BCM96756
config SYS_CONFIG_NAME
	default "bcm96756"
endif

if TARGET_BCM96765
config SYS_CONFIG_NAME
	default "bcm96765"
endif

if TARGET_BCM96766
config SYS_CONFIG_NAME
	default "bcm96766"
endif

if TARGET_BCM96846
config SYS_CONFIG_NAME
    default "bcm96846"
endif

if TARGET_BCM96878
config SYS_CONFIG_NAME
    default "bcm96878"
endif

if TARGET_BCM96855
config SYS_CONFIG_NAME
    default "bcm96855"
endif

if TARGET_BCM94908
config SYS_CONFIG_NAME
	default "bcm94908"
endif

if TARGET_BCM94912
config SYS_CONFIG_NAME
	default "bcm94912"
endif

if TARGET_BCM96813
config SYS_CONFIG_NAME
	default "bcm96813"
endif

if TARGET_BCM963146
config SYS_CONFIG_NAME
	default "bcm963146"
endif

if TARGET_BCM963138
config SYS_CONFIG_NAME
	default "bcm963138"
endif

if TARGET_BCM963148
config SYS_CONFIG_NAME
	default "bcm963148"
endif

if TARGET_BCM96888
config SYS_CONFIG_NAME
    default "bcm96888"
endif

if TARGET_BCM96837
config SYS_CONFIG_NAME
    default "bcm96837"
endif

if TARGET_BCM968880
config SYS_CONFIG_NAME
    default "bcm968880"
endif

config BCMBCA_HTTPD
	bool "Support HTTPD server"
	depends on NET

config BCMBCA_IKOS
	bool "IKOS"
	depends on !CONFIG_SYS_ARCH_TIMER
	help
	  Enable IKOS build 

config BCMBCA_IKOS_SPL_JUMP_TO_UBOOT
	bool "IKOS SPL to u-boot jump"
	depends on BCMBCA_IKOS && SPL
	default n
	help
	  Enable IKOS SPL early jump to u-boot entry directly

config BCMBCA_IKOS_SKIP_PGTBL_CLEAN
	bool "IKOS skip page table clean"
	depends on BCMBCA_IKOS
	default n
	help
	  Skip MMU page table clean to speed up IKOS boot up time

config BCMBCA_NO_SMC_BOOT
	bool "NO SMC Define"
	help
		"No System Management Controller boot

config ARM_A55
	bool "ARM Cortex@ A55 based"
	help
	  ARM Cortex@ A55 based 

config SMC_BASED
	bool "SoCs based on SMC"
    default y if BCM68880
    default y if BCM6837
    default n
	help
	  SoCs based on SMC 

config BCMBCA_BOARD_SPECIFIC_DT
	bool "Load board specific device tree for uboot"

config BCMBCA_UPDATE_MCB_IN_ENV
	bool "Auto update MCB selector in environment"
	depends on BCMBCA_BOARD_SPECIFIC_DT
	default y

config BCMBCA_BOARD_SDK
	bool "Support board sdk"
	depends on !BCMBCA_IKOS
	default y

config BCMBCA_DECRYPT_TPL
	bool "Directs SPL to unconditionally decrypt TPL in Bootrom FLD/MFG Secure mode using AES symmetric key. Caution: TPL will not be capable to run in unsecrue mode"

config BCMBCA_DISABLE_SECURE_VERIFY
	bool "WARNING!!!: allows to run unsecured images(FIT, u-boot and rootfs) under Bootrom secure mode.  All keys sent from bootrom will be tossed; Secured OTP will be disabled. If a symmetric encryption is applied to the rootfs content then system will crash upon run"
	default n

config BCMBCA_EARLY_ABORT_JTAG_UNLOCK
	bool "Unlocks JTAG in early abort. Hazardous: Use in debug/development mode only"
	help
          JTAG unlock is a debug feature helping to unbrick board if booted to BOOTROM secure mode

config BCMBCA_EARLY_ABORT_DDRINIT
	bool "Manual DDR Init in early abort (Debug/Development only)"
	default n
	help
		  Manually initialize DDR in early abort menu. This allow user to load binary
		  to DDR over UART and recover board in case TPL or u-boot fails to boot.
		  WARNING: this feature is for debug and development only!

config BCMBCA_EARLY_ABORT_LOADB
	bool "Load binary through UART in early abort (Debug/Development only)"
	select SPL_HASH_SUPPORT
	select BCMBCA_EARLY_ABORT_DDRINIT
	default n
	help
		  Load binary through UART, currently using Ymodem only, to memory in early
		  abort menu. It can be used with early abort ddr init to recover board. 
		  WARNING: this feature is for debug and development only!

config BCMBCA_RELAX_CHECKS_WHEN_NONSECURE
	bool "Relax security checks when device is not in secure boot modes"
	default n
	help
	  If selected, mechanisms to lock the uboot CLI and override environment that
	  are normally used to secure a device in secure boot mode can be compiled
          in but relaxed when the image is used in non-secure modes.  This allows
          the same (signed) image to be used prior to switching to secure boot and
	  after.


#since we need this in tpl, we can't have it under misc 
config BCM_BOOTSTATE
	bool "Enable support for Broadcom Bootstate Driver"
	help
	  If you say Y here, you will get support broadcom bootstate
	  mechanism

config BCM_BOOTSTATE_FALLBACK_SUPPORT
	bool "Enable support for Broadcom Bootstate Fallback in case of unsteady image"
	depends on BCM_BOOTSTATE && !SMC_BASED
	default n
	help
	  If you say Y here, you will get support broadcom bootstate fallback
	  mechanism

config BCM_THERMAL
	bool "Support thermal throttling"
	default n

config BCMBCA_EXTRA_BOARD_OBJECTS
	string "Space Seperated List of Extra board/broadcom/bcmbca objects to build"
	help
	  To add additional files to the uboot proper in the board/broadcom/bcmbca directory
	  add the names of the .o files in a space-separated list

config BCMBCA_BOARD_TK_PROG
	bool "Build Turnkey Programming SPL Version"
	default n

config BCMBCA_BUTTON
	bool "button support for broadcom board"
	depends on DM
	default y

config BCMBCA_SPL_SALT
	string "Random SALT String for SPL"
	depends on SPL
	help
	  Specify the random string adding to spl binary for security enhancement
```

## release/src-rt-5.04behnd.4916/bootloaders/u-boot-2019.07/board/broadcom/bcmcygnus/Kconfig
```kconfig
if TARGET_BCMCYGNUS

config SYS_BOARD
	default "bcm_ep"

config SYS_VENDOR
	default "broadcom"

config SYS_SOC
	default "bcmcygnus"

config SYS_CONFIG_NAME
	default "bcm_ep_board"

endif
```

## release/src-rt-5.04behnd.4916/bootloaders/u-boot-2019.07/board/broadcom/bcmns2/Kconfig
```kconfig
if TARGET_BCMNS2

config SYS_BOARD
	default "bcmns2"

config SYS_VENDOR
	default "broadcom"

config SYS_SOC
	default "ns2"

config SYS_CONFIG_NAME
	default "bcm_northstar2"

endif
```

## release/src-rt-5.04behnd.4916/bootloaders/u-boot-2019.07/board/broadcom/bcmnsp/Kconfig
```kconfig
if TARGET_BCMNSP

config SYS_BOARD
	default "bcm_ep"

config SYS_VENDOR
	default "broadcom"

config SYS_SOC
	default "bcmnsp"

config SYS_CONFIG_NAME
	default "bcm_ep_board"

endif
```

## release/src-rt-5.04behnd.4916/bootloaders/u-boot-2019.07/board/bticino/mamoj/Kconfig
```kconfig
if TARGET_MX6DL_MAMOJ

config SYS_BOARD
	default "mamoj"

config SYS_VENDOR
	default "bticino"

config SYS_CONFIG_NAME
	default "imx6dl-mamoj"

endif
```

## release/src-rt-5.04behnd.4916/bootloaders/u-boot-2019.07/board/calao/usb_a9263/Kconfig
```kconfig
if TARGET_USB_A9263

config SYS_BOARD
	default "usb_a9263"

config SYS_VENDOR
	default "calao"

config SYS_CONFIG_NAME
	default "usb_a9263"

endif
```

## release/src-rt-5.04behnd.4916/bootloaders/u-boot-2019.07/board/ccv/xpress/Kconfig
```kconfig
if TARGET_XPRESS

config SYS_BOARD
	default "xpress"

config SYS_VENDOR
	default "ccv"

config SYS_CONFIG_NAME
	default "xpress"

endif
```

## release/src-rt-5.04behnd.4916/bootloaders/u-boot-2019.07/board/chipspark/popmetal_rk3288/Kconfig
```kconfig
if TARGET_POPMETAL_RK3288

config SYS_BOARD
	default "popmetal_rk3288"

config SYS_VENDOR
	default "chipspark"

config SYS_CONFIG_NAME
	default "popmetal_rk3288"

config BOARD_SPECIFIC_OPTIONS # dummy
	def_bool y

endif
```

## release/src-rt-5.04behnd.4916/bootloaders/u-boot-2019.07/board/cirrus/edb93xx/Kconfig
```kconfig
if TARGET_EDB93XX

config SYS_BOARD
	default "edb93xx"

config SYS_VENDOR
	default "cirrus"

config SYS_SOC
	default "ep93xx"

config SYS_CONFIG_NAME
	default "edb93xx"

endif
```

## release/src-rt-5.04behnd.4916/bootloaders/u-boot-2019.07/board/cobra5272/Kconfig
```kconfig
if TARGET_COBRA5272

config SYS_CPU
	default "mcf52x2"

config SYS_BOARD
	default "cobra5272"

config SYS_CONFIG_NAME
	default "cobra5272"

endif
```

## release/src-rt-5.04behnd.4916/bootloaders/u-boot-2019.07/board/compal/paz00/Kconfig
```kconfig
if TARGET_PAZ00

config SYS_BOARD
	default "paz00"

config SYS_VENDOR
	default "compal"

config SYS_CONFIG_NAME
	default "paz00"

endif
```

## release/src-rt-5.04behnd.4916/bootloaders/u-boot-2019.07/board/compulab/cm_t35/Kconfig
```kconfig
if TARGET_CM_T35

config SYS_BOARD
	default "cm_t35"

config SYS_VENDOR
	default "compulab"

config SYS_CONFIG_NAME
	default "cm_t35"

endif
```

## release/src-rt-5.04behnd.4916/bootloaders/u-boot-2019.07/board/compulab/cm_t43/Kconfig
```kconfig
if TARGET_CM_T43

config SYS_BOARD
	default "cm_t43"

config SYS_VENDOR
	default "compulab"

config SYS_SOC
	default "am33xx"

config SYS_CONFIG_NAME
	default "cm_t43"

endif
```

## release/src-rt-5.04behnd.4916/bootloaders/u-boot-2019.07/board/compulab/cm_t54/Kconfig
```kconfig
if TARGET_CM_T54

config SYS_BOARD
	default "cm_t54"

config SYS_VENDOR
	default "compulab"

config SYS_CONFIG_NAME
	default "cm_t54"

endif
```

## release/src-rt-5.04behnd.4916/bootloaders/u-boot-2019.07/board/comtrend/ar5315u/Kconfig
```kconfig
if BOARD_COMTREND_AR5315U

config SYS_BOARD
	default "ar5315u"

config SYS_VENDOR
	default "comtrend"

config SYS_CONFIG_NAME
	default "comtrend_ar5315u"

endif
```

## release/src-rt-5.04behnd.4916/bootloaders/u-boot-2019.07/board/comtrend/ct5361/Kconfig
```kconfig
if BOARD_COMTREND_CT5361

config SYS_BOARD
	default "ct5361"

config SYS_VENDOR
	default "comtrend"

config SYS_CONFIG_NAME
	default "comtrend_ct5361"

endif
```

## release/src-rt-5.04behnd.4916/bootloaders/u-boot-2019.07/board/comtrend/vr3032u/Kconfig
```kconfig
if BOARD_COMTREND_VR3032U

config SYS_BOARD
	default "vr3032u"

config SYS_VENDOR
	default "comtrend"

config SYS_CONFIG_NAME
	default "comtrend_vr3032u"

endif
```

## release/src-rt-5.04behnd.4916/bootloaders/u-boot-2019.07/board/congatec/Kconfig
```kconfig
# SPDX-License-Identifier: GPL-2.0+
#
# Copyright (C) 2015, Bin Meng <bmeng.cn@gmail.com>

if VENDOR_CONGATEC

choice
	prompt "Mainboard model"
	optional

config TARGET_CONGA_QEVAL20_QA3_E3845
	bool "congatec QEVAL 2.0 & conga-QA3/E3845"
	select BOARD_LATE_INIT
	imply SCSI
	help
	  This is the congatec Qseven 2.0 evaluation carrier board
	  (conga-QEVAL) equipped with the conga-QA3/E3845-4G SoM.
	  It contains an Atom E3845 with Ethernet, micro-SD, USB 2,
	  USB 3, SATA, serial console and HDMI 1.3 video out.
	  It requires some binary blobs - see README.x86 for details.

	  Note that PCIE_ECAM_BASE is set up by the FSP so the value used
	  by U-Boot matches that value.

config TARGET_THEADORABLE_X86_CONGA_QA3_E3845
	bool "theadorable-x86 baseboard & conga-QA3/E3845"
	help
	  This is the theadorable-x86 baseboard board equipped with the
	  conga-QA3/E3845-4G SoM. It contains an Atom E3845 with Ethernet,
	  micro-SD, USB 2, USB 3, SATA, serial console and HDMI 1.3 video
	  out. It requires some binary blobs - see README.x86 for details.

	  Note that PCIE_ECAM_BASE is set up by the FSP so the value used
	  by U-Boot matches that value.

endchoice

source "board/congatec/conga-qeval20-qa3-e3845/Kconfig"

endif
```

## release/src-rt-5.04behnd.4916/bootloaders/u-boot-2019.07/board/congatec/conga-qeval20-qa3-e3845/Kconfig
```kconfig
config SYS_BOARD
	default "conga-qeval20-qa3-e3845"

config SYS_VENDOR
	default "congatec"

config SYS_SOC
	default "baytrail"

config SYS_CONFIG_NAME
	default "conga-qeval20-qa3-e3845" if TARGET_CONGA_QEVAL20_QA3_E3845
	default "theadorable-x86-conga-qa3-e3845" if TARGET_THEADORABLE_X86_CONGA_QA3_E3845

config SYS_TEXT_BASE
	default 0xfff00000

config BOARD_SPECIFIC_OPTIONS # dummy
	def_bool y
	select X86_RESET_VECTOR
	select INTEL_BAYTRAIL
	select BOARD_ROMSIZE_KB_8192
	select BOARD_EARLY_INIT_F
	select BOARD_LATE_INIT
	select SPI_FLASH_STMICRO
	imply SPI_FLASH_SPANSION
	imply SPI_FLASH_WINBOND
	select SERIAL_RX_BUFFER

config PCIE_ECAM_BASE
	default 0xe0000000
```

## release/src-rt-5.04behnd.4916/bootloaders/u-boot-2019.07/board/corscience/tricorder/Kconfig
```kconfig
if TARGET_TRICORDER

config SYS_BOARD
	default "tricorder"

config SYS_VENDOR
	default "corscience"

config SYS_CONFIG_NAME
	default "tricorder"

endif
```
