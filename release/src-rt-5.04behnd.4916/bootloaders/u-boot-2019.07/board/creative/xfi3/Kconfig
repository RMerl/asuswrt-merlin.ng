## release/src-rt-5.04behnd.4916/bootloaders/u-boot-2019.07/board/creative/xfi3/Kconfig
```kconfig
if TARGET_XFI3

config SYS_BOARD
	default "xfi3"

config SYS_VENDOR
	default "creative"

config SYS_SOC
	default "mxs"

config SYS_CONFIG_NAME
	default "xfi3"

endif
```

## release/src-rt-5.04behnd.4916/bootloaders/u-boot-2019.07/board/cssi/MCR3000/Kconfig
```kconfig
if TARGET_MCR3000

config SYS_BOARD
	default "MCR3000"

config SYS_VENDOR
	default "cssi"

config SYS_CONFIG_NAME
	default "MCR3000"

config SYS_TEXT_BASE
	default 0x04000000

endif
```

## release/src-rt-5.04behnd.4916/bootloaders/u-boot-2019.07/board/d-link/dns325/Kconfig
```kconfig
if TARGET_DNS325

config SYS_BOARD
	default "dns325"

config SYS_VENDOR
	default "d-link"

config SYS_CONFIG_NAME
	default "dns325"

endif
```

## release/src-rt-5.04behnd.4916/bootloaders/u-boot-2019.07/board/davinci/da8xxevm/Kconfig
```kconfig
if TARGET_DA850EVM

config SYS_BOARD
	default "da8xxevm"

config SYS_VENDOR
	default "davinci"

config SYS_CONFIG_NAME
	default "da850evm"

menuconfig DA850_MAC
	bool "Use MAC Address"
	default y

if DA850_MAC
config MAC_ADDR_IN_SPIFLASH
	bool "MAC address in SPI Flash"
	default y
	help
	  The OMAP-L138 and AM1808 SoM are programmed with
	  their MAC address in SPI Flash from the factory
	  Enable this option to read the MAC from SPI Flash

config MAC_ADDR_IN_EEPROM
	bool "MAC address in EEPROM"
	help
	  The DA850 EVM comes with SoM are programmed with
	  their MAC address in SPI Flash from the factory,
	  but the kit has an optional expansion board with
	  EEPROM available.  Enable this option to read the
	  MAC from the EEPROM

endif

source "board/ti/common/Kconfig"

endif

if TARGET_OMAPL138_LCDK

config SYS_BOARD
	default "da8xxevm"

config SYS_VENDOR
	default "davinci"

config SYS_CONFIG_NAME
	default "omapl138_lcdk"

endif

source "board/ti/common/Kconfig"
```

## release/src-rt-5.04behnd.4916/bootloaders/u-boot-2019.07/board/dfi/Kconfig
```kconfig
# SPDX-License-Identifier: GPL-2.0+
#
# Copyright (C) 2015, Bin Meng <bmeng.cn@gmail.com>

if VENDOR_DFI

choice
	prompt "Mainboard model"

config TARGET_Q7X_151_DFI_BT700
	bool "DFI BT700 BayTrail on DFI Q7X-151 baseboard"
	imply SCSI
	help
	  This is the DFI Q7X-151 baseboard equipped with the
	  DFI BayTrail Bt700 SoM. It contains an Atom E3845 with
	  Ethernet (in non-PCIe-x4 configuration), micro-SD, USB 2,
	  USB 3, SATA, serial console and DisplayPort video out.
	  It requires some binary blobs - see README.x86 for details.

	  Note that PCIE_ECAM_BASE is set up by the FSP so the value used
	  by U-Boot matches that value.

config TARGET_THEADORABLE_X86_DFI_BT700
	bool "DFI BT700 BayTrail on theadorable-x86 baseboard"
	imply SCSI
	help
	  This is the theadorable-x86 baseboard equipped with the
	  DFI BayTrail Bt700 SoM. It contains an Atom E3845 with
	  Ethernet (in non-PCIe-x4 configuration), micro-SD, USB 2,
	  USB 3, SATA, serial console and DisplayPort video out.
	  It requires some binary blobs - see README.x86 for details.

	  Note that PCIE_ECAM_BASE is set up by the FSP so the value used
	  by U-Boot matches that value.

endchoice

source "board/dfi/dfi-bt700/Kconfig"

endif
```

## release/src-rt-5.04behnd.4916/bootloaders/u-boot-2019.07/board/dfi/dfi-bt700/Kconfig
```kconfig
config SYS_BOARD
	default "dfi-bt700"

config SYS_VENDOR
	default "dfi"

config SYS_SOC
	default "baytrail"

config SYS_CONFIG_NAME
	default "dfi-bt700" if TARGET_Q7X_151_DFI_BT700
	default "theadorable-x86-dfi-bt700" if TARGET_THEADORABLE_X86_DFI_BT700

config SYS_TEXT_BASE
	default 0xfff00000

config BOARD_SPECIFIC_OPTIONS # dummy
	def_bool y
	select X86_RESET_VECTOR
	select INTEL_BAYTRAIL
	select BOARD_ROMSIZE_KB_8192
	select BOARD_EARLY_INIT_F
	select BOARD_LATE_INIT
	select SPI_FLASH_STMICRO
	imply SPI_FLASH_SPANSION
	imply SPI_FLASH_WINBOND
	select SERIAL_RX_BUFFER

config PCIE_ECAM_BASE
	default 0xe0000000
```

## release/src-rt-5.04behnd.4916/bootloaders/u-boot-2019.07/board/eets/pdu001/Kconfig
```kconfig
# Copyright (C) 2018 EETS GmbH - http://www.eets.ch/
#
# SPDX-License-Identifier: GPL-2.0+
#

if TARGET_PDU001

config SYS_BOARD
	default "pdu001"

config SYS_VENDOR
	default "eets"

config SYS_SOC
	default "am33xx"

config SYS_CONFIG_NAME
	default "pdu001"

choice
	prompt "State of Run LED"
	default RUN_LED_RED
	help
	  The PDU001 has a bi-color (red/green) LED labeled 'Run' which
	  can be used to indicate the operating state of the board. By
	  default it will be lit red by U-Boot. Later in the start-up
	  process it can be changed to green (or heartbeat or anything else)
	  by the kernel or some other software.

config RUN_LED_RED
	bool
	prompt "Red"
	help
	  Lit Run LED red.

config RUN_LED_GREEN
	bool
	prompt "Green"
	help
	  Lit Run LED green.

config RUN_LED_OFF
	bool
	prompt "Off"
	help
	  Do not lit Run LED.

endchoice

endif
```

## release/src-rt-5.04behnd.4916/bootloaders/u-boot-2019.07/board/egnite/ethernut5/Kconfig
```kconfig
if TARGET_ETHERNUT5

config SYS_BOARD
	default "ethernut5"

config SYS_VENDOR
	default "egnite"

config SYS_CONFIG_NAME
	default "ethernut5"

endif
```

## release/src-rt-5.04behnd.4916/bootloaders/u-boot-2019.07/board/emulation/qemu-arm/Kconfig
```kconfig
if TARGET_QEMU_ARM_32BIT || TARGET_QEMU_ARM_64BIT

config SYS_TEXT_BASE
	default 0x00000000

config BOARD_SPECIFIC_OPTIONS # dummy
	def_bool y
	imply VIRTIO_MMIO
	imply VIRTIO_PCI
	imply VIRTIO_NET
	imply VIRTIO_BLK

endif
```

## release/src-rt-5.04behnd.4916/bootloaders/u-boot-2019.07/board/emulation/qemu-x86/Kconfig
```kconfig
if TARGET_QEMU_X86 || TARGET_QEMU_X86_64

config SYS_BOARD
	default "qemu-x86"

config SYS_VENDOR
	default "emulation"

config SYS_SOC
	default "qemu"

config SYS_CONFIG_NAME
	default "qemu-x86"

config SYS_TEXT_BASE
	default 0xfff00000 if !SUPPORT_SPL
	default 0x01110000 if SUPPORT_SPL

config BOARD_SPECIFIC_OPTIONS # dummy
	def_bool y
	select X86_RESET_VECTOR
	select QEMU
	select BOARD_ROMSIZE_KB_1024
	imply VIRTIO_PCI
	imply VIRTIO_NET
	imply VIRTIO_BLK

endif
```

## release/src-rt-5.04behnd.4916/bootloaders/u-boot-2019.07/board/engicam/imx6q/Kconfig
```kconfig
if TARGET_MX6Q_ENGICAM

config SYS_BOARD
	default "imx6q"

config SYS_VENDOR
	default "engicam"

config SYS_CONFIG_NAME
	default "imx6-engicam"

endif
```

## release/src-rt-5.04behnd.4916/bootloaders/u-boot-2019.07/board/engicam/imx6ul/Kconfig
```kconfig
if TARGET_MX6UL_ENGICAM

config SYS_BOARD
	default "imx6ul"

config SYS_VENDOR
	default "engicam"

config SYS_CONFIG_NAME
	default "imx6-engicam"

endif
```

## release/src-rt-5.04behnd.4916/bootloaders/u-boot-2019.07/board/esd/vme8349/Kconfig
```kconfig
if TARGET_VME8349

config SYS_BOARD
	default "vme8349"

config SYS_VENDOR
	default "esd"

config SYS_CONFIG_NAME
	default "vme8349"

endif

if TARGET_CADDY2

config SYS_BOARD
	default "vme8349"

config SYS_VENDOR
	default "esd"

config SYS_CONFIG_NAME
	default "caddy2"

endif
```

## release/src-rt-5.04behnd.4916/bootloaders/u-boot-2019.07/board/firefly/firefly-rk3288/Kconfig
```kconfig
if TARGET_FIREFLY_RK3288

config SYS_BOARD
	default "firefly-rk3288"

config SYS_VENDOR
	default "firefly"

config SYS_CONFIG_NAME
	default "firefly-rk3288"

config BOARD_SPECIFIC_OPTIONS # dummy
	def_bool y

endif
```

## release/src-rt-5.04behnd.4916/bootloaders/u-boot-2019.07/board/freescale/b4860qds/Kconfig
```kconfig
if TARGET_B4860QDS || TARGET_B4420QDS

config SYS_BOARD
	default "b4860qds"

config SYS_VENDOR
	default "freescale"

config SYS_CONFIG_NAME
	default "B4860QDS"

source "board/freescale/common/Kconfig"

endif
```

## release/src-rt-5.04behnd.4916/bootloaders/u-boot-2019.07/board/freescale/bsc9132qds/Kconfig
```kconfig
if TARGET_BSC9132QDS

config SYS_BOARD
	default "bsc9132qds"

config SYS_VENDOR
	default "freescale"

config SYS_CONFIG_NAME
	default "BSC9132QDS"

source "board/freescale/common/Kconfig"

endif
```

## release/src-rt-5.04behnd.4916/bootloaders/u-boot-2019.07/board/freescale/c29xpcie/Kconfig
```kconfig
if TARGET_C29XPCIE

config SYS_BOARD
	default "c29xpcie"

config SYS_VENDOR
	default "freescale"

config SYS_CONFIG_NAME
	default "C29XPCIE"

source "board/freescale/common/Kconfig"

endif
```

## release/src-rt-5.04behnd.4916/bootloaders/u-boot-2019.07/board/freescale/imx8mq_evk/Kconfig
```kconfig
if TARGET_IMX8MQ_EVK

config SYS_BOARD
	default "imx8mq_evk"

config SYS_VENDOR
	default "freescale"

config SYS_CONFIG_NAME
	default "imx8mq_evk"

endif
```

## release/src-rt-5.04behnd.4916/bootloaders/u-boot-2019.07/board/freescale/imx8qm_mek/Kconfig
```kconfig
if TARGET_IMX8QM_MEK

config SYS_BOARD
	default "imx8qm_mek"

config SYS_VENDOR
	default "freescale"

config SYS_CONFIG_NAME
	default "imx8qm_mek"

source "board/freescale/common/Kconfig"

endif
```

## release/src-rt-5.04behnd.4916/bootloaders/u-boot-2019.07/board/freescale/ls1043ardb/Kconfig
```kconfig
if TARGET_LS1043ARDB

config SYS_BOARD
	default "ls1043ardb"

config SYS_VENDOR
	default "freescale"

config SYS_SOC
	default "fsl-layerscape"

config SYS_CONFIG_NAME
	default "ls1043ardb"

config SYS_HAS_ARMV8_SECURE_BASE
	bool "Enable secure address for PSCI image"
	depends on ARMV8_PSCI
	default n
	help
	  PSCI image can be re-located to secure RAM.
	  If enabled, please also define the value for ARMV8_SECURE_BASE,
	  for LS1043ARDB, it could be some address in OCRAM.

if FSL_LS_PPA
config SYS_LS_PPA_FW_ADDR
	hex "PPA Firmware Addr"
	default 0x60400000 if SYS_LS_PPA_FW_IN_XIP
	default 0x400000 if SYS_LS_PPA_FW_IN_MMC || SYS_LS_PPA_FW_IN_NAND

if CHAIN_OF_TRUST
config SYS_LS_PPA_ESBC_ADDR
	hex "PPA Firmware HDR Addr"
	default 0x60680000 if SYS_LS_PPA_FW_IN_XIP
	default 0x680000 if SYS_LS_PPA_FW_IN_MMC || SYS_LS_PPA_FW_IN_NAND
endif
endif

source "board/freescale/common/Kconfig"

endif
```

## release/src-rt-5.04behnd.4916/bootloaders/u-boot-2019.07/board/freescale/ls1046afrwy/Kconfig
```kconfig
if TARGET_LS1046AFRWY

config SYS_BOARD
	default "ls1046afrwy"

config SYS_VENDOR
	default "freescale"

config SYS_SOC
	default "fsl-layerscape"

config SYS_CONFIG_NAME
	default "ls1046afrwy"

source "board/freescale/common/Kconfig"
endif
```

## release/src-rt-5.04behnd.4916/bootloaders/u-boot-2019.07/board/freescale/ls1088a/Kconfig
```kconfig
if TARGET_LS1088AQDS

config SYS_BOARD
	default "ls1088a"

config SYS_VENDOR
	default "freescale"

config SYS_SOC
	default "fsl-layerscape"

config SYS_CONFIG_NAME
	default "ls1088aqds"

if FSL_LS_PPA
config SYS_LS_PPA_FW_ADDR
        hex "PPA Firmware Addr"
	default 0x20400000 if SYS_LS_PPA_FW_IN_XIP
	default 0x400000 if SYS_LS_PPA_FW_IN_MMC || SYS_LS_PPA_FW_IN_NAND

if CHAIN_OF_TRUST
config SYS_LS_PPA_ESBC_ADDR
	hex "PPA Firmware HDR Addr"
	default 0x20680000 if SYS_LS_PPA_FW_IN_XIP
	default 0x680000 if SYS_LS_PPA_FW_IN_MMC || SYS_LS_PPA_FW_IN_NAND
endif
endif

source "board/freescale/common/Kconfig"
endif

if TARGET_LS1088ARDB

config SYS_BOARD
	default "ls1088a"

config SYS_VENDOR
	default "freescale"

config SYS_SOC
	default "fsl-layerscape"

config SYS_CONFIG_NAME
	default "ls1088ardb"

if FSL_LS_PPA
config SYS_LS_PPA_FW_ADDR
        hex "PPA Firmware Addr"
	default 0x20400000 if SYS_LS_PPA_FW_IN_XIP
	default 0x400000 if SYS_LS_PPA_FW_IN_MMC || SYS_LS_PPA_FW_IN_NAND

if CHAIN_OF_TRUST
config SYS_LS_PPA_ESBC_ADDR
	hex "PPA Firmware HDR Addr"
	default 0x20680000 if SYS_LS_PPA_FW_IN_XIP
	default 0x680000 if SYS_LS_PPA_FW_IN_MMC || SYS_LS_PPA_FW_IN_NAND
endif
endif

source "board/freescale/common/Kconfig"
endif
```

## release/src-rt-5.04behnd.4916/bootloaders/u-boot-2019.07/board/freescale/ls2080ardb/Kconfig
```kconfig
if TARGET_LS2080ARDB || TARGET_LS2081ARDB

config SYS_BOARD
	default "ls2080ardb"

config SYS_VENDOR
	default "freescale"

config SYS_SOC
	default "fsl-layerscape"

config SYS_CONFIG_NAME
	default "ls2080ardb"

source "board/freescale/common/Kconfig"

if FSL_LS_PPA
config SYS_LS_PPA_FW_ADDR
	hex "PPA Firmware Addr"
	default 0x20400000 if SYS_LS_PPA_FW_IN_XIP && QSPI_BOOT
	default 0x580400000 if SYS_LS_PPA_FW_IN_XIP
	default 0x400000 if SYS_LS_PPA_FW_IN_MMC || SYS_LS_PPA_FW_IN_NAND

if CHAIN_OF_TRUST
config SYS_LS_PPA_ESBC_ADDR
	hex "PPA Firmware HDR Addr"
	default 0x20680000 if SYS_LS_PPA_FW_IN_XIP && QSPI_BOOT
	default 0x580680000 if SYS_LS_PPA_FW_IN_XIP
	default 0x680000 if SYS_LS_PPA_FW_IN_MMC || SYS_LS_PPA_FW_IN_NAND
endif
endif

source "board/freescale/common/Kconfig"

endif
```

## release/src-rt-5.04behnd.4916/bootloaders/u-boot-2019.07/board/freescale/lx2160a/Kconfig
```kconfig
if TARGET_LX2160ARDB

config SYS_BOARD
	default "lx2160a"

config SYS_VENDOR
	default "freescale"

config SYS_SOC
	default "fsl-layerscape"

config SYS_CONFIG_NAME
	default "lx2160ardb"

source "board/freescale/common/Kconfig"
endif

if TARGET_LX2160AQDS

config SYS_BOARD
	default "lx2160a"

config SYS_VENDOR
	default "freescale"

config SYS_SOC
	default "fsl-layerscape"

config SYS_CONFIG_NAME
	default "lx2160aqds"

source "board/freescale/common/Kconfig"
endif
```

## release/src-rt-5.04behnd.4916/bootloaders/u-boot-2019.07/board/freescale/m5208evbe/Kconfig
```kconfig
if TARGET_M5208EVBE

config SYS_CPU
	default "mcf52x2"

config SYS_BOARD
	default "m5208evbe"

config SYS_VENDOR
	default "freescale"

config SYS_CONFIG_NAME
	default "M5208EVBE"

endif
```
