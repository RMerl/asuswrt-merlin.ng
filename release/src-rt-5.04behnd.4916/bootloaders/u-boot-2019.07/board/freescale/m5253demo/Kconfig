## release/src-rt-5.04behnd.4916/bootloaders/u-boot-2019.07/board/freescale/m5253demo/Kconfig
```kconfig
if TARGET_M5253DEMO

config SYS_CPU
	default "mcf52x2"

config SYS_BOARD
	default "m5253demo"

config SYS_VENDOR
	default "freescale"

config SYS_CONFIG_NAME
	default "M5253DEMO"

endif
```

## release/src-rt-5.04behnd.4916/bootloaders/u-boot-2019.07/board/freescale/m54418twr/Kconfig
```kconfig
if TARGET_M54418TWR

config SYS_CPU
	default "mcf5445x"

config SYS_BOARD
	default "m54418twr"

config SYS_VENDOR
	default "freescale"

config SYS_CONFIG_NAME
	default "M54418TWR"

endif
```

## release/src-rt-5.04behnd.4916/bootloaders/u-boot-2019.07/board/freescale/m54451evb/Kconfig
```kconfig
if TARGET_M54451EVB

config SYS_CPU
	default "mcf5445x"

config SYS_BOARD
	default "m54451evb"

config SYS_VENDOR
	default "freescale"

config SYS_CONFIG_NAME
	default "M54451EVB"

endif
```

## release/src-rt-5.04behnd.4916/bootloaders/u-boot-2019.07/board/freescale/m548xevb/Kconfig
```kconfig
if TARGET_M5485EVB

config SYS_CPU
	default "mcf547x_8x"

config SYS_BOARD
	default "m548xevb"

config SYS_VENDOR
	default "freescale"

config SYS_CONFIG_NAME
	default "M5485EVB"

endif
```

## release/src-rt-5.04behnd.4916/bootloaders/u-boot-2019.07/board/freescale/mpc8313erdb/Kconfig
```kconfig
if TARGET_MPC8313ERDB_NOR

config SYS_BOARD
	default "mpc8313erdb"

config SYS_VENDOR
	default "freescale"

config SYS_CONFIG_NAME
	default "MPC8313ERDB_NOR"

endif

if TARGET_MPC8313ERDB_NAND

config SYS_BOARD
	default "mpc8313erdb"

config SYS_VENDOR
	default "freescale"

config SYS_CONFIG_NAME
	default "MPC8313ERDB_NAND"

endif
```

## release/src-rt-5.04behnd.4916/bootloaders/u-boot-2019.07/board/freescale/mpc8323erdb/Kconfig
```kconfig
if TARGET_MPC8323ERDB

config SYS_BOARD
	default "mpc8323erdb"

config SYS_VENDOR
	default "freescale"

config SYS_CONFIG_NAME
	default "MPC8323ERDB"

endif
```

## release/src-rt-5.04behnd.4916/bootloaders/u-boot-2019.07/board/freescale/mpc8349itx/Kconfig
```kconfig
if TARGET_MPC8349ITX

config SYS_BOARD
	default "mpc8349itx"

config SYS_VENDOR
	default "freescale"

config SYS_CONFIG_NAME
	default "MPC8349ITX"

endif
```

## release/src-rt-5.04behnd.4916/bootloaders/u-boot-2019.07/board/freescale/mpc837xemds/Kconfig
```kconfig
if TARGET_MPC837XEMDS

config SYS_BOARD
	default "mpc837xemds"

config SYS_VENDOR
	default "freescale"

config SYS_CONFIG_NAME
	default "MPC837XEMDS"

endif
```

## release/src-rt-5.04behnd.4916/bootloaders/u-boot-2019.07/board/freescale/mpc837xerdb/Kconfig
```kconfig
if TARGET_MPC837XERDB

config SYS_BOARD
	default "mpc837xerdb"

config SYS_VENDOR
	default "freescale"

config SYS_CONFIG_NAME
	default "MPC837XERDB"

endif
```

## release/src-rt-5.04behnd.4916/bootloaders/u-boot-2019.07/board/freescale/mpc8555cds/Kconfig
```kconfig
if TARGET_MPC8555CDS

config SYS_BOARD
	default "mpc8555cds"

config SYS_VENDOR
	default "freescale"

config SYS_CONFIG_NAME
	default "MPC8555CDS"

endif
```

## release/src-rt-5.04behnd.4916/bootloaders/u-boot-2019.07/board/freescale/mpc8572ds/Kconfig
```kconfig
if TARGET_MPC8572DS

config SYS_BOARD
	default "mpc8572ds"

config SYS_VENDOR
	default "freescale"

config SYS_CONFIG_NAME
	default "MPC8572DS"

endif
```

## release/src-rt-5.04behnd.4916/bootloaders/u-boot-2019.07/board/freescale/mpc8610hpcd/Kconfig
```kconfig
if TARGET_MPC8610HPCD

config SYS_BOARD
	default "mpc8610hpcd"

config SYS_VENDOR
	default "freescale"

config SYS_CONFIG_NAME
	default "MPC8610HPCD"

endif
```

## release/src-rt-5.04behnd.4916/bootloaders/u-boot-2019.07/board/freescale/mpc8641hpcn/Kconfig
```kconfig
if TARGET_MPC8641HPCN

config SYS_BOARD
	default "mpc8641hpcn"

config SYS_VENDOR
	default "freescale"

config SYS_CONFIG_NAME
	default "MPC8641HPCN"

endif
```

## release/src-rt-5.04behnd.4916/bootloaders/u-boot-2019.07/board/freescale/mx25pdk/Kconfig
```kconfig
if TARGET_MX25PDK

config SYS_BOARD
	default "mx25pdk"

config SYS_VENDOR
	default "freescale"

config SYS_SOC
	default "mx25"

config SYS_CONFIG_NAME
	default "mx25pdk"

endif
```

## release/src-rt-5.04behnd.4916/bootloaders/u-boot-2019.07/board/freescale/mx31pdk/Kconfig
```kconfig
if TARGET_MX31PDK

config SPL_LDSCRIPT
	default "arch/$(ARCH)/cpu/u-boot-spl.lds"

config SYS_BOARD
	default "mx31pdk"

config SYS_VENDOR
	default "freescale"

config SYS_SOC
	default "mx31"

config SYS_CONFIG_NAME
	default "mx31pdk"

endif
```

## release/src-rt-5.04behnd.4916/bootloaders/u-boot-2019.07/board/freescale/mx51evk/Kconfig
```kconfig
if TARGET_MX51EVK

config SYS_BOARD
	default "mx51evk"

config SYS_VENDOR
	default "freescale"

config SYS_SOC
	default "mx5"

config SYS_CONFIG_NAME
	default "mx51evk"

endif
```

## release/src-rt-5.04behnd.4916/bootloaders/u-boot-2019.07/board/freescale/mx53evk/Kconfig
```kconfig
if TARGET_MX53EVK

config SYS_BOARD
	default "mx53evk"

config SYS_VENDOR
	default "freescale"

config SYS_SOC
	default "mx5"

config SYS_CONFIG_NAME
	default "mx53evk"

endif
```

## release/src-rt-5.04behnd.4916/bootloaders/u-boot-2019.07/board/freescale/mx53loco/Kconfig
```kconfig
if TARGET_MX53LOCO

config SYS_BOARD
	default "mx53loco"

config SYS_VENDOR
	default "freescale"

config SYS_SOC
	default "mx5"

config SYS_CONFIG_NAME
	default "mx53loco"

endif
```

## release/src-rt-5.04behnd.4916/bootloaders/u-boot-2019.07/board/freescale/mx53smd/Kconfig
```kconfig
if TARGET_MX53SMD

config SYS_BOARD
	default "mx53smd"

config SYS_VENDOR
	default "freescale"

config SYS_SOC
	default "mx5"

config SYS_CONFIG_NAME
	default "mx53smd"

endif
```

## release/src-rt-5.04behnd.4916/bootloaders/u-boot-2019.07/board/freescale/mx6qarm2/Kconfig
```kconfig
if TARGET_MX6QARM2

config SYS_BOARD
	default "mx6qarm2"

config SYS_VENDOR
	default "freescale"

config SYS_CONFIG_NAME
	default "mx6qarm2"

endif
```

## release/src-rt-5.04behnd.4916/bootloaders/u-boot-2019.07/board/freescale/mx6sabresd/Kconfig
```kconfig
if TARGET_MX6SABRESD

config SYS_BOARD
	default "mx6sabresd"

config SYS_VENDOR
	default "freescale"

config SYS_CONFIG_NAME
	default "mx6sabresd"

endif
```

## release/src-rt-5.04behnd.4916/bootloaders/u-boot-2019.07/board/freescale/mx6sxsabresd/Kconfig
```kconfig
if TARGET_MX6SXSABRESD

config SYS_BOARD
	default "mx6sxsabresd"

config SYS_VENDOR
	default "freescale"

config SYS_CONFIG_NAME
	default "mx6sxsabresd"

endif
```

## release/src-rt-5.04behnd.4916/bootloaders/u-boot-2019.07/board/freescale/mx7ulp_evk/Kconfig
```kconfig
if TARGET_MX7ULP_EVK

config SYS_BOARD
	default "mx7ulp_evk"

config SYS_VENDOR
	default "freescale"

config SYS_CONFIG_NAME
	default "mx7ulp_evk"

endif
```

## release/src-rt-5.04behnd.4916/bootloaders/u-boot-2019.07/board/freescale/p1022ds/Kconfig
```kconfig
if TARGET_P1022DS

config SYS_BOARD
	default "p1022ds"

config SYS_VENDOR
	default "freescale"

config SYS_CONFIG_NAME
	default "P1022DS"

endif
```

## release/src-rt-5.04behnd.4916/bootloaders/u-boot-2019.07/board/freescale/p1023rdb/Kconfig
```kconfig
if TARGET_P1023RDB

config SYS_BOARD
	default "p1023rdb"

config SYS_VENDOR
	default "freescale"

config SYS_CONFIG_NAME
	default "P1023RDB"

endif
```
