## release/src-rt-5.04behnd.4916/bootloaders/u-boot-2019.07/board/freescale/p1_p2_rdb_pc/Kconfig
```kconfig
if TARGET_P1020MBG		|| \
	TARGET_P1020RDB_PC	|| \
	TARGET_P1020RDB_PD	|| \
	TARGET_P1020UTM		|| \
	TARGET_P1021RDB		|| \
	TARGET_P1024RDB		|| \
	TARGET_P1025RDB		|| \
	TARGET_P2020RDB

config SYS_BOARD
	default "p1_p2_rdb_pc"

config SYS_VENDOR
	default "freescale"

config SYS_CONFIG_NAME
	default "p1_p2_rdb_pc"

endif
```

## release/src-rt-5.04behnd.4916/bootloaders/u-boot-2019.07/board/freescale/p1_twr/Kconfig
```kconfig
if TARGET_P1_TWR

config SYS_BOARD
	default "p1_twr"

config SYS_VENDOR
	default "freescale"

config SYS_CONFIG_NAME
	default "p1_twr"

endif
```

## release/src-rt-5.04behnd.4916/bootloaders/u-boot-2019.07/board/freescale/t104xrdb/Kconfig
```kconfig
if TARGET_T1040RDB || TARGET_T1040D4RDB || \
	TARGET_T1042RDB || TARGET_T1042D4RDB || \
	TARGET_T1042RDB_PI

config SYS_BOARD
	default "t104xrdb"

config SYS_VENDOR
	default "freescale"

config SYS_CONFIG_NAME
	default "T104xRDB"

source "board/freescale/common/Kconfig"

endif
```

## release/src-rt-5.04behnd.4916/bootloaders/u-boot-2019.07/board/freescale/t208xrdb/Kconfig
```kconfig
if TARGET_T2080RDB

config SYS_BOARD
	default "t208xrdb"

config SYS_VENDOR
	default "freescale"

config SYS_CONFIG_NAME
	default "T208xRDB"

source "board/freescale/common/Kconfig"

endif
```

## release/src-rt-5.04behnd.4916/bootloaders/u-boot-2019.07/board/freescale/t4rdb/Kconfig
```kconfig
if TARGET_T4160RDB || TARGET_T4240RDB

config SYS_BOARD
	default "t4rdb"

config SYS_VENDOR
	default "freescale"

config SYS_CONFIG_NAME
	default "T4240RDB"

source "board/freescale/common/Kconfig"

endif
```

## release/src-rt-5.04behnd.4916/bootloaders/u-boot-2019.07/board/freescale/vf610twr/Kconfig
```kconfig
if TARGET_VF610TWR

config SYS_BOARD
	default "vf610twr"

config SYS_VENDOR
	default "freescale"

config SYS_CONFIG_NAME
	default "vf610twr"

endif
```

## release/src-rt-5.04behnd.4916/bootloaders/u-boot-2019.07/board/gdsys/p1022/Kconfig
```kconfig
config GDSYS_LEGACY_DRIVERS
	bool
	help
	  Enable the gdsys legacy drivers under board/gdsys/common. If this
	  option is not set, all relevant DM drivers must be configured for the
	  device in question.

if TARGET_CONTROLCENTERD

config SYS_BOARD
	default "p1022"

config SYS_VENDOR
	default "gdsys"

config SYS_CONFIG_NAME
	default "controlcenterd"

config GDSYS_LEGACY_DRIVERS
	default y

endif
```

## release/src-rt-5.04behnd.4916/bootloaders/u-boot-2019.07/board/ge/bx50v3/Kconfig
```kconfig
if TARGET_GE_BX50V3

config IMX_CONFIG
	default "board/ge/bx50v3/bx50v3.cfg"

config SYS_BOARD
	default "bx50v3"

config SYS_VENDOR
	default "ge"

config SYS_SOC
	default "mx6"

config SYS_CONFIG_NAME
	default "ge_bx50v3"

source "board/ge/common/Kconfig"

endif
```

## release/src-rt-5.04behnd.4916/bootloaders/u-boot-2019.07/board/ge/common/Kconfig
```kconfig
config SYS_VPD_EEPROM_I2C_ADDR
	hex "I2C address of the EEPROM device used for VPD"
	help
	  VPD = Vital Product Data

config SYS_VPD_EEPROM_I2C_BUS
	int "I2C bus of the EEPROM device used for VPD."

config SYS_VPD_EEPROM_SIZE
	int "Size in bytes of the EEPROM device used for VPD"

config SYS_VPD_EEPROM_I2C_ADDR_LEN
	int "Number of bytes to use for VPD EEPROM address"
	default 1
```

## release/src-rt-5.04behnd.4916/bootloaders/u-boot-2019.07/board/ge/mx53ppd/Kconfig
```kconfig
if TARGET_MX53PPD

config SYS_BOARD
	default "mx53ppd"

config SYS_VENDOR
	default "ge"

config SYS_SOC
	default "mx5"

config SYS_CONFIG_NAME
	default "mx53ppd"

source "board/ge/common/Kconfig"

endif
```

## release/src-rt-5.04behnd.4916/bootloaders/u-boot-2019.07/board/google/Kconfig
```kconfig
# SPDX-License-Identifier: GPL-2.0+
#
# Copyright (C) 2015, Bin Meng <bmeng.cn@gmail.com>

if VENDOR_GOOGLE

choice
	prompt "Mainboard model"
	optional

config TARGET_CHROMEBOOK_LINK
	bool "Chromebook link"
	help
	  This is the Chromebook Pixel released in 2013. It uses an Intel
	  i5 Ivybridge which is a die-shrink of Sandybridge, with 4GB of
	  SDRAM. It has a Panther Point platform controller hub, PCIe
	  WiFi and Bluetooth. It also includes a 720p webcam, USB SD
	  reader, microphone and speakers, display port and 32GB SATA
	  solid state drive. There is a Chrome OS EC connected on LPC,
	  and it provides a 2560x1700 high resolution touch-enabled LCD
	  display.

config TARGET_CHROMEBOOK_LINK64
	bool "Chromebook link 64-bit"
	help
	  This is the Chromebook Pixel released in 2013. With this config
	  U-Boot is built as a 64-bit binary. This allows testing while this
	  feature is being completed.

config TARGET_CHROMEBOX_PANTHER
	bool "Chromebox panther (not available)"
	help
	  Note: At present this must be used with coreboot. See README.x86
	  for instructions.

	  This is the Asus Chromebox CN60 released in 2014. It uses an Intel
	  Haswell Celeron 2955U Dual Core CPU with 2GB of SDRAM. It has a
	  Lynx Point platform controller hub, PCIe WiFi and Bluetooth. It also
	  includes a USB SD reader, four USB3 ports, display port and HDMI
	  video output and a 16GB SATA solid state drive. There is no Chrome
	  OS EC on this model.

config TARGET_CHROMEBOOK_SAMUS
	bool "Chromebook samus"
	help
	  This is the Chromebook Pixel released in 2015. It uses an Intel
	  Broadwell U Core i5 or Core i7 CPU with either 8GB or 16GB of
	  LPDDR3 SDRAM. It has PCIe WiFi and Bluetooth. It also includes a
	  720p webcam, USB SD reader, microphone and speakers, 2 USB 3 Type
	  C ports which can support charging and up to a 4K external display.
	  There is a solid state drive, either 32GB or 64GB. There is a
	  Chrome OS EC connected on LPC, and it provides a 2560x1700 high
	  resolution touch-enabled LCD display.

config TARGET_CHROMEBOOK_SAMUS_TPL
	bool "Chromebook samus booting from TPL"
	help
	  This is a version of Samus which boots into TPL, then to SPL and
	  U-Boot proper. This is useful where verified boot must select
	  between different A/B versions of SPL/U-Boot, to allow upgrading of
	  almost all U-Boot code in the field.

endchoice

source "board/google/chromebook_link/Kconfig"
source "board/google/chromebox_panther/Kconfig"
source "board/google/chromebook_samus/Kconfig"

endif
```

## release/src-rt-5.04behnd.4916/bootloaders/u-boot-2019.07/board/grinn/liteboard/Kconfig
```kconfig
if TARGET_LITEBOARD

config SYS_BOARD
	default "liteboard"

config SYS_VENDOR
	default "grinn"

config SYS_CONFIG_NAME
	default "liteboard"

endif
```

## release/src-rt-5.04behnd.4916/bootloaders/u-boot-2019.07/board/ids/ids8313/Kconfig
```kconfig
if TARGET_IDS8313

config SYS_BOARD
	default "ids8313"

config SYS_VENDOR
	default "ids"

config SYS_CONFIG_NAME
	default "ids8313"

endif
```

## release/src-rt-5.04behnd.4916/bootloaders/u-boot-2019.07/board/imgtec/malta/Kconfig
```kconfig
if TARGET_MALTA

config SYS_BOARD
	default "malta"

config SYS_VENDOR
	default "imgtec"

config SYS_CONFIG_NAME
	default "malta"

config SYS_TEXT_BASE
	default 0xbe000000 if 32BIT
	default 0xffffffffbe000000 if 64BIT

endif
```

## release/src-rt-5.04behnd.4916/bootloaders/u-boot-2019.07/board/intel/Kconfig
```kconfig
# SPDX-License-Identifier: GPL-2.0+
#
# Copyright (C) 2015, Bin Meng <bmeng.cn@gmail.com>

if VENDOR_INTEL

choice
	prompt "Mainboard model"
	optional

config TARGET_BAYLEYBAY
	bool "Bayley Bay"
	help
	  This is the Intel Bayley Bay Customer Reference Board. It contains an
	  Intel quad-core Atom Processor E3800 with dual-channel DDR3L SODIMM
	  4GB memory, HDMI/DP/VGA display, HD audio, SATA, USB2, USB3, SD, eMMC,
	  PCIe and some other sensor interfaces.

config TARGET_CHERRYHILL
	bool "Cherry Hill"
	help
	  This is the Intel Cherry Hill Customer Reference Board. It is in a
	  mini-ITX form factor containing the Intel Braswell SoC, which has
	  a 64-bit quad-core, single-thread, Intel Atom processor, along with
	  serial console, 10/100/1000 Ethernet, SD-Card, USB 2/3, SATA, PCIe,
	  some GPIOs, one HDMI and two DP video out.

config TARGET_COUGARCANYON2
	bool "Cougar Canyon 2"
	help
	  This is the Intel Cougar Canyon 2 Customer Reference Board. It
	  is built on the Chief River platform with Intel Ivybridge Processor
	  and Panther Point chipset. The board has 4GB RAM, with some other
	  peripheral connectors for PCIe/SATA/USB2/USB3/LAN/UART/PS2/VGA/HDMI.

config TARGET_CROWNBAY
	bool "Crown Bay"
	help
	  This is the Intel Crown Bay Customer Reference Board. It contains
	  the Intel Atom Processor E6xx populated on the COM Express module
	  with 1GB DDR2 soldered down memory and a carrier board with the
	  Intel Platform Controller Hub EG20T, other system components and
	  peripheral connectors for PCIe/SATA/USB/LAN/SD/UART/Audio/LVDS.

config TARGET_EDISON
	bool "Edison"
	help
	  This is the Intel Edison Compute Module. It contains a dual core Intel
	  Atom Tangier CPU, 1 GB RAM integrated on package. There is also 4 GB
	  eMMC flash on board, Wi-Fi, Bluetooth 4 and USB controllers.

config TARGET_GALILEO
	bool "Galileo"
	help
	  This is the Intel Galileo board, which is the first in a family of
	  Arduino-certified development and prototyping boards based on Intel
	  architecture. It includes an Intel Quark SoC X1000 processor, a 32-bit
	  single-core, single-thread, Intel Pentium processor instrunction set
	  architecture (ISA) compatible, operating at speeds up to 400Mhz,
	  along with 256MB DDR3 memory. It supports a wide range of industry
	  standard I/O interfaces, including a full-sized mini-PCIe slot,
	  one 100Mb Ethernet port, a microSD card slot, a USB host port and
	  a USB client port.

config TARGET_MINNOWMAX
	bool "Minnowboard MAX"
	help
	  This is the Intel Minnowboard MAX. It contains an Atom E3800
	  processor in a small form factor with Ethernet, micro-SD, USB 2,
	  USB 3, SATA, serial console, some GPIOs and HDMI 1.3 video out.
	  It requires some binary blobs - see README.x86 for details.

	  Note that PCIE_ECAM_BASE is set up by the FSP so the value used
	  by U-Boot matches that value.

endchoice

source "board/intel/bayleybay/Kconfig"
source "board/intel/cherryhill/Kconfig"
source "board/intel/cougarcanyon2/Kconfig"
source "board/intel/crownbay/Kconfig"
source "board/intel/edison/Kconfig"
source "board/intel/galileo/Kconfig"
source "board/intel/minnowmax/Kconfig"

endif
```

## release/src-rt-5.04behnd.4916/bootloaders/u-boot-2019.07/board/intel/bayleybay/Kconfig
```kconfig
if TARGET_BAYLEYBAY

config SYS_BOARD
	default "bayleybay"

config SYS_VENDOR
	default "intel"

config SYS_SOC
	default "baytrail"

config SYS_CONFIG_NAME
	default "bayleybay"

config SYS_TEXT_BASE
	default 0xfff00000

config BOARD_SPECIFIC_OPTIONS # dummy
	def_bool y
	select X86_RESET_VECTOR
	select INTEL_BAYTRAIL
	select BOARD_ROMSIZE_KB_8192
	select SPI_FLASH_WINBOND

config PCIE_ECAM_BASE
	default 0xe0000000

endif
```

## release/src-rt-5.04behnd.4916/bootloaders/u-boot-2019.07/board/intel/edison/Kconfig
```kconfig
if TARGET_EDISON

config SYS_BOARD
	default "edison"

config SYS_VENDOR
	default "intel"

config SYS_SOC
	default "tangier"

config SYS_CONFIG_NAME
	default "edison"

config SYS_TEXT_BASE
	default 0x01101000

config ROM_TABLE_ADDR
	default 0x0e4500

config ROM_TABLE_SIZE
	default 0x007b00

config BOARD_SPECIFIC_OPTIONS # dummy
	def_bool y
	select X86_LOAD_FROM_32_BIT
	select INTEL_MID
	select INTEL_TANGIER
	select BOARD_LATE_INIT
	select MD5

endif
```

## release/src-rt-5.04behnd.4916/bootloaders/u-boot-2019.07/board/isee/igep003x/Kconfig
```kconfig
if TARGET_AM335X_IGEP003X

config SYS_BOARD
	default "igep003x"

config SYS_VENDOR
	default "isee"

config SYS_SOC
	default "am33xx"

config SYS_CONFIG_NAME
	default "am335x_igep003x"

endif
```

## release/src-rt-5.04behnd.4916/bootloaders/u-boot-2019.07/board/k+p/kp_imx53/Kconfig
```kconfig
if TARGET_KP_IMX53

config SYS_BOARD
	default "kp_imx53"

config SYS_VENDOR
	default "k+p"

config SYS_SOC
	default "mx5"

config SYS_CONFIG_NAME
	default "kp_imx53"

endif
```

## release/src-rt-5.04behnd.4916/bootloaders/u-boot-2019.07/board/kosagi/novena/Kconfig
```kconfig
if TARGET_KOSAGI_NOVENA

config SYS_BOARD
	default "novena"

config SYS_VENDOR
	default "kosagi"

config SYS_CONFIG_NAME
	default "novena"

endif
```

## release/src-rt-5.04behnd.4916/bootloaders/u-boot-2019.07/board/l+g/vinco/Kconfig
```kconfig
if TARGET_VINCO

config SYS_BOARD
	default "vinco"

config SYS_VENDOR
	default "l+g"

config SYS_CONFIG_NAME
	default "vinco"

endif
```

## release/src-rt-5.04behnd.4916/bootloaders/u-boot-2019.07/board/laird/wb45n/Kconfig
```kconfig
if TARGET_WB45N

config SYS_BOARD
	default "wb45n"

config SYS_VENDOR
	default "laird"

config SYS_CONFIG_NAME
	default "wb45n"

endif
```

## release/src-rt-5.04behnd.4916/bootloaders/u-boot-2019.07/board/liebherr/display5/Kconfig
```kconfig
if TARGET_DISPLAY5

config SYS_CPU
	default "armv7"

config SYS_BOARD
	default "display5"

config SYS_VENDOR
	default "liebherr"

config SYS_SOC
	default "mx6"

config SYS_CONFIG_NAME
	default "display5"

endif
```

## release/src-rt-5.04behnd.4916/bootloaders/u-boot-2019.07/board/liebherr/mccmon6/Kconfig
```kconfig
if TARGET_MCCMON6

config SYS_BOARD
	default "mccmon6"

config SYS_VENDOR
	default "liebherr"

config SYS_CONFIG_NAME
	default "mccmon6"

endif
```

## release/src-rt-5.04behnd.4916/bootloaders/u-boot-2019.07/board/logicpd/am3517evm/Kconfig
```kconfig
if TARGET_AM3517_EVM

config SYS_BOARD
	default "am3517evm"

config SYS_VENDOR
	default "logicpd"

config SYS_CONFIG_NAME
	default "am3517_evm"

source "board/ti/common/Kconfig"

endif
```
