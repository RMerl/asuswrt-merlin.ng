## release/src-rt-5.04behnd.4916/bootloaders/u-boot-2019.07/board/logicpd/imx6/Kconfig
```kconfig
if TARGET_MX6LOGICPD

config SYS_BOARD
       default "imx6"

config SYS_VENDOR
       default "logicpd"

config SYS_CONFIG_NAME
       default "imx6_logic"

endif
```

## release/src-rt-5.04behnd.4916/bootloaders/u-boot-2019.07/board/logicpd/omap3som/Kconfig
```kconfig
if TARGET_OMAP3_LOGIC

config SYS_BOARD
	default "omap3som"

config SYS_VENDOR
	default "logicpd"

config SYS_CONFIG_NAME
	default "omap3_logic"

source "board/ti/common/Kconfig"

endif
```

## release/src-rt-5.04behnd.4916/bootloaders/u-boot-2019.07/board/logicpd/zoom1/Kconfig
```kconfig
if TARGET_OMAP3_ZOOM1

config SYS_BOARD
	default "zoom1"

config SYS_VENDOR
	default "logicpd"

config SYS_CONFIG_NAME
	default "omap3_zoom1"

endif
```

## release/src-rt-5.04behnd.4916/bootloaders/u-boot-2019.07/board/menlo/m53menlo/Kconfig
```kconfig
if TARGET_M53MENLO

config SYS_BOARD
	default "m53menlo"

config SYS_VENDOR
	default "menlo"

config SYS_SOC
	default "mx5"

config SYS_CONFIG_NAME
	default "m53menlo"

endif
```

## release/src-rt-5.04behnd.4916/bootloaders/u-boot-2019.07/board/micronas/vct/Kconfig
```kconfig
if TARGET_VCT

config SYS_BOARD
	default "vct"

config SYS_VENDOR
	default "micronas"

config SYS_CONFIG_NAME
	default "vct"

config SYS_TEXT_BASE
	default 0x87000000

config SYS_DCACHE_SIZE
	default 16384

config SYS_DCACHE_LINE_SIZE
	default 32

config SYS_ICACHE_SIZE
	default 16384

config SYS_ICACHE_LINE_SIZE
	default 32

menu "vct board options"

choice
	prompt "Board variant"
	optional

config VCT_PLATINUM
	bool "Enable VCT_PLATINUM"

config VCT_PLATINUMAVC
	bool "Enable VCT_PLATINUMAVC"

config VCT_PREMIUM
	bool "Enable VCT_PLATINUMAVC"

endchoice

config VCT_ONENAND
	bool "Enable VCT_ONENAND"

config VCT_SMALL_IMAGE
	bool "Enable VCT_SMALL_IMAGE"

endmenu

endif
```

## release/src-rt-5.04behnd.4916/bootloaders/u-boot-2019.07/board/mscc/ocelot/Kconfig
```kconfig
# SPDX-License-Identifier: (GPL-2.0+ OR MIT)

config SYS_VENDOR
	default "mscc"

if SOC_OCELOT

config SYS_BOARD
	default "ocelot"

config SYS_CONFIG_NAME
	default "ocelot"

endif
```

## release/src-rt-5.04behnd.4916/bootloaders/u-boot-2019.07/board/netgear/cg3100d/Kconfig
```kconfig
if BOARD_NETGEAR_CG3100D

config SYS_BOARD
	default "cg3100d"

config SYS_VENDOR
	default "netgear"

config SYS_CONFIG_NAME
	default "netgear_cg3100d"

endif
```

## release/src-rt-5.04behnd.4916/bootloaders/u-boot-2019.07/board/nokia/rx51/Kconfig
```kconfig
if TARGET_NOKIA_RX51

config SYS_BOARD
	default "rx51"

config SYS_VENDOR
	default "nokia"

config SYS_CONFIG_NAME
	default "nokia_rx51"

endif
```

## release/src-rt-5.04behnd.4916/bootloaders/u-boot-2019.07/board/nvidia/beaver/Kconfig
```kconfig
if TARGET_BEAVER

config SYS_BOARD
	default "beaver"

config SYS_VENDOR
	default "nvidia"

config SYS_CONFIG_NAME
	default "beaver"

endif
```

## release/src-rt-5.04behnd.4916/bootloaders/u-boot-2019.07/board/nvidia/cardhu/Kconfig
```kconfig
if TARGET_CARDHU

config SYS_BOARD
	default "cardhu"

config SYS_VENDOR
	default "nvidia"

config SYS_CONFIG_NAME
	default "cardhu"

endif
```

## release/src-rt-5.04behnd.4916/bootloaders/u-boot-2019.07/board/nvidia/jetson-tk1/Kconfig
```kconfig
if TARGET_JETSON_TK1

config SYS_BOARD
	default "jetson-tk1"

config SYS_VENDOR
	default "nvidia"

config SYS_CONFIG_NAME
	default "jetson-tk1"

endif
```

## release/src-rt-5.04behnd.4916/bootloaders/u-boot-2019.07/board/nvidia/p2771-0000/Kconfig
```kconfig
# Copyright (c) 2016, NVIDIA CORPORATION.
#
# SPDX-License-Identifier: GPL-2.0

if TARGET_P2771_0000

config SYS_BOARD
	default "p2771-0000"

config SYS_VENDOR
	default "nvidia"

config SYS_CONFIG_NAME
	default "p2771-0000"

endif
```

## release/src-rt-5.04behnd.4916/bootloaders/u-boot-2019.07/board/olimex/mx23_olinuxino/Kconfig
```kconfig
if TARGET_MX23_OLINUXINO

config SYS_BOARD
	default "mx23_olinuxino"

config SYS_VENDOR
	default "olimex"

config SYS_SOC
	default "mxs"

config SYS_CONFIG_NAME
	default "mx23_olinuxino"

endif
```

## release/src-rt-5.04behnd.4916/bootloaders/u-boot-2019.07/board/phytec/pcm052/Kconfig
```kconfig
if TARGET_PCM052

config SYS_BOARD
	default "pcm052"

config SYS_VENDOR
	default "phytec"

config SYS_CONFIG_NAME
	default "pcm052"

config PCM052_DDR_SIZE
	int
	default 256

endif

if TARGET_BK4R1

config SYS_BOARD
	default "pcm052"

config SYS_VENDOR
	default "phytec"

config SYS_CONFIG_NAME
	default "bk4r1"

config PCM052_DDR_SIZE
	int
	default 512

endif
```

## release/src-rt-5.04behnd.4916/bootloaders/u-boot-2019.07/board/phytec/pfla02/Kconfig
```kconfig
if TARGET_PFLA02

config SYS_BOARD
	default "pfla02"

config SYS_VENDOR
	default "phytec"

config SYS_CONFIG_NAME
	default "pfla02"

config SPL_DRAM_1_BANK
	bool "DRAM on just one bank"
	help
	  activate, if the module has just one bank
	  of RAM

endif
```

## release/src-rt-5.04behnd.4916/bootloaders/u-boot-2019.07/board/ppcag/bg0900/Kconfig
```kconfig
if TARGET_BG0900

config SYS_BOARD
	default "bg0900"

config SYS_VENDOR
	default "ppcag"

config SYS_SOC
	default "mxs"

config SYS_CONFIG_NAME
	default "bg0900"

endif
```

## release/src-rt-5.04behnd.4916/bootloaders/u-boot-2019.07/board/qca/ap121/Kconfig
```kconfig
if TARGET_AP121

config SYS_VENDOR
	default "qca"

config SYS_BOARD
	default "ap121"

config SYS_CONFIG_NAME
	default "ap121"

config SYS_TEXT_BASE
	default 0x9f000000

config SYS_DCACHE_SIZE
	default 32768

config SYS_DCACHE_LINE_SIZE
	default 32

config SYS_ICACHE_SIZE
	default 65536

config SYS_ICACHE_LINE_SIZE
	default 32

endif
```

## release/src-rt-5.04behnd.4916/bootloaders/u-boot-2019.07/board/qca/ap152/Kconfig
```kconfig
if TARGET_AP152

config SYS_VENDOR
	default "qca"

config SYS_BOARD
	default "ap152"

config SYS_CONFIG_NAME
	default "ap152"

config SYS_TEXT_BASE
	default 0x9f000000

endif
```

## release/src-rt-5.04behnd.4916/bootloaders/u-boot-2019.07/board/qemu-mips/Kconfig
```kconfig
if TARGET_QEMU_MIPS

config SYS_BOARD
	default "qemu-mips"

config SYS_CONFIG_NAME
	default "qemu-mips" if 32BIT
	default "qemu-mips64" if 64BIT

config SYS_TEXT_BASE
	default 0xbfc00000 if 32BIT
	default 0xffffffffbfc00000 if 64BIT

config SYS_DCACHE_SIZE
	default 16384

config SYS_DCACHE_LINE_SIZE
	default 32

config SYS_ICACHE_SIZE
	default 16384

config SYS_ICACHE_LINE_SIZE
	default 32

endif
```

## release/src-rt-5.04behnd.4916/bootloaders/u-boot-2019.07/board/qualcomm/dragonboard820c/Kconfig
```kconfig
if TARGET_DRAGONBOARD820C

config SYS_BOARD
	default "dragonboard820c"

config SYS_VENDOR
	default "qualcomm"

config SYS_SOC
	default "apq8096"

config SYS_CONFIG_NAME
	default "dragonboard820c"

endif
```

## release/src-rt-5.04behnd.4916/bootloaders/u-boot-2019.07/board/quipos/cairo/Kconfig
```kconfig
if TARGET_OMAP3_CAIRO

config SYS_BOARD
	default "cairo"

config SYS_VENDOR
	default "quipos"

config SYS_CONFIG_NAME
	default "omap3_cairo"

endif
```

## release/src-rt-5.04behnd.4916/bootloaders/u-boot-2019.07/board/radxa/rock/Kconfig
```kconfig
if TARGET_ROCK

config SYS_BOARD
	default "rock"

config SYS_VENDOR
	default "radxa"

config SYS_CONFIG_NAME
	default "rock"

config BOARD_SPECIFIC_OPTIONS # dummy
	def_bool y

endif
```

## release/src-rt-5.04behnd.4916/bootloaders/u-boot-2019.07/board/raidsonic/ib62x0/Kconfig
```kconfig
if TARGET_IB62X0

config SYS_BOARD
	default "ib62x0"

config SYS_VENDOR
	default "raidsonic"

config SYS_CONFIG_NAME
	default "ib62x0"

endif
```

## release/src-rt-5.04behnd.4916/bootloaders/u-boot-2019.07/board/renesas/alt/Kconfig
```kconfig
if TARGET_ALT

config SYS_BOARD
	default "alt"

config SYS_VENDOR
	default "renesas"

config SYS_CONFIG_NAME
	default "alt"

endif
```

## release/src-rt-5.04behnd.4916/bootloaders/u-boot-2019.07/board/renesas/blanche/Kconfig
```kconfig
if TARGET_BLANCHE

config SYS_BOARD
	default "blanche"

config SYS_VENDOR
	default "renesas"

config SYS_CONFIG_NAME
	default "blanche"

endif
```
