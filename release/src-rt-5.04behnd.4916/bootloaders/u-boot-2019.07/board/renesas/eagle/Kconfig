## release/src-rt-5.04behnd.4916/bootloaders/u-boot-2019.07/board/renesas/eagle/Kconfig
```kconfig
if TARGET_EAGLE

config SYS_SOC
	default "rmobile"

config SYS_BOARD
	default "eagle"

config SYS_VENDOR
	default "renesas"

config SYS_CONFIG_NAME
	default "eagle"

endif
```

## release/src-rt-5.04behnd.4916/bootloaders/u-boot-2019.07/board/renesas/ebisu/Kconfig
```kconfig
if TARGET_EBISU

config SYS_SOC
	default "rmobile"

config SYS_BOARD
	default "ebisu"

config SYS_VENDOR
	default "renesas"

config SYS_CONFIG_NAME
	default "ebisu"

endif
```

## release/src-rt-5.04behnd.4916/bootloaders/u-boot-2019.07/board/renesas/sh7752evb/Kconfig
```kconfig
if TARGET_SH7752EVB

config SYS_BOARD
	default "sh7752evb"

config SYS_VENDOR
	default "renesas"

config SYS_CONFIG_NAME
	default "sh7752evb"

endif
```

## release/src-rt-5.04behnd.4916/bootloaders/u-boot-2019.07/board/renesas/sh7753evb/Kconfig
```kconfig
if TARGET_SH7753EVB

config SYS_BOARD
	default "sh7753evb"

config SYS_VENDOR
	default "renesas"

config SYS_CONFIG_NAME
	default "sh7753evb"

endif
```

## release/src-rt-5.04behnd.4916/bootloaders/u-boot-2019.07/board/renesas/sh7757lcr/Kconfig
```kconfig
if TARGET_SH7757LCR

config SYS_BOARD
	default "sh7757lcr"

config SYS_VENDOR
	default "renesas"

config SYS_CONFIG_NAME
	default "sh7757lcr"

endif
```

## release/src-rt-5.04behnd.4916/bootloaders/u-boot-2019.07/board/renesas/sh7763rdp/Kconfig
```kconfig
if TARGET_SH7763RDP

config SYS_BOARD
	default "sh7763rdp"

config SYS_VENDOR
	default "renesas"

config SYS_CONFIG_NAME
	default "sh7763rdp"

endif
```

## release/src-rt-5.04behnd.4916/bootloaders/u-boot-2019.07/board/renesas/silk/Kconfig
```kconfig
if TARGET_SILK

config SYS_BOARD
	default "silk"

config SYS_VENDOR
	default "renesas"

config SYS_CONFIG_NAME
	default "silk"

endif
```

## release/src-rt-5.04behnd.4916/bootloaders/u-boot-2019.07/board/renesas/ulcb/Kconfig
```kconfig
if TARGET_ULCB

config SYS_SOC
	default "rmobile"

config SYS_BOARD
	default "ulcb"

config SYS_VENDOR
	default "renesas"

config SYS_CONFIG_NAME
	default "ulcb"

endif
```

## release/src-rt-5.04behnd.4916/bootloaders/u-boot-2019.07/board/rockchip/evb_px5/Kconfig
```kconfig
if TARGET_EVB_PX5

config SYS_BOARD
	default "evb_px5"

config SYS_VENDOR
	default "rockchip"

config SYS_CONFIG_NAME
	default "evb_px5"

config BOARD_SPECIFIC_OPTIONS # dummy
	def_bool y

endif
```

## release/src-rt-5.04behnd.4916/bootloaders/u-boot-2019.07/board/rockchip/tinker_rk3288/Kconfig
```kconfig
if TARGET_TINKER_RK3288

config SYS_BOARD
	default "tinker_rk3288"

config SYS_VENDOR
	default "rockchip"

config SYS_CONFIG_NAME
	default "tinker_rk3288"

config BOARD_SPECIFIC_OPTIONS # dummy
	def_bool y

endif
```

## release/src-rt-5.04behnd.4916/bootloaders/u-boot-2019.07/board/ronetix/pm9261/Kconfig
```kconfig
if TARGET_PM9261

config SYS_BOARD
	default "pm9261"

config SYS_VENDOR
	default "ronetix"

config SYS_CONFIG_NAME
	default "pm9261"

endif
```

## release/src-rt-5.04behnd.4916/bootloaders/u-boot-2019.07/board/ronetix/pm9263/Kconfig
```kconfig
if TARGET_PM9263

config SYS_BOARD
	default "pm9263"

config SYS_VENDOR
	default "ronetix"

config SYS_CONFIG_NAME
	default "pm9263"

endif
```

## release/src-rt-5.04behnd.4916/bootloaders/u-boot-2019.07/board/ronetix/pm9g45/Kconfig
```kconfig
if TARGET_PM9G45

config SYS_BOARD
	default "pm9g45"

config SYS_VENDOR
	default "ronetix"

config SYS_CONFIG_NAME
	default "pm9g45"

endif
```

## release/src-rt-5.04behnd.4916/bootloaders/u-boot-2019.07/board/sagem/f@st1704/Kconfig
```kconfig
if BOARD_SAGEM_FAST1704

config SYS_BOARD
	default "f@st1704"

config SYS_VENDOR
	default "sagem"

config SYS_CONFIG_NAME
	default "sagem_f@st1704"

endif
```

## release/src-rt-5.04behnd.4916/bootloaders/u-boot-2019.07/board/samsung/arndale/Kconfig
```kconfig
if TARGET_ARNDALE

config SYS_BOARD
	default "arndale"

config SYS_VENDOR
	default "samsung"

config SYS_CONFIG_NAME
	default "arndale"

endif
```

## release/src-rt-5.04behnd.4916/bootloaders/u-boot-2019.07/board/samsung/odroid/Kconfig
```kconfig
if TARGET_ODROID

config SYS_BOARD
	default "odroid"

config SYS_VENDOR
	default "samsung"

config SYS_CONFIG_NAME
	default "odroid"

endif
```

## release/src-rt-5.04behnd.4916/bootloaders/u-boot-2019.07/board/samsung/smdkv310/Kconfig
```kconfig
if TARGET_SMDKV310

config SYS_BOARD
	default "smdkv310"

config SYS_VENDOR
	default "samsung"

config SYS_CONFIG_NAME
	default "smdkv310"

endif
```

## release/src-rt-5.04behnd.4916/bootloaders/u-boot-2019.07/board/samsung/trats2/Kconfig
```kconfig
if TARGET_TRATS2

config SYS_BOARD
	default "trats2"

config SYS_VENDOR
	default "samsung"

config SYS_CONFIG_NAME
	default "trats2"

endif
```

## release/src-rt-5.04behnd.4916/bootloaders/u-boot-2019.07/board/sandisk/sansa_fuze_plus/Kconfig
```kconfig
if TARGET_SANSA_FUZE_PLUS

config SYS_BOARD
	default "sansa_fuze_plus"

config SYS_VENDOR
	default "sandisk"

config SYS_SOC
	default "mxs"

config SYS_CONFIG_NAME
	default "sansa_fuze_plus"

endif
```

## release/src-rt-5.04behnd.4916/bootloaders/u-boot-2019.07/board/sbc8349/Kconfig
```kconfig
if TARGET_SBC8349

config SYS_BOARD
	default "sbc8349"

config SYS_CONFIG_NAME
	default "sbc8349"

endif
```

## release/src-rt-5.04behnd.4916/bootloaders/u-boot-2019.07/board/sbc8641d/Kconfig
```kconfig
if TARGET_SBC8641D

config SYS_BOARD
	default "sbc8641d"

config SYS_CONFIG_NAME
	default "sbc8641d"

endif
```

## release/src-rt-5.04behnd.4916/bootloaders/u-boot-2019.07/board/schulercontrol/sc_sps_1/Kconfig
```kconfig
if TARGET_SC_SPS_1

config SYS_BOARD
	default "sc_sps_1"

config SYS_VENDOR
	default "schulercontrol"

config SYS_SOC
	default "mxs"

config SYS_CONFIG_NAME
	default "sc_sps_1"

endif
```

## release/src-rt-5.04behnd.4916/bootloaders/u-boot-2019.07/board/seco/Kconfig
```kconfig
if TARGET_SECOMX6

choice
	prompt "SECO i.MX6 Board variant"
	optional

config SECOMX6_Q7
	bool "Q7"

config SECOMX6_UQ7
	bool "uQ7"

config SECOMX6_USBC
	bool "uSBC"

endchoice

choice
	prompt "SECO i.MX6 SoC variant"
	optional

config SECOMX6Q
	bool "i.MX6Q"
	select MX6Q

config SECOMX6DL
	bool "i.MX6DL"
	select MX6DL

config SECOMX6S
	bool "i.MX6S"
	select MX6S

endchoice

choice
	prompt "DDR size"

config SECOMX6_512MB
	bool "512MB"

config SECOMX6_1GB
	bool "1GB"

config SECOMX6_2GB
	bool "2GB"

config SECOMX6_4GB
	bool "4GB"

endchoice

config IMX_CONFIG
	default "board/seco/mx6quq7/mx6quq7-2g.cfg" if SECOMX6_UQ7 && SECOMX6Q && SECOMX6_2GB

config SYS_BOARD
	default "mx6quq7" if SECOMX6_UQ7 && SECOMX6Q

config SYS_VENDOR
	default "seco"

config SYS_CONFIG_NAME
	default "secomx6quq7" if SECOMX6_UQ7 && SECOMX6Q

endif
```

## release/src-rt-5.04behnd.4916/bootloaders/u-boot-2019.07/board/seeed/linkit-smart-7688/Kconfig
```kconfig
if BOARD_LINKIT_SMART_7688

config SYS_BOARD
	default "linkit-smart-7688"

config SYS_VENDOR
	default "seeed"

config SYS_CONFIG_NAME
	default "linkit-smart-7688"

endif
```

## release/src-rt-5.04behnd.4916/bootloaders/u-boot-2019.07/board/sfr/nb4_ser/Kconfig
```kconfig
if BOARD_SFR_NB4_SER

config SYS_BOARD
	default "nb4_ser"

config SYS_VENDOR
	default "sfr"

config SYS_CONFIG_NAME
	default "sfr_nb4_ser"

endif
```
