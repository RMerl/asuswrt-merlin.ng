## release/src-rt-5.04behnd.4916/bootloaders/u-boot-2019.07/board/siemens/rut/Kconfig
```kconfig
if TARGET_RUT

config SYS_BOARD
	default "rut"

config SYS_VENDOR
	default "siemens"

config SYS_SOC
	default "am33xx"

config SYS_CONFIG_NAME
	default "rut"

endif
```

## release/src-rt-5.04behnd.4916/bootloaders/u-boot-2019.07/board/sifive/fu540/Kconfig
```kconfig
if TARGET_SIFIVE_FU540

config SYS_BOARD
	default "fu540"

config SYS_VENDOR
	default "sifive"

config SYS_CPU
	default "generic"

config SYS_CONFIG_NAME
	default "sifive-fu540"

config SYS_TEXT_BASE
	default 0x80000000 if !RISCV_SMODE
	default 0x80200000 if RISCV_SMODE

config BOARD_SPECIFIC_OPTIONS # dummy
	def_bool y
	select GENERIC_RISCV
	imply CMD_DHCP
	imply CMD_EXT2
	imply CMD_EXT4
	imply CMD_FAT
	imply CMD_FS_GENERIC
	imply CMD_NET
	imply CMD_PING
	imply CLK_SIFIVE
	imply CLK_SIFIVE_FU540_PRCI
	imply CLK_SIFIVE_GEMGXL_MGMT
	imply DOS_PARTITION
	imply EFI_PARTITION
	imply IP_DYN
	imply ISO_PARTITION
	imply MACB
	imply MII
	imply NET_RANDOM_ETHADDR
	imply PHY_LIB
	imply PHY_MSCC
	imply SIFIVE_SERIAL
	imply SMP

endif
```

## release/src-rt-5.04behnd.4916/bootloaders/u-boot-2019.07/board/sks-kinkel/sksimx6/Kconfig
```kconfig
if TARGET_SKSIMX6

config SYS_BOARD
	default "sksimx6"

config SYS_VENDOR
	default "sks-kinkel"

config SYS_CONFIG_NAME
	default "sksimx6"
endif
```

## release/src-rt-5.04behnd.4916/bootloaders/u-boot-2019.07/board/socrates/Kconfig
```kconfig
if TARGET_SOCRATES

config SYS_BOARD
	default "socrates"

config SYS_CONFIG_NAME
	default "socrates"

endif
```

## release/src-rt-5.04behnd.4916/bootloaders/u-boot-2019.07/board/spear/spear310/Kconfig
```kconfig
if TARGET_SPEAR310

config SYS_BOARD
	default "spear310"

config SYS_VENDOR
	default "spear"

config SYS_SOC
	default "spear"

config SYS_CONFIG_NAME
	default "spear3xx_evb"

endif
```

## release/src-rt-5.04behnd.4916/bootloaders/u-boot-2019.07/board/spear/spear320/Kconfig
```kconfig
if TARGET_SPEAR320

config SYS_BOARD
	default "spear320"

config SYS_VENDOR
	default "spear"

config SYS_SOC
	default "spear"

config SYS_CONFIG_NAME
	default "spear3xx_evb"

endif
```

## release/src-rt-5.04behnd.4916/bootloaders/u-boot-2019.07/board/spear/spear600/Kconfig
```kconfig
if TARGET_SPEAR600

config SYS_BOARD
	default "spear600"

config SYS_VENDOR
	default "spear"

config SYS_SOC
	default "spear"

config SYS_CONFIG_NAME
	default "spear6xx_evb"

endif
```

## release/src-rt-5.04behnd.4916/bootloaders/u-boot-2019.07/board/st/stm32h743-eval/Kconfig
```kconfig
if TARGET_STM32H743_EVAL

config SYS_BOARD
	string
	default "stm32h743-eval"

config SYS_VENDOR
	string
	default "st"

config SYS_SOC
	string
	default "stm32h7"

config SYS_CONFIG_NAME
	string
	default "stm32h743-eval"

endif
```

## release/src-rt-5.04behnd.4916/bootloaders/u-boot-2019.07/board/st/stm32mp1/Kconfig
```kconfig
if TARGET_STM32MP1

config SYS_BOARD
	default "stm32mp1"

config SYS_VENDOR
	default "st"

config SYS_CONFIG_NAME
	default "stm32mp1"

endif
```

## release/src-rt-5.04behnd.4916/bootloaders/u-boot-2019.07/board/synopsys/Kconfig
```kconfig
if TARGET_NSIM

config SYS_VENDOR
	default "synopsys"

config SYS_CONFIG_NAME
	default "nsim"

endif
```

## release/src-rt-5.04behnd.4916/bootloaders/u-boot-2019.07/board/synopsys/emsdp/Kconfig
```kconfig
if TARGET_EMSDP

config SYS_BOARD
	default "emsdp"

config SYS_VENDOR
	default "synopsys"

config SYS_CONFIG_NAME
	default "emsdp"

endif
```

## release/src-rt-5.04behnd.4916/bootloaders/u-boot-2019.07/board/sysam/stmark2/Kconfig
```kconfig
if TARGET_STMARK2

config SYS_CPU
	default "mcf5445x"

config SYS_BOARD
	default "stmark2"

config SYS_VENDOR
	default "sysam"

config SYS_CONFIG_NAME
	default "stmark2"

endif
```

## release/src-rt-5.04behnd.4916/bootloaders/u-boot-2019.07/board/tcl/sl50/Kconfig
```kconfig
if TARGET_AM335X_SL50

config SYS_BOARD
	default "sl50"

config SYS_VENDOR
	default "tcl"

config SYS_SOC
	default "am33xx"

config SYS_CONFIG_NAME
	default "am335x_sl50"

endif
```

## release/src-rt-5.04behnd.4916/bootloaders/u-boot-2019.07/board/technexion/pico-imx6ul/Kconfig
```kconfig
if TARGET_PICO_IMX6UL

config SYS_BOARD
	default "pico-imx6ul"

config SYS_VENDOR
	default "technexion"

config SYS_SOC
	default "mx6"

config SYS_CONFIG_NAME
	default "pico-imx6ul"

endif
```

## release/src-rt-5.04behnd.4916/bootloaders/u-boot-2019.07/board/technexion/pico-imx7d/Kconfig
```kconfig
if TARGET_PICO_IMX7D

config SYS_BOARD
	default "pico-imx7d"

config SYS_VENDOR
	default "technexion"

config SYS_SOC
	default "mx7"

config SYS_CONFIG_NAME
	default "pico-imx7d"

endif
```

## release/src-rt-5.04behnd.4916/bootloaders/u-boot-2019.07/board/technexion/tao3530/Kconfig
```kconfig
if TARGET_TAO3530

config SYS_BOARD
	default "tao3530"

config SYS_VENDOR
	default "technexion"

config SYS_CONFIG_NAME
	default "tao3530"

endif
```

## release/src-rt-5.04behnd.4916/bootloaders/u-boot-2019.07/board/technologic/ts4600/Kconfig
```kconfig
if TARGET_TS4600

config SYS_BOARD
	default "ts4600"

config SYS_VENDOR
	default "technologic"

config SYS_SOC
	default "mxs"

config SYS_CONFIG_NAME
	default "ts4600"

endif
```

## release/src-rt-5.04behnd.4916/bootloaders/u-boot-2019.07/board/theobroma-systems/lion_rk3368/fit_spl_atf.its
```
/* SPDX-License-Identifier: GPL-2.0+ OR X11 */
/*
 * Copyright (C) 2017 Theobroma Systems Design und Consulting GmbH
 *
 * Minimal dts for a SPL FIT image payload.
 */

/dts-v1/;

/ {
	description = "FIT image with U-Boot proper, ATF bl31, DTB";
	#address-cells = <1>;

	images {
		uboot {
			description = "U-Boot (64-bit)";
			data = /incbin/("../../../u-boot-nodtb.bin");
			type = "standalone";
			os = "U-Boot";
			arch = "arm64";
			compression = "none";
			load = <0x00200000>;
		};
		atf {
			description = "ARM Trusted Firmware";
			data = /incbin/("../../../bl31-rk3368.bin");
			type = "firmware";
			os = "arm-trusted-firmware";
			arch = "arm64";
			compression = "none";
			load = <0x00100000>;
			entry = <0x00100000>;
		};

		fdt {
			description = "RK3368-uQ7 (Lion) flat device-tree";
			data = /incbin/("../../../u-boot.dtb");
			type = "flat_dt";
			compression = "none";
		};
	};

	configurations {
		default = "conf";
		conf {
			description = "Theobroma Systems RK3368-uQ7 (Puma) SoM";
			firmware = "atf";
			loadables = "uboot";
			fdt = "fdt";
		};
	};
};
```

## release/src-rt-5.04behnd.4916/bootloaders/u-boot-2019.07/board/theobroma-systems/puma_rk3399/Kconfig
```kconfig
if TARGET_PUMA_RK3399

config SYS_BOARD
	default "puma_rk3399"

config SYS_VENDOR
	default "theobroma-systems"

config SYS_CONFIG_NAME
	default "puma_rk3399"

config BOARD_SPECIFIC_OPTIONS # dummy
	def_bool y

config ENV_SIZE
	default 0x2000

config ENV_OFFSET
	default 0x3fc000 if ENV_IS_IN_SPI_FLASH

endif
```

## release/src-rt-5.04behnd.4916/bootloaders/u-boot-2019.07/board/ti/am335x/Kconfig
```kconfig
if TARGET_AM335X_EVM

config SYS_BOARD
	default "am335x"

config SYS_VENDOR
	default "ti"

config SYS_SOC
	default "am33xx"

config SYS_CONFIG_NAME
	default "am335x_evm"

config NOR
	bool "Support for NOR flash"
	help
	  The AM335x SoC supports having a NOR flash connected to the GPMC.
	  In practice this is seen as a NOR flash module connected to the
	  "memory cape" for the BeagleBone family.

source "board/ti/common/Kconfig"

endif
```

## release/src-rt-5.04behnd.4916/bootloaders/u-boot-2019.07/board/ti/am3517crane/Kconfig
```kconfig
if TARGET_AM3517_CRANE

config SYS_BOARD
	default "am3517crane"

config SYS_VENDOR
	default "ti"

config SYS_CONFIG_NAME
	default "am3517_crane"

endif
```

## release/src-rt-5.04behnd.4916/bootloaders/u-boot-2019.07/board/ti/am65x/Kconfig
```kconfig
# SPDX-License-Identifier: GPL-2.0+
#
# Copyright (C) 2017-2018 Texas Instruments Incorporated - http://www.ti.com/
#	Lokesh Vutla <lokeshvutla@ti.com>

choice
	prompt "K3 AM65 based boards"
	optional

config TARGET_AM654_A53_EVM
	bool "TI K3 based AM654 EVM running on A53"
	select ARM64
	select SOC_K3_AM6
	select SYS_DISABLE_DCACHE_OPS

config TARGET_AM654_R5_EVM
	bool "TI K3 based AM654 EVM running on R5"
	select CPU_V7R
	select SYS_THUMB_BUILD
	select SOC_K3_AM6
	select K3_AM654_DDRSS
	imply SYS_K3_SPL_ATF

endchoice

if TARGET_AM654_A53_EVM

config SYS_BOARD
       default "am65x"

config SYS_VENDOR
       default "ti"

config SYS_CONFIG_NAME
       default "am65x_evm"

endif

if TARGET_AM654_R5_EVM

config SYS_BOARD
       default "am65x"

config SYS_VENDOR
       default "ti"

config SYS_CONFIG_NAME
       default "am65x_evm"

config SPL_LDSCRIPT
	default "arch/arm/mach-omap2/u-boot-spl.lds"

endif
```

## release/src-rt-5.04behnd.4916/bootloaders/u-boot-2019.07/board/ti/common/Kconfig
```kconfig
config TI_I2C_BOARD_DETECT
	bool "Support for Board detection for TI platforms"
	help
	   Support for detection board information on Texas Instrument's
	   Evaluation Boards which have I2C based EEPROM detection

config EEPROM_BUS_ADDRESS
	int "Board EEPROM's I2C bus address"
	range 0 8
	default 0

config EEPROM_CHIP_ADDRESS
	hex "Board EEPROM's I2C chip address"
	range 0 0xff
	default 0x50

config TI_COMMON_CMD_OPTIONS
	bool "Enable cmd options on TI platforms"
	imply CMD_ASKENV
	imply CMD_BOOTZ
	imply CRC32_VERIFY if ARCH_KEYSTONE
	imply CMD_DFU if USB_GADGET_DOWNLOAD
	imply CMD_DHCP
	imply CMD_EEPROM
	imply CMD_EXT2
	imply CMD_EXT4
	imply CMD_EXT4_WRITE
	imply CMD_FAT
	imply FAT_WRITE if CMD_FAT
	imply CMD_FS_GENERIC
	imply CMD_GPIO
	imply CMD_GPT
	imply CMD_I2C
	imply CMD_MII
	imply CMD_MMC
	imply CMD_PART
	imply CMD_PING
	imply CMD_PMIC if DM_PMIC
	imply CMD_REGULATOR if DM_REGULATOR
	imply CMD_SF if SPI_FLASH
	imply CMD_SPI
	imply CMD_TIME
	imply CMD_USB if USB
```

## release/src-rt-5.04behnd.4916/bootloaders/u-boot-2019.07/board/ti/ks2_evm/Kconfig
```kconfig
if TARGET_K2E_EVM

config SYS_BOARD
	default "ks2_evm"

config SYS_VENDOR
	default "ti"

config SYS_CONFIG_NAME
	default "k2e_evm"

endif

if TARGET_K2HK_EVM

config SYS_BOARD
	default "ks2_evm"

config SYS_VENDOR
	default "ti"

config SYS_CONFIG_NAME
	default "k2hk_evm"

endif

if TARGET_K2L_EVM

config SYS_BOARD
	default "ks2_evm"

config SYS_VENDOR
	default "ti"

config SYS_CONFIG_NAME
	default "k2l_evm"

endif

if TARGET_K2G_EVM

config SYS_BOARD
	default "ks2_evm"

config SYS_VENDOR
	default "ti"

config SYS_CONFIG_NAME
	default "k2g_evm"

endif

source "board/ti/common/Kconfig"
```

## release/src-rt-5.04behnd.4916/bootloaders/u-boot-2019.07/board/ti/omap5_uevm/Kconfig
```kconfig
if TARGET_OMAP5_UEVM

config SYS_BOARD
	default "omap5_uevm"

config SYS_VENDOR
	default "ti"

config SYS_CONFIG_NAME
	default "omap5_uevm"

endif
```
