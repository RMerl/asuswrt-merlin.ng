## release/src-rt-5.04behnd.4916/bootloaders/u-boot-2019.07/board/ti/panda/Kconfig
```kconfig
if TARGET_OMAP4_PANDA

config SYS_BOARD
	default "panda"

config SYS_VENDOR
	default "ti"

config SYS_CONFIG_NAME
	default "omap4_panda"

endif
```

## release/src-rt-5.04behnd.4916/bootloaders/u-boot-2019.07/board/ti/sdp4430/Kconfig
```kconfig
if TARGET_OMAP4_SDP4430

config SYS_BOARD
	default "sdp4430"

config SYS_VENDOR
	default "ti"

config SYS_CONFIG_NAME
	default "omap4_sdp4430"

config CMD_BAT
	bool "Enable board-specific battery command"

endif
```

## release/src-rt-5.04behnd.4916/bootloaders/u-boot-2019.07/board/timll/devkit3250/Kconfig
```kconfig
if TARGET_DEVKIT3250

config SYS_BOARD
	default "devkit3250"

config SYS_VENDOR
	default "timll"

config SYS_CONFIG_NAME
	default "devkit3250"

endif
```

## release/src-rt-5.04behnd.4916/bootloaders/u-boot-2019.07/board/toradex/apalis-tk1/Kconfig
```kconfig
if TARGET_APALIS_TK1

config SYS_BOARD
	default "apalis-tk1"

config SYS_VENDOR
	default "toradex"

config SYS_CONFIG_NAME
	default "apalis-tk1"

config TDX_CFG_BLOCK
	default y

config TDX_HAVE_MMC
	default y

config TDX_CFG_BLOCK_DEV
	default "0"

config TDX_CFG_BLOCK_PART
	default "1"

# Toradex config block in eMMC, at the end of 1st "boot sector"
config TDX_CFG_BLOCK_OFFSET
	default "-512"

config APALIS_TK1_PCIE_EVALBOARD_INIT
	bool "Apalis Evaluation Board PCIe Initialisation"
	help
	  Bring up the Apalis PCIe port with the PCIe switch as found on the
	  Apalis Evaluation board. Note that by default the PCIe port is also
	  left disabled in the device tree which needs changing as well for this
	  to actually work.

source "board/toradex/common/Kconfig"

endif
```

## release/src-rt-5.04behnd.4916/bootloaders/u-boot-2019.07/board/toradex/apalis_t30/Kconfig
```kconfig
if TARGET_APALIS_T30

config SYS_BOARD
	default "apalis_t30"

config SYS_VENDOR
	default "toradex"

config SYS_CONFIG_NAME
	default "apalis_t30"

config TDX_CFG_BLOCK
	default y

config TDX_HAVE_MMC
	default y

config TDX_CFG_BLOCK_DEV
	default "0"

config TDX_CFG_BLOCK_PART
	default "1"

# Toradex config block in eMMC, at the end of 1st "boot sector"
config TDX_CFG_BLOCK_OFFSET
	default "-512"

config APALIS_T30_PCIE_EVALBOARD_INIT
	bool "Apalis Evaluation Board PCIe Initialisation"
	help
	  Bring up the Apalis type specific 4 lane PCIe port as well as the
	  Apalis PCIe port with the PCIe switch as found on the Apalis
	  Evaluation board. Note that by default both those ports are also left
	  disabled in the device tree which needs changing as well for this to
	  actually work.

source "board/toradex/common/Kconfig"

endif
```

## release/src-rt-5.04behnd.4916/bootloaders/u-boot-2019.07/board/toradex/colibri_t20/Kconfig
```kconfig
if TARGET_COLIBRI_T20

config SYS_BOARD
	default "colibri_t20"

config SYS_VENDOR
	default "toradex"

config SYS_CONFIG_NAME
	default "colibri_t20"

config TDX_CFG_BLOCK
	default y

config TDX_HAVE_NAND
	default y

config TDX_CFG_BLOCK_OFFSET
	default "3145728"

source "board/toradex/common/Kconfig"

endif
```

## release/src-rt-5.04behnd.4916/bootloaders/u-boot-2019.07/board/tqc/tqm834x/Kconfig
```kconfig
if TARGET_TQM834X

config SYS_BOARD
	default "tqm834x"

config SYS_VENDOR
	default "tqc"

config SYS_CONFIG_NAME
	default "TQM834x"

endif
```

## release/src-rt-5.04behnd.4916/bootloaders/u-boot-2019.07/board/ucRobotics/bubblegum_96/Kconfig
```kconfig
if TARGET_BUBBLEGUM_96

config SYS_BOARD
	default "bubblegum_96"

config SYS_VENDOR
	default "ucRobotics"

config SYS_SOC
	default "s900"

config SYS_CONFIG_NAME
	default "bubblegum_96"

endif
```

## release/src-rt-5.04behnd.4916/bootloaders/u-boot-2019.07/board/vamrs/rock960_rk3399/Kconfig
```kconfig
if TARGET_ROCK960_RK3399

config SYS_BOARD
	default "rock960_rk3399"

config SYS_VENDOR
	default "vamrs"

config SYS_CONFIG_NAME
	default "rock960_rk3399"

config BOARD_SPECIFIC_OPTIONS # dummy
	def_bool y

endif
```

## release/src-rt-5.04behnd.4916/bootloaders/u-boot-2019.07/board/variscite/dart_6ul/Kconfig
```kconfig
if TARGET_DART_6UL

config SYS_BOARD
	default "dart_6ul"

config SYS_VENDOR
	default "variscite"

config SYS_CONFIG_NAME
	default "dart_6ul"

endif
```

## release/src-rt-5.04behnd.4916/bootloaders/u-boot-2019.07/board/varisys/cyrus/Kconfig
```kconfig
if TARGET_CYRUS_P5020 || TARGET_CYRUS_P5040

config SYS_BOARD
	default "cyrus"

config SYS_VENDOR
	default "varisys"

config SYS_CONFIG_NAME
	default "cyrus"

source "board/freescale/common/Kconfig"

endif
```

## release/src-rt-5.04behnd.4916/bootloaders/u-boot-2019.07/board/ve8313/Kconfig
```kconfig
if TARGET_VE8313

config SYS_BOARD
	default "ve8313"

config SYS_CONFIG_NAME
	default "ve8313"

endif
```

## release/src-rt-5.04behnd.4916/bootloaders/u-boot-2019.07/board/woodburn/Kconfig
```kconfig
if TARGET_WOODBURN

config SYS_BOARD
	default "woodburn"

config SYS_SOC
	default "mx35"

config SYS_CONFIG_NAME
	default "woodburn"

endif

if TARGET_WOODBURN_SD

config SYS_BOARD
	default "woodburn"

config SYS_SOC
	default "mx35"

config SYS_CONFIG_NAME
	default "woodburn_sd"

endif
```

## release/src-rt-5.04behnd.4916/bootloaders/u-boot-2019.07/board/xes/xpedite537x/Kconfig
```kconfig
if TARGET_XPEDITE537X

config SYS_BOARD
	default "xpedite537x"

config SYS_VENDOR
	default "xes"

config SYS_CONFIG_NAME
	default "xpedite537x"

endif
```

## release/src-rt-5.04behnd.4916/bootloaders/u-boot-2019.07/board/xilinx/Kconfig
```kconfig
# SPDX-License-Identifier: GPL-2.0
#
# Copyright (c) 2018, Luca Ceresoli <luca@lucaceresoli.net>

if ARCH_ZYNQ || ARCH_ZYNQMP

config XILINX_PS_INIT_FILE
	string "Zynq/ZynqMP PS init file(s) location"
	help
	  On Zynq and ZynqMP U-Boot SPL (or U-Boot proper if
	  ZYNQMP_PSU_INIT_ENABLED is set) is responsible for some
	  basic initializations, such as enabling peripherals and
	  configuring pinmuxes. The PS init file (called
	  psu_init_gpl.c on ZynqMP, ps7_init_gpl.c for Zynq-7000)
	  contains the code for such initializations.

	  U-Boot contains PS init files for some boards, but each of
	  them describes only one specific configuration. Users of a
	  different board, or needing a different configuration, can
	  generate custom files using the Xilinx development tools.

	  There are three ways to give a PS init file to U-Boot:

	  1. Set this variable to the path, either relative to the
	     source tree or absolute, where the psu_init_gpl.c or
	     ps7_init_gpl.c file is located. U-Boot will build this
	     file.

	  2. If you leave an empty string here, U-Boot will use
	     board/xilinx/zynq/$(CONFIG_DEFAULT_DEVICE_TREE)/ps7_init_gpl.c
	     for Zynq-7000, or
	     board/xilinx/zynqmp/$(CONFIG_DEFAULT_DEVICE_TREE)/psu_init_gpl.c
	     for ZynqMP.

	  3. If the above file does not exist, U-Boot will use
	     board/xilinx/zynq/ps7_init_gpl.c for Zynq-7000, or
	     board/xilinx/zynqmp/psu_init_gpl.c for ZynqMP. This file
	     is not provided by U-Boot, you have to copy it there
	     before the build.

endif
```

## release/src-rt-5.04behnd.4916/bootloaders/u-boot-2019.07/board/xilinx/zynq/Kconfig
```kconfig
# SPDX-License-Identifier: GPL-2.0
#
# Copyright (c) 2018, Xilinx, Inc.

if ARCH_ZYNQ

config CMD_ZYNQ
	bool "Enable Zynq specific commands"
	default y
	help
	  Enables Zynq specific commands.

config CMD_ZYNQ_AES
	bool "Enable zynq aes command for decryption of encrypted images"
	depends on CMD_ZYNQ
	depends on FPGA_ZYNQPL
	help
	  Decrypts the encrypted image present in source address
	  and places the decrypted image at destination address.

config CMD_ZYNQ_RSA
	bool "Enable zynq rsa command for loading secure images"
	default y
	depends on CMD_ZYNQ
	depends on CMD_ZYNQ_AES
	help
	  Enabling this will support zynq secure image verification.
	  The secure image is a xilinx specific BOOT.BIN with
	  either authentication or encryption or both encryption
	  and authentication feature enabled while generating
	  BOOT.BIN using Xilinx bootgen tool.

endif
```

## release/src-rt-5.04behnd.4916/bootloaders/u-boot-2019.07/board/xilinx/zynqmp/Kconfig
```kconfig
# Copyright (c) 2018, Xilinx, Inc.
#
# SPDX-License-Identifier: GPL-2.0

if ARCH_ZYNQMP

config CMD_ZYNQMP
	bool "Enable ZynqMP specific commands"
	default y
	help
	  Enable ZynqMP specific commands like "zynqmp secure"
	  which is used for zynqmp secure image verification.
	  The secure image is a xilinx specific BOOT.BIN with
	  either authentication or encryption or both encryption
	  and authentication feature enabled while generating
	  BOOT.BIN using Xilinx bootgen tool.

endif
```

## release/src-rt-5.04behnd.4916/bootloaders/u-boot-2019.07/cmd/mvebu/Kconfig
```kconfig
menu "MVEBU commands"
depends on ARCH_MVEBU

config CMD_MVEBU_BUBT
	bool "bubt"
	default n
	help
	  bubt - Burn a u-boot image to flash
	  For details about bubt command please see the documentation
	  in doc/mvebu/cmd/bubt.txt

choice
	prompt "Flash for image"
	default MVEBU_SPI_BOOT

config MVEBU_NAND_BOOT
	bool "NAND flash boot"
	depends on NAND_PXA3XX
	help
	  Enable boot from NAND flash.
	  Allow usage of NAND flash as a target for "bubt" command
	  For details about bubt command please see the documentation
	  in doc/mvebu/cmd/bubt.txt

config MVEBU_SPI_BOOT
	bool "SPI flash boot"
	depends on SPI_FLASH
	help
	  Enable boot from SPI flash.
	  Allow usage of SPI flash as a target for "bubt" command
	  For details about bubt command please see the documentation
	  in doc/mvebu/cmd/bubt.txt

config MVEBU_MMC_BOOT
	bool "eMMC flash boot"
	depends on MVEBU_MMC
	help
	  Enable boot from eMMC boot partition
	  Allow usage of eMMC/SD device as a target for "bubt" command
	  For details about bubt command please see the documentation
	  in doc/mvebu/cmd/bubt.txt

endchoice

config MVEBU_UBOOT_DFLT_NAME
	string "Default image name for bubt command"
	default "flash-image.bin"
	help
	  This option should contain a default file name to be used with
	  MVEBU "bubt" command if the source file name is omitted

endmenu
```

## release/src-rt-5.04behnd.4916/bootloaders/u-boot-2019.07/cmd/ti/Kconfig
```kconfig
menu "TI specific command line interface"

config CMD_DDR3
	bool "command for verifying DDR features"
	help
	   Support for testing ddr3 on TI platforms. This command
	   supports memory verification, memory comapre and ecc
	   verification if supported.

endmenu
```

## release/src-rt-5.04behnd.4916/bootloaders/u-boot-2019.07/configs/10m50_defconfig
```kconfig
CONFIG_NIOS2=y
CONFIG_SYS_CONFIG_NAME="10m50_devboard"
CONFIG_NR_DRAM_BANKS=1
CONFIG_FIT=y
CONFIG_SYS_CONSOLE_INFO_QUIET=y
CONFIG_VERSION_VARIABLE=y
CONFIG_DISPLAY_BOARDINFO_LATE=y
CONFIG_HUSH_PARSER=y
# CONFIG_AUTOBOOT is not set
CONFIG_CMD_CPU=y
# CONFIG_CMD_BOOTD is not set
# CONFIG_CMD_XIMG is not set
CONFIG_CMD_GPIO=y
# CONFIG_CMD_ITEST is not set
CONFIG_CMD_DHCP=y
# CONFIG_CMD_NFS is not set
CONFIG_CMD_MII=y
CONFIG_CMD_PING=y
CONFIG_DEFAULT_DEVICE_TREE="10m50_devboard"
CONFIG_ENV_IS_IN_FLASH=y
CONFIG_NET_RANDOM_ETHADDR=y
CONFIG_DM_GPIO=y
CONFIG_ALTERA_PIO=y
CONFIG_MISC=y
CONFIG_ALTERA_SYSID=y
CONFIG_MTD=y
CONFIG_MTD_NOR_FLASH=y
CONFIG_MTD_DEVICE=y
CONFIG_ALTERA_QSPI=y
CONFIG_PHY_MARVELL=y
CONFIG_DM_ETH=y
CONFIG_PHY_GIGE=y
CONFIG_ALTERA_TSE=y
CONFIG_DM_SERIAL=y
CONFIG_SYS_NS16550=y
CONFIG_TIMER=y
CONFIG_ALTERA_TIMER=y
```

## release/src-rt-5.04behnd.4916/bootloaders/u-boot-2019.07/configs/A13-OLinuXino_defconfig
```kconfig
CONFIG_ARM=y
CONFIG_ARCH_SUNXI=y
CONFIG_NR_DRAM_BANKS=1
CONFIG_SPL=y
CONFIG_MACH_SUN5I=y
CONFIG_DRAM_CLK=408
CONFIG_DRAM_EMR1=0
CONFIG_MMC0_CD_PIN="PG0"
CONFIG_USB0_VBUS_DET="PG1"
CONFIG_USB1_VBUS_PIN="PG11"
CONFIG_AXP_GPIO=y
# CONFIG_VIDEO_HDMI is not set
CONFIG_VIDEO_VGA_VIA_LCD=y
CONFIG_VIDEO_VGA_VIA_LCD_FORCE_SYNC_ACTIVE_HIGH=y
CONFIG_VIDEO_LCD_POWER="AXP0-0"
CONFIG_VIDEO_LCD_BL_PWM="PB2"
# CONFIG_SYS_MALLOC_CLEAR_ON_INIT is not set
CONFIG_SPL_TEXT_BASE=0x60
CONFIG_SPL_I2C_SUPPORT=y
CONFIG_CMD_DFU=y
# CONFIG_CMD_FLASH is not set
CONFIG_CMD_USB_MASS_STORAGE=y
# CONFIG_SPL_DOS_PARTITION is not set
# CONFIG_SPL_PARTITION_UUIDS is not set
CONFIG_DEFAULT_DEVICE_TREE="sun5i-a13-olinuxino"
CONFIG_DFU_RAM=y
CONFIG_FASTBOOT_CMD_OEM_FORMAT=y
CONFIG_AXP_ALDO3_VOLT=3300
CONFIG_CONS_INDEX=2
CONFIG_USB_EHCI_HCD=y
CONFIG_USB_OHCI_HCD=y
CONFIG_USB_MUSB_GADGET=y
CONFIG_SYS_USB_EVENT_POLL_VIA_INT_QUEUE=y
```

## release/src-rt-5.04behnd.4916/bootloaders/u-boot-2019.07/configs/A20-OLinuXino-Lime2_defconfig
```kconfig
CONFIG_ARM=y
CONFIG_ARCH_SUNXI=y
CONFIG_NR_DRAM_BANKS=1
CONFIG_SPL=y
CONFIG_MACH_SUN7I=y
CONFIG_DRAM_CLK=384
CONFIG_MMC0_CD_PIN="PH1"
CONFIG_USB0_VBUS_PIN="PC17"
CONFIG_USB0_VBUS_DET="PH5"
CONFIG_I2C1_ENABLE=y
CONFIG_SATAPWR="PC3"
CONFIG_AHCI=y
# CONFIG_SYS_MALLOC_CLEAR_ON_INIT is not set
CONFIG_SPL_TEXT_BASE=0x60
CONFIG_SPL_I2C_SUPPORT=y
CONFIG_CMD_DFU=y
# CONFIG_CMD_FLASH is not set
CONFIG_CMD_USB_MASS_STORAGE=y
# CONFIG_SPL_DOS_PARTITION is not set
# CONFIG_SPL_PARTITION_UUIDS is not set
CONFIG_DEFAULT_DEVICE_TREE="sun7i-a20-olinuxino-lime2"
CONFIG_SCSI_AHCI=y
CONFIG_DFU_RAM=y
CONFIG_FASTBOOT_CMD_OEM_FORMAT=y
CONFIG_ETH_DESIGNWARE=y
CONFIG_RGMII=y
CONFIG_MII=y
CONFIG_SUN7I_GMAC=y
CONFIG_AXP_ALDO3_VOLT=2800
CONFIG_AXP_ALDO3_VOLT_SLOPE_08=y
CONFIG_AXP_ALDO3_INRUSH_QUIRK=y
CONFIG_AXP_ALDO4_VOLT=2800
CONFIG_SCSI=y
CONFIG_USB_EHCI_HCD=y
CONFIG_USB_OHCI_HCD=y
CONFIG_USB_MUSB_GADGET=y
CONFIG_SYS_USB_EVENT_POLL_VIA_INT_QUEUE=y
```

## release/src-rt-5.04behnd.4916/bootloaders/u-boot-2019.07/configs/A20-Olimex-SOM204-EVB-eMMC_defconfig
```kconfig
CONFIG_ARM=y
CONFIG_ARCH_SUNXI=y
CONFIG_NR_DRAM_BANKS=1
CONFIG_SPL=y
CONFIG_MACH_SUN7I=y
CONFIG_DRAM_CLK=384
CONFIG_MMC0_CD_PIN="PH1"
CONFIG_MMC_SUNXI_SLOT_EXTRA=2
CONFIG_USB0_VBUS_PIN="PC17"
CONFIG_USB0_VBUS_DET="PH5"
CONFIG_I2C1_ENABLE=y
CONFIG_SATAPWR="PC3"
CONFIG_GMAC_TX_DELAY=4
CONFIG_AHCI=y
# CONFIG_SYS_MALLOC_CLEAR_ON_INIT is not set
CONFIG_SPL_TEXT_BASE=0x60
CONFIG_SPL_I2C_SUPPORT=y
# CONFIG_CMD_FLASH is not set
# CONFIG_SPL_DOS_PARTITION is not set
# CONFIG_SPL_PARTITION_UUIDS is not set
CONFIG_DEFAULT_DEVICE_TREE="sun7i-a20-olimex-som204-evb-emmc"
CONFIG_SCSI_AHCI=y
CONFIG_FASTBOOT_CMD_OEM_FORMAT=y
CONFIG_PHY_ADDR=3
CONFIG_PHY_MICREL=y
CONFIG_PHY_MICREL_KSZ90X1=y
CONFIG_ETH_DESIGNWARE=y
CONFIG_RGMII=y
CONFIG_MII=y
CONFIG_SUN7I_GMAC=y
CONFIG_AXP_ALDO3_VOLT=2800
CONFIG_AXP_ALDO4_VOLT=2800
CONFIG_SCSI=y
CONFIG_USB_EHCI_HCD=y
CONFIG_USB_OHCI_HCD=y
CONFIG_USB_MUSB_GADGET=y
CONFIG_SYS_USB_EVENT_POLL_VIA_INT_QUEUE=y
```

## release/src-rt-5.04behnd.4916/bootloaders/u-boot-2019.07/configs/Auxtek-T004_defconfig
```kconfig
CONFIG_ARM=y
CONFIG_ARCH_SUNXI=y
CONFIG_NR_DRAM_BANKS=1
CONFIG_SPL=y
CONFIG_MACH_SUN5I=y
CONFIG_DRAM_CLK=432
CONFIG_USB1_VBUS_PIN="PG13"
# CONFIG_SYS_MALLOC_CLEAR_ON_INIT is not set
CONFIG_SPL_TEXT_BASE=0x60
CONFIG_SPL_I2C_SUPPORT=y
# CONFIG_CMD_FLASH is not set
# CONFIG_SPL_DOS_PARTITION is not set
# CONFIG_SPL_EFI_PARTITION is not set
CONFIG_DEFAULT_DEVICE_TREE="sun5i-a10s-auxtek-t004"
CONFIG_AXP152_POWER=y
CONFIG_CONS_INDEX=2
CONFIG_USB_EHCI_HCD=y
CONFIG_USB_OHCI_HCD=y
CONFIG_SYS_USB_EVENT_POLL_VIA_INT_QUEUE=y
```

## release/src-rt-5.04behnd.4916/bootloaders/u-boot-2019.07/configs/Bananapi_m2m_defconfig
```kconfig
CONFIG_ARM=y
CONFIG_ARCH_SUNXI=y
CONFIG_NR_DRAM_BANKS=1
CONFIG_SPL=y
CONFIG_MACH_SUN8I_A33=y
CONFIG_DRAM_CLK=600
CONFIG_DRAM_ZQ=15291
CONFIG_DRAM_ODT_EN=y
CONFIG_MMC0_CD_PIN="PB4"
CONFIG_MMC_SUNXI_SLOT_EXTRA=2
CONFIG_USB0_ID_DET="PH8"
# CONFIG_SYS_MALLOC_CLEAR_ON_INIT is not set
CONFIG_SPL_TEXT_BASE=0x60
# CONFIG_CMD_FLASH is not set
# CONFIG_SPL_DOS_PARTITION is not set
# CONFIG_SPL_PARTITION_UUIDS is not set
CONFIG_DEFAULT_DEVICE_TREE="sun8i-r16-bananapi-m2m"
CONFIG_FASTBOOT_CMD_OEM_FORMAT=y
CONFIG_USB_EHCI_HCD=y
CONFIG_USB_OHCI_HCD=y
CONFIG_USB_MUSB_GADGET=y
CONFIG_USB_FUNCTION_MASS_STORAGE=y
```
