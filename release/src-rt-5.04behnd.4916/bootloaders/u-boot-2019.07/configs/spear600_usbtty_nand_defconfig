## release/src-rt-5.04behnd.4916/bootloaders/u-boot-2019.07/configs/tmp_emmc__bcm96765_defconfig
```kconfig
CONFIG_ENV_IS_IN_BOOT_MAGIC=y

CONFIG_DEFAULT_DEVICE_TREE="bcm96765"

CONFIG_SPL_LIBGENERIC_SUPPORT=y

CONFIG_SPI_FLASH=y

# CONFIG_SPL_LIBDISK_SUPPORT is not set

CONFIG_SERIAL_SEARCH_ALL=y

CONFIG_USB_STORAGE=y

CONFIG_SPL_SYS_MALLOC_F_LEN=0x2000

CONFIG_BCMBCA_DDRC=y

CONFIG_PINCTRL_BCMBCA=y

CONFIG_TARGET_BCM96765=y

# CONFIG_SPL_FS_EXT4 is not set

CONFIG_SPL_STANDALONE=y

CONFIG_LED_BLINK=y

CONFIG_HUSH_PARSER=y

CONFIG_CMD_CACHE=y

CONFIG_SUPPORT_RAW_INITRD=y

CONFIG_USB_OHCI_BCMBCA=y

CONFIG_DISPLAY_BOARDINFO_LATE=y

CONFIG_BCM6765=y

CONFIG_NR_DRAM_BANKS=2

CONFIG_SPECIFY_CONSOLE_INDEX=y

CONFIG_USB_OHCI_HCD=y

CONFIG_SYS_TEXT_BASE=0x01000000

CONFIG_TPL_ENV_SUPPORT=y

CONFIG_PANIC_HANG=y

CONFIG_SPL_LIBCOMMON_SUPPORT=y

# CONFIG_TPL_NAND_SUPPORT is not set

CONFIG_USB_EHCI_HCD=y

CONFIG_SPL_SERIAL_SUPPORT=y

CONFIG_USB_HOST_ETHER=y

CONFIG_SPL_TEXT_BASE=0x90200000

# CONFIG_MTD is not set

CONFIG_BCMBCA_DDR_LOADADDR=0x90280000

CONFIG_CMD_SF=y

# CONFIG_CMD_MMC is not set

CONFIG_SPL_WATCHDOG_SUPPORT=y

CONFIG_FIT=y

CONFIG_BCMBCA_DDR4=y

# CONFIG_NAND_BRCMNAND is not set

CONFIG_BCM_BOOTSTATE=y

CONFIG_FIT_VERBOSE=y

CONFIG_CLK=y

CONFIG_TPL_SERIAL_SUPPORT=y

CONFIG_SUPPORT_EMMC_BOOT=y

CONFIG_SYSRESET_WATCHDOG=y

CONFIG_SPL=y

CONFIG_IMAGE_FORMAT_LEGACY=y

CONFIG_RNG_BCMBCA_TRNG=y

CONFIG_SPI_FLASH_MTD=y

CONFIG_TPL_SYS_MALLOC_SIMPLE=y

# CONFIG_CMD_PART is not set

CONFIG_TPL=y

CONFIG_TPL_ATF=y

# CONFIG_EFI_LOADER is not set

CONFIG_TPL_CLK=y

CONFIG_TPL_NEEDS_SEPARATE_TEXT_BASE=y

CONFIG_BCM_PHY_BLACKFIN_B0=y

CONFIG_CMD_GPIO=y

CONFIG_BCMBCA_HTTPD=n

CONFIG_ARM=y

CONFIG_DM_SERIAL=y

CONFIG_OF_SYSTEM_SETUP=y

CONFIG_CMD_WDT=y

# CONFIG_SPL_NAND_SUPPORT is not set

CONFIG_LOG=y

CONFIG_PL01X_SERIAL=y

CONFIG_USB=y

CONFIG_BCMBCA_DPFE=y

CONFIG_SYSRESET=y

# CONFIG_CMD_UBI is not set

CONFIG_BCM_SELECTIVE_PHYS=y

CONFIG_ARCH_BCMBCA=y

CONFIG_TPL_MAX_SIZE=1048576

CONFIG_TPL_SYS_MALLOC_F_LEN=0x80000

CONFIG_CMD_SPI=y

CONFIG_SPL_CLK=y

CONFIG_CMD_SF_TEST=y

# CONFIG_CMD_NAND is not set

CONFIG_DM_MMC=y

CONFIG_TFTP_BLOCKSIZE=1024

# CONFIG_GENERATE_SMBIOS_TABLE is not set

# CONFIG_CMD_MTD is not set

CONFIG_FIT_ENABLE_RSASSA_PSS_SUPPORT=y

CONFIG_BOOT_BLOB_JTAG_LOAD_MAX_DDR_SIZE=0xa000

CONFIG_CMD_RNG=y

CONFIG_TPL_SPI_FLASH_SUPPORT=y

CONFIG_MMC_SDHCI=y

CONFIG_TPL_LIBGENERIC_SUPPORT=y

CONFIG_BCMBCA_BOARD_SPECIFIC_DT=y

CONFIG_DM_RNG=y

CONFIG_DM_SPI_FLASH=y

CONFIG_TPL_LIBCOMMON_SUPPORT=y

CONFIG_TPL_TEXT_BASE=0x05000000

CONFIG_MISC=y

CONFIG_DM_ETH=y

CONFIG_PINCTRL=y

# CONFIG_MMC_WRITE is not set

CONFIG_SPL_SIZE_LIMIT=327680

# CONFIG_PARTITIONS is not set

# CONFIG_CMD_FLASH is not set

CONFIG_SPL_MMC_SUPPORT=y

CONFIG_PARTITION_TYPE_GUID=y

# CONFIG_NAND is not set

CONFIG_SPI_FLASH_MACRONIX=y

CONFIG_CMD_USB=y

CONFIG_BCM_PHY_XPHY=y

CONFIG_FIT_SIGNATURE=y

CONFIG_MMC_SDHCI_BCMBCA=y

# CONFIG_MMC_VERBOSE is not set

CONFIG_SYS_MALLOC_F_LEN=0x8000

# CONFIG_MMC_HW_PARTITIONING is not set

CONFIG_BOARD_LATE_INIT=y

CONFIG_MTD_SPI_NAND=y

# CONFIG_SYS_MMCSD_RAW_MODE_U_BOOT_USE_PARTITION is not set

CONFIG_USB_EHCI_BCMBCA=y

CONFIG_UBI_SILENCE_MSG=y

# CONFIG_CMD_GPT is not set

# CONFIG_CMD_MTDPARTS is not set

CONFIG_TPL_DM=y

CONFIG_SPL_ENV_SUPPORT=y

CONFIG_SPL_SYS_MALLOC_SIMPLE=y

CONFIG_DM_USB=y

CONFIG_ENV_VARS_UBOOT_CONFIG=y

CONFIG_TPL_MMC_SUPPORT=y

CONFIG_CMD_FS_GENERIC=y

CONFIG_CMD_GPT_RENAME=y

CONFIG_WDT_BCM6345=y

CONFIG_CONS_INDEX=0

CONFIG_CMD_PING=y

CONFIG_TPL_LDSCRIPT="arch/arm/cpu/armv8/u-boot.lds"

CONFIG_BCMBCA_LPDDR4=y
```

## release/src-rt-5.04behnd.4916/bootloaders/u-boot-2019.07/configs/tmp_nand__bcm96764_defconfig
```kconfig
CONFIG_IMAGE_FORMAT_LEGACY=y

CONFIG_LZMA=y

CONFIG_TPL_SYS_MALLOC_F_LEN=0x80000

CONFIG_LOG=y

CONFIG_NR_DRAM_BANKS=2

CONFIG_NAND=y

CONFIG_SPL=y

# CONFIG_GENERATE_SMBIOS_TABLE is not set

CONFIG_BCMBCA_DPFE=y

CONFIG_CMD_GPIO=y

CONFIG_USB=y

CONFIG_BCM_SELECTIVE_PHYS=y

CONFIG_TPL_ATF=y

CONFIG_SPECIFY_CONSOLE_INDEX=y

CONFIG_BCMBCA_BOARD_SPECIFIC_DT=y

CONFIG_SPL_LIBGENERIC_SUPPORT=y

CONFIG_SYSRESET=y

CONFIG_CMD_SPI=y

CONFIG_BOOT_BLOB_JTAG_LOAD_MAX_DDR_SIZE=0xa000

CONFIG_PINCTRL=y

CONFIG_DM_SPI_FLASH=y

CONFIG_SPL_LIBCOMMON_SUPPORT=y

CONFIG_ARCH_BCMBCA=y

CONFIG_ARM=y

CONFIG_HUSH_PARSER=y

# CONFIG_SPL_LIBDISK_SUPPORT is not set

CONFIG_WDT_BCM6345=y

# CONFIG_CMD_MMC is not set

CONFIG_USB_OHCI_BCMBCA=y

CONFIG_CMD_SF_TEST=y

CONFIG_CMD_UBI=y

CONFIG_CMD_MTDPARTS=y

CONFIG_SPL_NAND_SUPPORT=y

CONFIG_TPL_DM=y

CONFIG_FIT=y

CONFIG_CMD_NAND=y

CONFIG_ENV_VARS_UBOOT_CONFIG=y

CONFIG_CMD_RNG=y

CONFIG_NAND_BRCMNAND=y

CONFIG_SYSRESET_WATCHDOG=y

CONFIG_TARGET_BCM96764=y

CONFIG_CMD_FS_GENERIC=y

# CONFIG_MMC_SDHCI_BCMBCA is not set

# CONFIG_MMC_SDHCI is not set

CONFIG_SUPPORT_RAW_INITRD=y

CONFIG_TPL_LDSCRIPT="arch/arm/cpu/armv7/u-boot.lds"

CONFIG_ARMV7_LPAE=y

CONFIG_MISC=y

CONFIG_DM_SERIAL=y

CONFIG_SPI_FLASH_MTD=y

CONFIG_TPL_SYS_MALLOC_SIMPLE=y

CONFIG_SPL_SYS_MALLOC_SIMPLE=y

CONFIG_TPL_TEXT_BASE=0x05000000

CONFIG_MTD_SPI_NAND=y

CONFIG_OF_SYSTEM_SETUP=y

CONFIG_CMD_PING=y

CONFIG_PANIC_HANG=y

CONFIG_SPL_SERIAL_SUPPORT=y

CONFIG_SPI_FLASH_MACRONIX=y

CONFIG_TPL_LIBCOMMON_SUPPORT=y

CONFIG_DM_USB=y

CONFIG_DM_ETH=y

CONFIG_TPL=y

CONFIG_SPL_WATCHDOG_SUPPORT=y

# CONFIG_PARTITION_TYPE_GUID is not set

CONFIG_LED_BLINK=y

CONFIG_PHYS_64BIT=y

# CONFIG_SPL_FS_EXT4 is not set

CONFIG_SPL_SYS_MALLOC_F_LEN=0x2000

CONFIG_RNG_BCMBCA_TRNG=y

CONFIG_CMD_WDT=y

CONFIG_USB_STORAGE=y

# CONFIG_SUPPORT_EMMC_BOOT is not set

CONFIG_TPL_MAX_SIZE=1048576

CONFIG_TFTP_BLOCKSIZE=1024

CONFIG_BCMBCA_DDR_LOADADDR=0x90260000

CONFIG_SPL_CLK=y

CONFIG_SPI_FLASH=y

CONFIG_TPL_CLK=y

CONFIG_SERIAL_SEARCH_ALL=y

# CONFIG_SYS_MMCSD_RAW_MODE_U_BOOT_USE_PARTITION is not set

# CONFIG_MMC is not set

CONFIG_CMD_SF=y

CONFIG_MTD=y

CONFIG_SPL_STANDALONE=y

CONFIG_SPL_TEXT_BASE=0x90200000

# CONFIG_CMD_GPT_RENAME is not set

CONFIG_SPL_ENV_SUPPORT=y

CONFIG_USB_EHCI_HCD=y

CONFIG_TPL_NEEDS_SEPARATE_TEXT_BASE=y

CONFIG_USB_EHCI_BCMBCA=y

CONFIG_TPL_ENV_SUPPORT=y

# CONFIG_DM_MMC is not set

CONFIG_BCMBCA_HTTPD=n

CONFIG_DISPLAY_BOARDINFO_LATE=y

CONFIG_TPL_NAND_SUPPORT=y

CONFIG_BOARD_LATE_INIT=y

CONFIG_SPL_SIZE_LIMIT=327680

CONFIG_USB_HOST_ETHER=y

CONFIG_BCM_PHY_BLACKFIN_B0=y

# CONFIG_CMD_GPT is not set

CONFIG_BCM6764=y

CONFIG_DM_RNG=y

CONFIG_USB_OHCI_HCD=y

CONFIG_ENV_IS_IN_BOOT_MAGIC=y

CONFIG_BCM_PHY_LANAI_A0=y

# CONFIG_SPL_MMC_SUPPORT is not set

CONFIG_FIT_VERBOSE=y

# CONFIG_EFI_PARTITION is not set

CONFIG_TPL_LIBGENERIC_SUPPORT=y

# CONFIG_CMD_FLASH is not set

CONFIG_CONS_INDEX=0

CONFIG_FIT_ENABLE_RSASSA_PSS_SUPPORT=y

CONFIG_UBI_SILENCE_MSG=y

CONFIG_CLK=y

CONFIG_PL01X_SERIAL=y

CONFIG_CMD_MTD=y

CONFIG_FIT_SIGNATURE=y

CONFIG_PINCTRL_BCMBCA=y

CONFIG_BCMBCA_DDRC=y

CONFIG_CMD_USB=y

# CONFIG_TPL_MMC_SUPPORT is not set

CONFIG_DEFAULT_DEVICE_TREE="bcm96764"

CONFIG_TPL_SPI_FLASH_SUPPORT=y

CONFIG_CMD_CACHE=y

CONFIG_SYS_TEXT_BASE=0x01000000

CONFIG_TPL_SERIAL_SUPPORT=y

# CONFIG_CMD_PART is not set

CONFIG_BCM_BOOTSTATE=y

CONFIG_SYS_MALLOC_F_LEN=0x8000

CONFIG_BCMBCA_DDR4=y
```

## release/src-rt-5.04behnd.4916/bootloaders/u-boot-2019.07/configs/tools-only_defconfig
```kconfig
CONFIG_SYS_TEXT_BASE=0
CONFIG_ANDROID_BOOT_IMAGE=y
CONFIG_FIT=y
CONFIG_FIT_SIGNATURE=y
# CONFIG_CMD_BOOTD is not set
# CONFIG_CMD_BOOTM is not set
# CONFIG_CMD_ELF is not set
# CONFIG_CMD_DATE is not set
CONFIG_OF_CONTROL=y
CONFIG_OF_HOSTFILE=y
CONFIG_DEFAULT_DEVICE_TREE="sandbox"
CONFIG_IP_DEFRAG=y
# CONFIG_UDP_FUNCTION_FASTBOOT is not set
CONFIG_SANDBOX_GPIO=y
CONFIG_DM_I2C_COMPAT=y
CONFIG_PCI=y
CONFIG_DM_PCI=y
CONFIG_PCI_SANDBOX=y
CONFIG_DM_RTC=y
CONFIG_SOUND=y
CONFIG_SYSRESET=y
# CONFIG_VIRTIO_MMIO is not set
# CONFIG_VIRTIO_PCI is not set
# CONFIG_VIRTIO_SANDBOX is not set
# CONFIG_EFI_LOADER is not set
```

## release/src-rt-5.04behnd.4916/bootloaders/u-boot-2019.07/configs/topic_miamiplus_defconfig
```kconfig
CONFIG_ARM=y
CONFIG_SYS_VENDOR="topic"
CONFIG_SYS_CONFIG_NAME="topic_miami"
CONFIG_SPL_SYS_DCACHE_OFF=y
CONFIG_ARCH_ZYNQ=y
CONFIG_SYS_TEXT_BASE=0x4000000
CONFIG_SPL_STACK_R_ADDR=0x200000
CONFIG_SPL=y
CONFIG_DEBUG_UART_BASE=0xe0000000
CONFIG_DEBUG_UART_CLOCK=100000000
CONFIG_BOOT_INIT_FILE="board/topic/zynq/zynq-topic-miamiplus/ps7_regs.txt"
CONFIG_DEBUG_UART=y
CONFIG_DISTRO_DEFAULTS=y
CONFIG_SYS_CUSTOM_LDSCRIPT=y
CONFIG_SYS_LDSCRIPT="arch/arm/mach-zynq/u-boot.lds"
CONFIG_BOOTDELAY=0
CONFIG_SPL_STACK_R=y
CONFIG_SPL_SPI_LOAD=y
CONFIG_SYS_PROMPT="zynq-uboot> "
CONFIG_CMD_THOR_DOWNLOAD=y
CONFIG_CMD_MEMTEST=y
CONFIG_CMD_DFU=y
# CONFIG_CMD_FLASH is not set
CONFIG_CMD_GPIO=y
CONFIG_CMD_I2C=y
CONFIG_CMD_MMC=y
CONFIG_CMD_SF=y
CONFIG_CMD_USB=y
# CONFIG_CMD_SETEXPR is not set
CONFIG_CMD_CACHE=y
CONFIG_OF_EMBED=y
CONFIG_DEFAULT_DEVICE_TREE="zynq-topic-miamiplus"
CONFIG_SPL_DM_SEQ_ALIAS=y
CONFIG_DFU_RAM=y
CONFIG_FPGA_XILINX=y
CONFIG_FPGA_ZYNQPL=y
CONFIG_DM_GPIO=y
CONFIG_DM_I2C=y
CONFIG_SYS_I2C_CADENCE=y
CONFIG_MMC_SDHCI=y
CONFIG_MMC_SDHCI_ZYNQ=y
CONFIG_SPI_FLASH=y
CONFIG_SF_DEFAULT_MODE=0
CONFIG_SF_DEFAULT_SPEED=108000000
CONFIG_SPI_FLASH_STMICRO=y
# CONFIG_SPI_FLASH_USE_4K_SECTORS is not set
# CONFIG_NETDEVICES is not set
CONFIG_DEBUG_UART_ZYNQ=y
CONFIG_ZYNQ_SERIAL=y
CONFIG_ZYNQ_QSPI=y
CONFIG_USB=y
CONFIG_USB_EHCI_HCD=y
CONFIG_USB_ULPI_VIEWPORT=y
CONFIG_USB_ULPI=y
CONFIG_USB_GADGET=y
CONFIG_USB_GADGET_MANUFACTURER="Xilinx"
CONFIG_USB_GADGET_VENDOR_NUM=0x03fd
CONFIG_USB_GADGET_PRODUCT_NUM=0x0300
CONFIG_CI_UDC=y
CONFIG_USB_GADGET_DOWNLOAD=y
CONFIG_USB_FUNCTION_THOR=y
```

## release/src-rt-5.04behnd.4916/bootloaders/u-boot-2019.07/configs/tqma6dl_mba6_spi_defconfig
```kconfig
CONFIG_ARM=y
CONFIG_ARCH_MX6=y
CONFIG_SYS_TEXT_BASE=0x4fc00000
CONFIG_TARGET_TQMA6=y
CONFIG_TQMA6DL=y
CONFIG_TQMA6X_SPI_BOOT=y
CONFIG_NR_DRAM_BANKS=1
CONFIG_FIT=y
CONFIG_FIT_VERBOSE=y
CONFIG_OF_BOARD_SETUP=y
CONFIG_BOOTDELAY=3
CONFIG_SUPPORT_RAW_INITRD=y
CONFIG_DEFAULT_FDT_FILE="imx6dl-mba6x.dtb"
CONFIG_BOUNCE_BUFFER=y
CONFIG_BOARD_EARLY_INIT_F=y
CONFIG_HUSH_PARSER=y
CONFIG_CMD_BOOTZ=y
CONFIG_CMD_EEPROM=y
# CONFIG_CMD_FLASH is not set
CONFIG_CMD_GPIO=y
CONFIG_CMD_I2C=y
CONFIG_CMD_MMC=y
CONFIG_CMD_SF=y
CONFIG_CMD_SPI=y
CONFIG_CMD_USB=y
CONFIG_CMD_DHCP=y
CONFIG_CMD_MII=y
CONFIG_CMD_PING=y
CONFIG_CMD_CACHE=y
CONFIG_CMD_EXT2=y
CONFIG_CMD_EXT4=y
CONFIG_CMD_EXT4_WRITE=y
CONFIG_CMD_FAT=y
CONFIG_CMD_FS_GENERIC=y
CONFIG_ENV_IS_IN_SPI_FLASH=y
CONFIG_FSL_ESDHC=y
CONFIG_SPI_FLASH=y
CONFIG_SF_DEFAULT_MODE=0
CONFIG_SF_DEFAULT_SPEED=50000000
CONFIG_SPI_FLASH_STMICRO=y
CONFIG_PHYLIB=y
CONFIG_PHY_MICREL=y
CONFIG_PHY_MICREL_KSZ90X1=y
CONFIG_MII=y
CONFIG_SPI=y
CONFIG_MXC_SPI=y
CONFIG_USB=y
CONFIG_USB_STORAGE=y
CONFIG_USB_HOST_ETHER=y
CONFIG_USB_ETHER_SMSC95XX=y
CONFIG_OF_LIBFDT=y
```

## release/src-rt-5.04behnd.4916/bootloaders/u-boot-2019.07/configs/tqma6s_wru4_mmc_defconfig
```kconfig
CONFIG_ARM=y
CONFIG_ARCH_MX6=y
CONFIG_SYS_TEXT_BASE=0x2fc00000
CONFIG_TARGET_TQMA6=y
CONFIG_TQMA6S=y
CONFIG_WRU4=y
CONFIG_NR_DRAM_BANKS=1
CONFIG_SYS_BOOTCOUNT_ADDR=0x00900000
CONFIG_FIT=y
CONFIG_FIT_VERBOSE=y
CONFIG_OF_BOARD_SETUP=y
CONFIG_BOOTDELAY=3
CONFIG_SUPPORT_RAW_INITRD=y
CONFIG_DEFAULT_FDT_FILE="imx6s-wru4.dtb"
CONFIG_MISC_INIT_R=y
CONFIG_BOUNCE_BUFFER=y
CONFIG_BOARD_EARLY_INIT_F=y
CONFIG_HUSH_PARSER=y
CONFIG_AUTOBOOT_KEYED=y
CONFIG_AUTOBOOT_PROMPT="Enter password in %d seconds to stop autoboot\n"
CONFIG_AUTOBOOT_ENCRYPTION=y
CONFIG_AUTOBOOT_STOP_STR_SHA256="36a9e7f1c95b82ffb99743e0c5c4ce95d83c9a430aac59f84ef3cbfab6145068"
CONFIG_CMD_BOOTZ=y
CONFIG_CMD_EEPROM=y
CONFIG_CMD_GPIO=y
CONFIG_CMD_I2C=y
CONFIG_CMD_MMC=y
CONFIG_CMD_USB=y
CONFIG_CMD_DHCP=y
CONFIG_CMD_MII=y
CONFIG_CMD_PING=y
CONFIG_CMD_CACHE=y
CONFIG_CMD_DATE=y
CONFIG_CMD_EXT2=y
CONFIG_CMD_EXT4=y
CONFIG_CMD_EXT4_WRITE=y
CONFIG_CMD_FAT=y
CONFIG_CMD_FS_GENERIC=y
CONFIG_ENV_IS_IN_MMC=y
CONFIG_BOOTCOUNT_LIMIT=y
CONFIG_LED_STATUS=y
CONFIG_LED_STATUS0=y
CONFIG_LED_STATUS_BIT=0
CONFIG_LED_STATUS_STATE=2
CONFIG_LED_STATUS1=y
CONFIG_LED_STATUS_BIT1=1
CONFIG_LED_STATUS_STATE1=2
CONFIG_LED_STATUS2=y
CONFIG_LED_STATUS_BIT2=2
CONFIG_LED_STATUS_STATE2=2
CONFIG_LED_STATUS3=y
CONFIG_LED_STATUS_BIT3=3
CONFIG_LED_STATUS_STATE3=2
CONFIG_LED_STATUS4=y
CONFIG_LED_STATUS_BIT4=4
CONFIG_LED_STATUS_STATE4=2
CONFIG_LED_STATUS5=y
CONFIG_LED_STATUS_BIT5=5
CONFIG_LED_STATUS_STATE5=2
CONFIG_LED_STATUS_CMD=y
CONFIG_PCA9551_LED=y
CONFIG_FSL_ESDHC=y
CONFIG_PHYLIB=y
CONFIG_MII=y
CONFIG_USB=y
CONFIG_USB_STORAGE=y
CONFIG_USB_HOST_ETHER=y
CONFIG_USB_ETHER_SMSC95XX=y
CONFIG_IMX_WATCHDOG=y
CONFIG_OF_LIBFDT=y
```

## release/src-rt-5.04behnd.4916/bootloaders/u-boot-2019.07/configs/trats_defconfig
```kconfig
CONFIG_ARM=y
CONFIG_ARCH_EXYNOS=y
CONFIG_SYS_TEXT_BASE=0x63300000
CONFIG_ARCH_EXYNOS4=y
CONFIG_TARGET_TRATS=y
CONFIG_DISTRO_DEFAULTS=y
CONFIG_FIT=y
CONFIG_FIT_VERBOSE=y
CONFIG_USE_BOOTARGS=y
CONFIG_BOOTARGS="Please use defined boot"
# CONFIG_USE_BOOTCOMMAND is not set
CONFIG_SYS_CONSOLE_IS_IN_ENV=y
CONFIG_SYS_CONSOLE_INFO_QUIET=y
CONFIG_MISC_INIT_R=y
CONFIG_SYS_PROMPT="Trats # "
# CONFIG_CMD_XIMG is not set
CONFIG_CMD_THOR_DOWNLOAD=y
CONFIG_CMD_DFU=y
CONFIG_CMD_GPT=y
CONFIG_CMD_I2C=y
CONFIG_CMD_MMC=y
CONFIG_CMD_USB_MASS_STORAGE=y
# CONFIG_CMD_NET is not set
CONFIG_CMD_CACHE=y
# CONFIG_CMD_MISC is not set
CONFIG_CMD_EXT4_WRITE=y
CONFIG_OF_CONTROL=y
CONFIG_DEFAULT_DEVICE_TREE="exynos4210-trats"
CONFIG_ENV_VARS_UBOOT_RUNTIME_CONFIG=y
CONFIG_DFU_MMC=y
CONFIG_DM_I2C_GPIO=y
CONFIG_SYS_I2C_S3C24X0=y
CONFIG_MMC_DW=y
CONFIG_MMC_SDHCI=y
CONFIG_MMC_SDHCI_SDMA=y
CONFIG_MMC_SDHCI_S5P=y
CONFIG_DM_PMIC=y
CONFIG_PMIC_MAX8997=y
CONFIG_USB=y
CONFIG_DM_USB=y
CONFIG_USB_GADGET=y
CONFIG_USB_GADGET_MANUFACTURER="Samsung"
CONFIG_USB_GADGET_VENDOR_NUM=0x04e8
CONFIG_USB_GADGET_PRODUCT_NUM=0x6601
CONFIG_USB_GADGET_DWC2_OTG=y
CONFIG_USB_GADGET_DOWNLOAD=y
CONFIG_USB_FUNCTION_THOR=y
CONFIG_LIB_HW_RAND=y
```

## release/src-rt-5.04behnd.4916/bootloaders/u-boot-2019.07/configs/trimslice_defconfig
```kconfig
CONFIG_ARM=y
CONFIG_TEGRA=y
CONFIG_SYS_TEXT_BASE=0x00110000
CONFIG_NR_DRAM_BANKS=2
CONFIG_TEGRA20=y
CONFIG_TARGET_TRIMSLICE=y
CONFIG_OF_SYSTEM_SETUP=y
CONFIG_CONSOLE_MUX=y
CONFIG_SYS_STDIO_DEREGISTER=y
CONFIG_SPL_TEXT_BASE=0x00108000
CONFIG_SYS_PROMPT="Tegra20 (TrimSlice) # "
# CONFIG_CMD_IMI is not set
# CONFIG_CMD_FLASH is not set
CONFIG_CMD_GPIO=y
CONFIG_CMD_I2C=y
CONFIG_CMD_MMC=y
CONFIG_CMD_PCI=y
CONFIG_CMD_SF=y
CONFIG_CMD_SPI=y
CONFIG_CMD_USB=y
# CONFIG_CMD_SETEXPR is not set
# CONFIG_CMD_NFS is not set
CONFIG_CMD_EXT4_WRITE=y
# CONFIG_SPL_DOS_PARTITION is not set
# CONFIG_SPL_EFI_PARTITION is not set
CONFIG_DEFAULT_DEVICE_TREE="tegra20-trimslice"
CONFIG_ENV_IS_IN_SPI_FLASH=y
CONFIG_USE_ENV_SPI_MAX_HZ=y
CONFIG_ENV_SPI_MAX_HZ=48000000
CONFIG_SPL_DM=y
CONFIG_SYS_I2C_TEGRA=y
CONFIG_SPI_FLASH=y
CONFIG_SF_DEFAULT_MODE=0
CONFIG_SPI_FLASH_WINBOND=y
CONFIG_RTL8169=y
CONFIG_PCI=y
CONFIG_DM_PCI=y
CONFIG_DM_PCI_COMPAT=y
CONFIG_PCI_TEGRA=y
CONFIG_SYS_NS16550=y
CONFIG_TEGRA20_SFLASH=y
CONFIG_USB=y
CONFIG_DM_USB=y
CONFIG_USB_EHCI_HCD=y
CONFIG_USB_EHCI_TEGRA=y
CONFIG_USB_HOST_ETHER=y
CONFIG_USB_ETHER_ASIX=y
```

## release/src-rt-5.04behnd.4916/bootloaders/u-boot-2019.07/configs/ts4600_defconfig
```kconfig
CONFIG_ARM=y
CONFIG_ARCH_MX28=y
CONFIG_SYS_TEXT_BASE=0x40002000
CONFIG_SPL_LIBCOMMON_SUPPORT=y
CONFIG_SPL_LIBGENERIC_SUPPORT=y
CONFIG_TARGET_TS4600=y
CONFIG_NR_DRAM_BANKS=1
CONFIG_SPL=y
CONFIG_FIT=y
CONFIG_SYS_CONSOLE_IS_IN_ENV=y
# CONFIG_DISPLAY_CPUINFO is not set
CONFIG_ARCH_MISC_INIT=y
CONFIG_BOARD_EARLY_INIT_F=y
# CONFIG_SPL_FRAMEWORK is not set
CONFIG_SPL_TEXT_BASE=0x00001000
CONFIG_HUSH_PARSER=y
CONFIG_CMD_BOOTZ=y
# CONFIG_CMD_FLASH is not set
CONFIG_CMD_MMC=y
CONFIG_CMD_EXT4=y
CONFIG_CMD_EXT4_WRITE=y
CONFIG_CMD_FAT=y
CONFIG_CMD_FS_GENERIC=y
CONFIG_ENV_IS_IN_MMC=y
CONFIG_MMC_MXS=y
CONFIG_CONS_INDEX=0
CONFIG_OF_LIBFDT=y
```
