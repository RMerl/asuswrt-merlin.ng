## release/src-rt-5.04behnd.4916/bootloaders/u-boot-2019.07/configs/xpress_defconfig
```kconfig
CONFIG_ARM=y
CONFIG_ARCH_MX6=y
CONFIG_SYS_TEXT_BASE=0x87800000
CONFIG_TARGET_XPRESS=y
CONFIG_NR_DRAM_BANKS=1
CONFIG_SYS_EXTRA_OPTIONS="IMX_CONFIG=board/ccv/xpress/imximage.cfg"
CONFIG_BOOTDELAY=3
CONFIG_SYS_CONSOLE_INFO_QUIET=y
CONFIG_SUPPORT_RAW_INITRD=y
CONFIG_BOUNCE_BUFFER=y
CONFIG_BOARD_EARLY_INIT_F=y
CONFIG_HUSH_PARSER=y
CONFIG_CMD_BOOTZ=y
CONFIG_CMD_MEMTEST=y
CONFIG_CMD_I2C=y
CONFIG_CMD_MMC=y
CONFIG_CMD_USB=y
CONFIG_CMD_DHCP=y
CONFIG_CMD_MII=y
CONFIG_CMD_PING=y
CONFIG_CMD_CACHE=y
CONFIG_CMD_EXT2=y
CONFIG_CMD_EXT4=y
CONFIG_CMD_EXT4_WRITE=y
CONFIG_CMD_FAT=y
CONFIG_CMD_FS_GENERIC=y
CONFIG_ENV_IS_IN_MMC=y
CONFIG_SUPPORT_EMMC_BOOT=y
CONFIG_FSL_ESDHC=y
CONFIG_PHYLIB=y
CONFIG_MII=y
CONFIG_USB=y
CONFIG_USB_STORAGE=y
CONFIG_OF_LIBFDT=y
```

## release/src-rt-5.04behnd.4916/bootloaders/u-boot-2019.07/configs/zc5202_defconfig
```kconfig
CONFIG_ARM=y
CONFIG_ARCH_MX6=y
CONFIG_SYS_TEXT_BASE=0x17800000
CONFIG_SPL_GPIO_SUPPORT=y
CONFIG_SPL_LIBCOMMON_SUPPORT=y
CONFIG_SPL_LIBGENERIC_SUPPORT=y
CONFIG_TARGET_ZC5202=y
CONFIG_SPL_MMC_SUPPORT=y
CONFIG_SPL_SERIAL_SUPPORT=y
CONFIG_NR_DRAM_BANKS=1
CONFIG_SPL=y
CONFIG_SPL_LIBDISK_SUPPORT=y
CONFIG_SPL_SPI_FLASH_SUPPORT=y
CONFIG_SPL_SPI_SUPPORT=y
CONFIG_DISTRO_DEFAULTS=y
CONFIG_SYS_EXTRA_OPTIONS="IMX_CONFIG=arch/arm/mach-imx/spl_sd.cfg,MX6Q"
CONFIG_BOOTDELAY=3
CONFIG_BOOTCOMMAND="run findfdt; run distro_bootcmd"
CONFIG_DEFAULT_FDT_FILE="imx6q-zc5202.dtb"
CONFIG_BOUNCE_BUFFER=y
CONFIG_BOARD_EARLY_INIT_F=y
CONFIG_SPL_TEXT_BASE=0x00908000
CONFIG_SPL_FS_EXT4=y
CONFIG_SPL_I2C_SUPPORT=y
CONFIG_SPL_SPI_LOAD=y
CONFIG_SPL_WATCHDOG_SUPPORT=y
CONFIG_CMD_MEMTEST=y
CONFIG_CMD_GPIO=y
CONFIG_CMD_I2C=y
CONFIG_CMD_MMC=y
CONFIG_CMD_PCI=y
CONFIG_CMD_SF=y
CONFIG_CMD_CACHE=y
CONFIG_CMD_EXT4_WRITE=y
CONFIG_ENV_IS_IN_MMC=y
CONFIG_ENV_VARS_UBOOT_RUNTIME_CONFIG=y
CONFIG_SUPPORT_EMMC_BOOT=y
CONFIG_FSL_ESDHC=y
CONFIG_SPI_FLASH=y
CONFIG_SF_DEFAULT_BUS=3
CONFIG_SF_DEFAULT_MODE=0
CONFIG_SF_DEFAULT_SPEED=20000000
CONFIG_SPI_FLASH_STMICRO=y
CONFIG_MII=y
CONFIG_PCI=y
CONFIG_SPI=y
CONFIG_MXC_SPI=y
CONFIG_OF_LIBFDT=y
```

## release/src-rt-5.04behnd.4916/bootloaders/u-boot-2019.07/configs/zynq_cc108_defconfig
```kconfig
CONFIG_ARM=y
CONFIG_SPL_SYS_DCACHE_OFF=y
CONFIG_ARCH_ZYNQ=y
CONFIG_SYS_TEXT_BASE=0x4000000
CONFIG_SPL_STACK_R_ADDR=0x200000
CONFIG_SPL=y
CONFIG_DEBUG_UART_BASE=0xe0000000
CONFIG_DEBUG_UART_CLOCK=50000000
CONFIG_DEBUG_UART=y
CONFIG_DISTRO_DEFAULTS=y
CONFIG_SYS_CUSTOM_LDSCRIPT=y
CONFIG_SYS_LDSCRIPT="arch/arm/mach-zynq/u-boot.lds"
CONFIG_FIT=y
CONFIG_FIT_SIGNATURE=y
CONFIG_FIT_VERBOSE=y
CONFIG_IMAGE_FORMAT_LEGACY=y
CONFIG_SPL_STACK_R=y
CONFIG_SPL_SPI_LOAD=y
CONFIG_SYS_PROMPT="Zynq> "
CONFIG_CMD_DFU=y
# CONFIG_CMD_FLASH is not set
CONFIG_CMD_GPIO=y
CONFIG_CMD_MMC=y
CONFIG_CMD_SF=y
CONFIG_CMD_USB=y
# CONFIG_CMD_SETEXPR is not set
CONFIG_CMD_TFTPPUT=y
CONFIG_CMD_CACHE=y
CONFIG_CMD_EXT4_WRITE=y
CONFIG_DEFAULT_DEVICE_TREE="zynq-cc108"
CONFIG_NET_RANDOM_ETHADDR=y
CONFIG_SPL_DM_SEQ_ALIAS=y
CONFIG_FPGA_XILINX=y
CONFIG_FPGA_ZYNQPL=y
CONFIG_DM_GPIO=y
CONFIG_MMC_SDHCI=y
CONFIG_MMC_SDHCI_ZYNQ=y
CONFIG_SPI_FLASH=y
CONFIG_SF_DEFAULT_SPEED=30000000
CONFIG_SPI_FLASH_ISSI=y
CONFIG_SPI_FLASH_MACRONIX=y
CONFIG_SPI_FLASH_SPANSION=y
CONFIG_SPI_FLASH_STMICRO=y
CONFIG_SPI_FLASH_WINBOND=y
CONFIG_PHY_MARVELL=y
CONFIG_PHY_REALTEK=y
CONFIG_PHY_XILINX=y
CONFIG_MII=y
CONFIG_ZYNQ_GEM=y
CONFIG_DEBUG_UART_ZYNQ=y
CONFIG_DEBUG_UART_ANNOUNCE=y
CONFIG_ZYNQ_SERIAL=y
CONFIG_ZYNQ_QSPI=y
CONFIG_USB=y
CONFIG_USB_EHCI_HCD=y
CONFIG_USB_ULPI_VIEWPORT=y
CONFIG_USB_ULPI=y
CONFIG_USB_GADGET=y
CONFIG_CI_UDC=y
CONFIG_USB_GADGET_DOWNLOAD=y
CONFIG_USB_FUNCTION_THOR=y
```

## release/src-rt-5.04behnd.4916/bootloaders/u-boot-2019.07/doc/chromium/nyan-big.its
```
/dts-v1/;

/ {
	description = "U-Boot mainline";
	#address-cells = <1>;

	images {
		kernel {
			description = "U-Boot mainline    ";
			type = "kernel_noload";
			arch = "arm";
			os = "linux";
			data = /incbin/("../.././b/nyan-big/u-boot.bin");
			compression = "none";
			load = <0>;
			entry = <0>;
			hash-2 {
				algo = "sha1";
			};
		};

		fdt-1{
			description = "tegra124-nyan-big.dtb";
			data = /incbin/("../.././b/nyan-big/u-boot.dtb");
			type = "flat_dt";
			arch = "arm";
			compression = "none";
			hash-1{
				algo = "sha1";
			};
		};
	};

	configurations {
		default = "config-1";
		config-1 {
			description = "Boot U-Boot";
			kernel = "kernel";
			fdt = "fdt-1";
		};
	};
};
```

## release/src-rt-5.04behnd.4916/bootloaders/u-boot-2019.07/doc/uImage.FIT/kernel.its
```
/*
 * Simple U-Boot uImage source file containing a single kernel
 */

/dts-v1/;

/ {
	description = "Simple image with single Linux kernel";
	#address-cells = <1>;

	images {
		kernel {
			description = "Vanilla Linux kernel";
			data = /incbin/("./vmlinux.bin.gz");
			type = "kernel";
			arch = "ppc";
			os = "linux";
			compression = "gzip";
			load = <00000000>;
			entry = <00000000>;
			hash-1 {
				algo = "crc32";
			};
			hash-2 {
				algo = "sha1";
			};
		};
	};

	configurations {
		default = "config-1";
		config-1 {
			description = "Boot Linux kernel";
			kernel = "kernel";
		};
	};
};



For x86 a setup node is also required: see x86-fit-boot.txt.

/dts-v1/;

/ {
	description = "Simple image with single Linux kernel on x86";
	#address-cells = <1>;

	images {
		kernel {
			description = "Vanilla Linux kernel";
			data = /incbin/("./image.bin.lzo");
			type = "kernel";
			arch = "x86";
			os = "linux";
			compression = "lzo";
			load = <0x01000000>;
			entry = <0x00000000>;
			hash-2 {
				algo = "sha1";
			};
		};

		setup {
			description = "Linux setup.bin";
			data = /incbin/("./setup.bin");
			type = "x86_setup";
			arch = "x86";
			os = "linux";
			compression = "none";
			load = <0x00090000>;
			entry = <0x00090000>;
			hash-2 {
				algo = "sha1";
			};
		};
	};

	configurations {
		default = "config-1";
		config-1 {
			description = "Boot Linux kernel";
			kernel = "kernel";
			setup = "setup";
		};
	};
};

Note: the above assumes a 32-bit kernel. To directly boot a 64-bit kernel,
change both arch values to "x86_64". U-Boot will then change to 64-bit mode
before booting the kernel (see boot_linux_kernel()).
```

## release/src-rt-5.04behnd.4916/bootloaders/u-boot-2019.07/doc/uImage.FIT/multi-with-loadables.its
```
/*
 * U-Boot uImage source file with multiple kernels, ramdisks and FDT blobs
 * This example makes use of the 'loadables' field
 */

/dts-v1/;

/ {
	description = "Configuration to load a Xen Kernel";
	#address-cells = <1>;

	images {
		xen_kernel {
			description = "xen binary";
			data = /incbin/("./xen");
			type = "kernel";
			arch = "arm";
			os = "linux";
			compression = "none";
			load = <0xa0000000>;
			entry = <0xa0000000>;
			hash-1 {
				algo = "md5";
			};
		};

		fdt-1 {
			description = "xexpress-ca15 tree blob";
			data = /incbin/("./vexpress-v2p-ca15-tc1.dtb");
			type = "flat_dt";
			arch = "arm";
			compression = "none";
			load = <0xb0000000>;
			hash-1 {
				algo = "md5";
			};
		};

		fdt-2 {
			description = "xexpress-ca15 tree blob";
			data = /incbin/("./vexpress-v2p-ca15-tc1.dtb");
			type = "flat_dt";
			arch = "arm";
			compression = "none";
			load = <0xb0400000>;
			hash-1 {
				algo = "md5";
			};
		};

		linux_kernel {
			description = "Linux Image";
			data = /incbin/("./Image");
			type = "kernel";
			arch = "arm";
			os = "linux";
			compression = "none";
			load = <0xa0000000>;
			entry = <0xa0000000>;
			hash-1 {
				algo = "md5";
			};
		};
	};

	configurations {
		default = "config-2";

		config-1 {
			description = "Just plain Linux";
			kernel = "linux_kernel";
			fdt = "fdt-1";
		};

		config-2 {
			description = "Xen one loadable";
			kernel = "xen_kernel";
			fdt = "fdt-1";
			loadables = "linux_kernel";
		};

		config-3 {
			description = "Xen two loadables";
			kernel = "xen_kernel";
			fdt = "fdt-1";
			loadables = "linux_kernel", "fdt-2";
		};
	};
};
```

## release/src-rt-5.04behnd.4916/bootloaders/u-boot-2019.07/doc/uImage.FIT/sec_firmware_ppa.its
```
/dts-v1/;

/*
 * Example FIT image description file demonstrating the usage
 * of SEC Firmware and multiple loadable images loaded by the u-boot.
 * For booting PPA (SEC Firmware), "firmware" is searched and loaded.
 *
 * Multiple binaries will be loaded as "loadables" (if present) at their
 * respective load offsets from firmware image address.
 */

/{
	description = "PPA Firmware";
	#address-cells = <1>;
	images {
		firmware@1 {
			description = "PPA Firmware: <version>";
			data = /incbin/("../obj/monitor.bin");
			type = "firmware";
			arch = "arm64";
			compression = "none";
		};
		trustedOS@1 {
			description = "Trusted OS";
			data = /incbin/("../../tee.bin");
			type = "OS";
			arch = "arm64";
			compression = "none";
			load = <0x00200000>;
		};
		fuse_scr {
			description = "Fuse Script";
			data = /incbin/("../../fuse_scr.bin");
			type = "firmware";
			arch = "arm64";
			compression = "none";
			load = <0x00180000>;
		};
	};

	configurations {
		default = "config-1";
		config-1 {
			description = "PPA Secure firmware";
			firmware = "firmware@1";
			loadables = "trustedOS@1", "fuse_scr";
		};
	};
};
```

## release/src-rt-5.04behnd.4916/bootloaders/u-boot-2019.07/doc/uImage.FIT/update_uboot.its
```
/*
 * Automatic software update for U-Boot
 * Make sure the flashing addresses ('load' prop) is correct for your board!
 */

/dts-v1/;

/ {
	description = "Automatic U-Boot update";
	#address-cells = <1>;

	images {
		update-1 {
			description = "U-Boot binary";
			data = /incbin/("./u-boot.bin");
			compression = "none";
			type = "firmware";
			load = <FFFC0000>;
			hash-1 {
				algo = "sha1";
			};
		};
	};
};
```

## release/src-rt-5.04behnd.4916/bootloaders/u-boot-2019.07/drivers/axi/Kconfig
```kconfig
menuconfig AXI
	bool "AXI bus drivers"
	help
	  Support AXI (Advanced eXtensible Interface) busses, a on-chip
	  interconnect specification for managing functional blocks in SoC
	  designs, which is also often used in designs involving FPGAs (e.g.
	  communication with IP cores in Xilinx FPGAs).

	  These types of busses expose a virtual address space that can be
	  accessed using different address widths (8, 16, and 32 are supported
	  for now).

	  Other similar bus architectures may be compatible as well.

if AXI

config IHS_AXI
	bool "Enable IHS AXI driver"
	depends on DM
	help
	  Support for gdsys Integrated Hardware Systems Advanced eXtensible
	  Interface (IHS AXI) bus on a gdsys IHS FPGA used to communicate with
	  IP cores in the FPGA (e.g. video transmitter cores).

config AXI_SANDBOX
	bool "Enable AXI sandbox driver"
	depends on DM
	help
	  Support AXI (Advanced eXtensible Interface) emulation for the sandbox
	  environment.

endif
```

## release/src-rt-5.04behnd.4916/bootloaders/u-boot-2019.07/drivers/block/Kconfig
```kconfig
config BLK
	bool "Support block devices"
	depends on DM
	default y if DM_MMC
	help
	  Enable support for block devices, such as SCSI, MMC and USB
	  flash sticks. These provide a block-level interface which permits
	  reading, writing and (in some cases) erasing blocks. Block
	  devices often have a partition table which allows the device to
	  be partitioned into several areas, called 'partitions' in U-Boot.
	  A filesystem can be placed in each partition.

config HAVE_BLOCK_DEVICE
	bool "Enable Legacy Block Device"
	help
	  Some devices require block support whether or not DM is enabled

config SPL_BLK
	bool "Support block devices in SPL"
	depends on SPL_DM && BLK
	default y
	help
	  Enable support for block devices, such as SCSI, MMC and USB
	  flash sticks. These provide a block-level interface which permits
	  reading, writing and (in some cases) erasing blocks. Block
	  devices often have a partition table which allows the device to
	  be partitioned into several areas, called 'partitions' in U-Boot.
	  A filesystem can be placed in each partition.

config TPL_BLK
	bool "Support block devices in TPL"
	depends on TPL_DM && BLK
	default y
	help
	  Enable support for block devices, such as SCSI, MMC and USB
	  flash sticks. These provide a block-level interface which permits
	  reading, writing and (in some cases) erasing blocks. Block
	  devices often have a partition table which allows the device to
	  be partitioned into several areas, called 'partitions' in U-Boot.
	  A filesystem can be placed in each partition.

config BLOCK_CACHE
	bool "Use block device cache"
	depends on BLK
	default y
	help
	  This option enables a disk-block cache for all block devices.
	  This is most useful when accessing filesystems under U-Boot since
	  it will prevent repeated reads from directory structures and other
	  filesystem data structures.

config SPL_BLOCK_CACHE
	bool "Use block device cache in SPL"
	depends on SPL_BLK
	default n
	help
	  This option enables the disk-block cache in SPL

config IDE
	bool "Support IDE controllers"
	select HAVE_BLOCK_DEVICE
	help
	  Enables support for IDE (Integrated Drive Electronics) hard drives.
	  This allows access to raw blocks and filesystems on an IDE drive
	  from U-Boot. See also CMD_IDE which provides an 'ide' command for
	  performing various IDE operations.
```

## release/src-rt-5.04behnd.4916/bootloaders/u-boot-2019.07/drivers/clk/at91/Kconfig
```kconfig
config CLK_AT91
	bool "AT91 clock drivers"
	depends on CLK
	select MISC
	help
	  This option is used to enable the AT91 clock driver.
	  The driver supports the AT91 clock generator, including
	  the oscillators and PLLs, such as main clock, slow clock,
	  PLLA, UTMI PLL. Clocks can also be a source clock of other
	  clocks a tree structure, such as master clock, usb device
	  clock, matrix clock and generic clock.
	  Devices can use a common clock API to request a particular
	  clock, enable it and get its rate.

config AT91_UTMI
	bool "Support UTMI PLL Clock"
	depends on CLK_AT91
	select REGMAP
	select SPL_REGMAP if SPL_DM
	select SYSCON
	select SPL_SYSCON if SPL_DM
	help
	  This option is used to enable the AT91 UTMI PLL clock
	  driver. It is the clock provider of USB, and UPLLCK is the
	  output of 480 MHz UTMI PLL, The souce clock of the UTMI
	  PLL is the main clock, so the main clock must select the
	  fast crystal oscillator to meet the frequency accuracy
	  required by USB.

config AT91_USB_CLK
	bool "Support USB OHCI Input Clock"
	depends on CLK_AT91
	help
	  This option is used to enable the USB Input Clock, from
	  the device tree, configure the USBS bit (PLLA or UTMI PLL)
	  and USBDIV field of the PMC_USB register.

config AT91_H32MX
	bool "Support H32MX 32-bit Matrix Clock"
	depends on CLK_AT91
	help
	  This option is used to enable the AT91 H32MX matrixes
	  clock driver. There are H64MX and H32MX matrixes clocks,
	  H64MX 64-bit matrix clocks are MCK. The H32MX 32-bit
	  matrix clock is to be configured as MCK if MCK does not
	  exceed 83 MHz, else it is to be configured as MCK/2.

config AT91_GENERIC_CLK
	bool "Support Generic Clock"
	depends on CLK_AT91
	help
	  This option is used to enable the AT91 generic clock
	  driver. Some peripherals may need a second clock source
	  that may be different from the system clock. This second
	  clock is the generic clock (GCLK) and is managed by
	  the PMC via PMC_PCR register.
```

## release/src-rt-5.04behnd.4916/bootloaders/u-boot-2019.07/drivers/clk/imx/Kconfig
```kconfig
config CLK_IMX8
	bool "Clock support for i.MX8"
	depends on ARCH_IMX8
	select CLK
	help
	  This enables support clock driver for i.MX8 platforms.
```

## release/src-rt-5.04behnd.4916/bootloaders/u-boot-2019.07/drivers/clk/mvebu/Kconfig
```kconfig
config CLK_MVEBU
	bool "MVEBU clock drivers"
	depends on CLK && ARCH_MVEBU
	help
	  Enable support for clock present on Marvell MVEBU SoCs.

config CLK_ARMADA_3720
	bool "Marvell Armada 3720 clock driver"
	depends on CLK_MVEBU && ARM64
	help
	  Enable this to support the clocks on Marvell Armada 3720 SoC.
```
