## release/src-rt-5.04behnd.4916/bootloaders/u-boot-2019.07/drivers/fpga/Kconfig
```kconfig
menu "FPGA support"

config FPGA
	bool

config FPGA_ALTERA
	bool "Enable Altera FPGA drivers"
	select FPGA
	help
	  Say Y here to enable the Altera FPGA driver

	  This provides basic infrastructure to support Altera FPGA devices.
	  Enable Altera FPGA specific functions which includes bitstream
	  (in BIT format), fpga and device validation.

config FPGA_SOCFPGA
	bool "Enable Gen5 and Arria10 common FPGA drivers"
	select FPGA_ALTERA
	help
	  Say Y here to enable the Gen5 and Arria10 common FPGA driver

	  This provides common functionality for Gen5 and Arria10 devices.

config FPGA_CYCLON2
	bool "Enable Altera FPGA driver for Cyclone II"
	depends on FPGA_ALTERA
	help
	  Say Y here to enable the Altera Cyclone II FPGA specific driver

	  This provides common functionality for Altera Cyclone II devices.
	  Enable FPGA driver for loading bitstream in BIT and BIN format
	  on Altera Cyclone II device.

config FPGA_STRATIX10
	bool "Enable Altera FPGA driver for Stratix 10"
	depends on TARGET_SOCFPGA_STRATIX10
	select FPGA_ALTERA
	help
	  Say Y here to enable the Altera Stratix 10 FPGA specific driver

	  This provides common functionality for Altera Stratix 10 devices.
	  Enable FPGA driver for writing bitstream into Altera Stratix10
	  device.

config FPGA_XILINX
	bool "Enable Xilinx FPGA drivers"
	select FPGA
	help
	  Enable Xilinx FPGA specific functions which includes bitstream
	  (in BIT format), fpga and device validation.

config FPGA_ZYNQMPPL
	bool "Enable Xilinx FPGA driver for ZynqMP"
	depends on FPGA_XILINX
	help
	  Enable FPGA driver for loading bitstream in BIT and BIN format
	  on Xilinx Zynq UltraScale+ (ZynqMP) device.

config FPGA_SPARTAN3
	bool "Enable Spartan3 FPGA driver"
	help
	  Enable Spartan3 FPGA driver for loading in BIT format.

config FPGA_ZYNQPL
	bool "Enable Xilinx FPGA for Zynq"
	depends on ARCH_ZYNQ
	help
	  Enable FPGA driver for loading bitstream in BIT and BIN format
	  on Xilinx Zynq devices.

endmenu
```

## release/src-rt-5.04behnd.4916/bootloaders/u-boot-2019.07/drivers/hwspinlock/Kconfig
```kconfig
menu "Hardware Spinlock Support"

config DM_HWSPINLOCK
	bool "Enable U-Boot hardware spinlock support"
	help
	  This option enables U-Boot hardware spinlock support

config HWSPINLOCK_SANDBOX
	bool "Enable Hardware Spinlock support for Sandbox"
	depends on SANDBOX && DM_HWSPINLOCK
	help
	  Enable hardware spinlock support in Sandbox. This is a dummy device that
	  can be probed and support all the methods of HWSPINLOCK, but does not
	  really do anything.

config HWSPINLOCK_STM32
	bool "Enable Hardware Spinlock support for STM32"
	depends on ARCH_STM32MP && DM_HWSPINLOCK
	help
	  Enable hardware spinlock support in STM32MP. Hardware spinlocks are
	  hardware mutex which provide a synchronisation mechanism for the
	  various processors on the SoC.

endmenu
```

## release/src-rt-5.04behnd.4916/bootloaders/u-boot-2019.07/drivers/i2c/muxes/Kconfig
```kconfig
config I2C_MUX
	bool "Support I2C multiplexers"
	depends on DM_I2C
	help
	  This enables I2C buses to be multiplexed, so that you can select
	  one of several buses using some sort of control mechanism. The
	  bus select is handled automatically when that bus is accessed,
	  using a suitable I2C MUX driver.

config SPL_I2C_MUX
	bool "Support I2C multiplexers on SPL"
	depends on I2C_MUX
	help
	  This enables I2C buses to be multiplexed, so that you can select
	  one of several buses using some sort of control mechanism. The
	  bus select is handled automatically when that bus is accessed,
	  using a suitable I2C MUX driver.

config I2C_ARB_GPIO_CHALLENGE
	bool "GPIO-based I2C arbitration"
	depends on I2C_MUX
	help
	  If you say yes to this option, support will be included for an
	  I2C multimaster arbitration scheme using GPIOs and a challenge &
	  response mechanism where masters have to claim the bus by asserting
	  a GPIO.

config I2C_MUX_PCA954x
	tristate "TI PCA954x I2C Mux/switches"
	depends on I2C_MUX
	help
	  If you say yes here you get support for the TI PCA954x I2C mux/switch
	  devices. It is x width I2C multiplexer which enables to partitioning
	  I2C bus and connect multiple devices with the same address to the same
	  I2C controller where driver handles proper routing to target i2c
	  device. Supported chips are PCA9543, PCA9544, PCA9547, PCA9548 and
	  PCA9646.

config I2C_MUX_GPIO
        tristate "GPIO-based I2C multiplexer"
	depends on I2C_MUX && DM_GPIO
	help
	  If you say yes to this option, support will be included for
	  a GPIO based I2C multiplexer. This driver provides access to
	  I2C busses connected through a MUX, which is controlled
	  through GPIO pins.
```

## release/src-rt-5.04behnd.4916/bootloaders/u-boot-2019.07/drivers/mailbox/Kconfig
```kconfig
menu "Mailbox Controller Support"

config DM_MAILBOX
	bool "Enable mailbox controllers using Driver Model"
	depends on DM && OF_CONTROL
	help
	  Enable support for the mailbox driver class. Mailboxes provide the
	  ability to transfer small messages and/or notifications from one
	  CPU to another CPU, or sometimes to dedicated HW modules. They form
	  the basis of a variety of inter-process/inter-CPU communication
	  protocols.

config SANDBOX_MBOX
	bool "Enable the sandbox mailbox test driver"
	depends on DM_MAILBOX && SANDBOX
	help
	  Enable support for a test mailbox implementation, which simply echos
	  back a modified version of any message that is sent.

config TEGRA_HSP
	bool "Enable Tegra HSP controller support"
	depends on DM_MAILBOX && TEGRA
	help
	  This enables support for the NVIDIA Tegra HSP Hw module, which
	  implements doorbells, mailboxes, semaphores, and shared interrupts.

config K3_SEC_PROXY
	bool "Texas Instruments K3 Secure Proxy Driver"
	depends on DM_MAILBOX && ARCH_K3
	help
	  An implementation of Secure proxy slave driver for K3 SoCs from
	  Texas Instruments. Secure proxy is a communication entity mainly
	  used for communication between multiple processors with the SoC.
	  Select this driver if your platform has support for this hardware
	  block.

endmenu
```
