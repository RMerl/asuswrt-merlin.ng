## release/src-rt-5.04behnd.4916/bootloaders/u-boot-2019.07/drivers/clk/owl/Kconfig
```kconfig
config CLK_OWL
        bool "Actions Semi OWL clock drivers"
        depends on CLK && ARCH_OWL
        help
          Enable support for clock managemet unit present in Actions Semi
	  OWL SoCs.

config CLK_S900
        bool "Actions Semi S900 clock driver"
        depends on CLK_OWL && ARM64
        help
          Enable support for the clocks in Actions Semi S900 SoC.
```

## release/src-rt-5.04behnd.4916/bootloaders/u-boot-2019.07/drivers/clk/sunxi/Kconfig
```kconfig
config CLK_SUNXI
	bool "Clock support for Allwinner SoCs"
	depends on CLK && ARCH_SUNXI
	select DM_RESET
	default y
	help
	  This enables support for common clock driver API on Allwinner
	  SoCs.

if CLK_SUNXI

config CLK_SUN4I_A10
	bool "Clock driver for Allwinner A10/A20"
	default MACH_SUN4I || MACH_SUN7I
	help
	  This enables common clock driver support for platforms based
	  on Allwinner A10/A20 SoC.

config CLK_SUN5I_A10S
	bool "Clock driver for Allwinner A10s/A13"
	default MACH_SUN5I
	help
	  This enables common clock driver support for platforms based
	  on Allwinner A10s/A13 SoC.

config CLK_SUN6I_A31
	bool "Clock driver for Allwinner A31/A31s"
	default MACH_SUN6I
	help
	  This enables common clock driver support for platforms based
	  on Allwinner A31/A31s SoC.

config CLK_SUN8I_A23
	bool "Clock driver for Allwinner A23/A33"
	default MACH_SUN8I_A23 || MACH_SUN8I_A33
	help
	  This enables common clock driver support for platforms based
	  on Allwinner A23/A33 SoC.

config CLK_SUN8I_A83T
	bool "Clock driver for Allwinner A83T"
	default MACH_SUN8I_A83T
	help
	  This enables common clock driver support for platforms based
	  on Allwinner A83T SoC.

config CLK_SUN8I_R40
	bool "Clock driver for Allwinner R40"
	default MACH_SUN8I_R40
	help
	  This enables common clock driver support for platforms based
	  on Allwinner R40 SoC.

config CLK_SUN8I_V3S
	bool "Clock driver for Allwinner V3S"
	default MACH_SUN8I_V3S
	help
	  This enables common clock driver support for platforms based
	  on Allwinner V3S SoC.

config CLK_SUN9I_A80
	bool "Clock driver for Allwinner A80"
	default MACH_SUN9I
	help
	  This enables common clock driver support for platforms based
	  on Allwinner A80 SoC.

config CLK_SUN8I_H3
	bool "Clock driver for Allwinner H3/H5"
	default MACH_SUNXI_H3_H5
	help
	  This enables common clock driver support for platforms based
	  on Allwinner H3/H5 SoC.

config CLK_SUN50I_H6
	bool "Clock driver for Allwinner H6"
	default MACH_SUN50I_H6
	help
	  This enables common clock driver support for platforms based
	  on Allwinner H6 SoC.

config CLK_SUN50I_A64
	bool "Clock driver for Allwinner A64"
	default MACH_SUN50I
	help
	  This enables common clock driver support for platforms based
	  on Allwinner A64 SoC.

endif # CLK_SUNXI
```

## release/src-rt-5.04behnd.4916/bootloaders/u-boot-2019.07/drivers/clk/uniphier/Kconfig
```kconfig
config CLK_UNIPHIER
	def_bool y
	depends on ARCH_UNIPHIER
	select CLK
	help
	  Support for clock controllers on UniPhier SoCs.
	  Say Y if you want to control clocks provided by System Control
	  block, Media I/O block, Peripheral Block.
```

## release/src-rt-5.04behnd.4916/bootloaders/u-boot-2019.07/drivers/cpu/Kconfig
```kconfig
config CPU
	bool "Enable CPU drivers using Driver Model"
	help
	  This allows drivers to be provided for CPUs and their type to be
	  specified in the board's device tree. For boards which support
	  multiple CPUs, then normally have to be set up in U-Boot so that
	  they can work correctly in the OS. This provides a framework for
	  finding out information about available CPUs and making changes.

config CPU_MPC83XX
	bool "Enable MPC83xx CPU driver"
	depends on CPU
	select CLK_MPC83XX
	help
	  Support CPU cores for SoCs of the MPC83xx series.

config CPU_RISCV
	bool "Enable RISC-V CPU driver"
	depends on CPU && RISCV
	help
	  Support CPU cores for RISC-V architecture.
```

## release/src-rt-5.04behnd.4916/bootloaders/u-boot-2019.07/drivers/crypto/fsl/Kconfig
```kconfig
config FSL_CAAM
	bool "Freescale Crypto Driver Support"
	select SHA_HW_ACCEL
	imply CMD_HASH
	help
	  Enables the Freescale's Cryptographic Accelerator and Assurance
	  Module (CAAM), also known as the SEC version 4 (SEC4). The driver uses
	  Job Ring as interface to communicate with CAAM.

config SYS_FSL_HAS_SEC
	bool
	help
		Enable Freescale Secure Boot and Trusted Architecture

config SYS_FSL_SEC_COMPAT_2
	bool
	help
		Secure boot and trust architecture compatible version 2

config SYS_FSL_SEC_COMPAT_4
	bool
	help
		Secure boot and trust architecture compatible version 4

config SYS_FSL_SEC_COMPAT_5
	bool
	help
		Secure boot and trust architecture compatible version 5

config SYS_FSL_SEC_COMPAT_6
	bool
	help
		Secure boot and trust architecture compatible version 6

config SYS_FSL_SEC_BE
	bool "Big-endian access to Freescale Secure Boot"

config SYS_FSL_SEC_COMPAT
	int "Freescale Secure Boot compatibility"
	depends on SYS_FSL_HAS_SEC
	default 2 if SYS_FSL_SEC_COMPAT_2
	default 4 if SYS_FSL_SEC_COMPAT_4
	default 5 if SYS_FSL_SEC_COMPAT_5
	default 6 if SYS_FSL_SEC_COMPAT_6

config SYS_FSL_SEC_LE
	bool "Little-endian access to Freescale Secure Boot"
```

## release/src-rt-5.04behnd.4916/bootloaders/u-boot-2019.07/drivers/ddr/fsl/Kconfig
```kconfig
config SYS_FSL_DDR
	bool
	help
	  Select Freescale General DDR driver, shared between most Freescale
	  PowerPC- based SoCs (such as mpc83xx, mpc85xx, mpc86xx) and ARM-
	  based Layerscape SoCs (such as ls2080a).

config SYS_FSL_MMDC
	bool
	help
	  Select Freescale Multi Mode DDR controller (MMDC).

config SYS_FSL_DDR_BE
	bool
	help
		Access DDR registers in big-endian

config SYS_FSL_DDR_LE
	bool
	help
		Access DDR registers in little-endian

config FSL_DDR_BIST
	bool

config FSL_DDR_INTERACTIVE
	bool

config FSL_DDR_SYNC_REFRESH
	bool

config FSL_DDR_FIRST_SLOT_QUAD_CAPABLE
	bool

menu "Freescale DDR controllers"
	depends on SYS_FSL_DDR

config SYS_NUM_DDR_CTLRS
	int "Maximum DDR controllers"
	default 3 if	ARCH_LS2080A	|| \
			ARCH_T4240
	default 2 if	ARCH_B4860	|| \
			ARCH_BSC9132	|| \
			ARCH_MPC8572	|| \
			ARCH_MPC8641	|| \
			ARCH_P4080	|| \
			ARCH_P5020	|| \
			ARCH_P5040	|| \
			ARCH_LX2160A	|| \
			ARCH_T4160
	default 1

config SYS_FSL_DDR_VER
	int
	default 50 if SYS_FSL_DDR_VER_50
	default 47 if SYS_FSL_DDR_VER_47
	default 46 if SYS_FSL_DDR_VER_46
	default 44 if SYS_FSL_DDR_VER_44

config SYS_FSL_DDR_VER_50
	bool

config SYS_FSL_DDR_VER_47
	bool

config SYS_FSL_DDR_VER_46
	bool

config SYS_FSL_DDR_VER_44
	bool

config SYS_FSL_DDRC_GEN1
	bool
	help
	  Enable Freescale DDR controller.

config SYS_FSL_DDRC_GEN2
	bool
	depends on !MPC86xx
	help
	  Enable Freescale DDR2 controller.

config SYS_FSL_DDRC_86XX_GEN2
	bool
	depends on MPC86xx
	help
	  Enable Freescale DDR2 controller for MPC86xx SoCs.

config SYS_FSL_DDRC_GEN3
	bool
	depends on PPC
	help
	  Enable Freescale DDR3 controller for PowerPC SoCs.

config SYS_FSL_DDRC_ARM_GEN3
	bool
	depends on ARM
	help
	  Enable Freescale DDR3 controller for ARM SoCs.

config SYS_FSL_DDRC_GEN4
	bool
	help
	  Enable Freescale DDR4 controller.

config SYS_FSL_HAS_DDR4
	bool

config SYS_FSL_HAS_DDR3
	bool

config SYS_FSL_HAS_DDR2
	bool

config SYS_FSL_HAS_DDR1
	bool

choice
	prompt "DDR technology"
	default SYS_FSL_DDR4 if SYS_FSL_HAS_DDR4
	default SYS_FSL_DDR3 if SYS_FSL_HAS_DDR3
	default SYS_FSL_DDR2 if SYS_FSL_HAS_DDR2
	default SYS_FSL_DDR1 if SYS_FSL_HAS_DDR1

config SYS_FSL_DDR4
	bool "Freescale DDR4 controller"
	depends on SYS_FSL_HAS_DDR4
	select SYS_FSL_DDRC_GEN4

config SYS_FSL_DDR3
	bool "Freescale DDR3 controller"
	depends on SYS_FSL_HAS_DDR3
	select SYS_FSL_DDRC_GEN3 if PPC
	select SYS_FSL_DDRC_ARM_GEN3 if ARM

config SYS_FSL_DDR2
	bool "Freescale DDR2 controller"
	depends on SYS_FSL_HAS_DDR2
	select SYS_FSL_DDRC_GEN2 if (!MPC86xx && !SYS_FSL_DDRC_GEN3)
	select SYS_FSL_DDRC_86XX_GEN2 if MPC86xx

config SYS_FSL_DDR1
	bool "Freescale DDR1 controller"
	depends on SYS_FSL_HAS_DDR1
	select SYS_FSL_DDRC_GEN1

endchoice

endmenu

config SYS_FSL_ERRATUM_A008378
	bool

config SYS_FSL_ERRATUM_A008511
	bool

config SYS_FSL_ERRATUM_A009663
	bool

config SYS_FSL_ERRATUM_A009801
	bool

config SYS_FSL_ERRATUM_A009803
	bool

config SYS_FSL_ERRATUM_A009942
	bool

config SYS_FSL_ERRATUM_A010165
	bool

config SYS_FSL_ERRATUM_NMG_DDR120
	bool

config SYS_FSL_ERRATUM_DDR_115
	bool

config SYS_FSL_ERRATUM_DDR111_DDR134
	bool

config SYS_FSL_ERRATUM_DDR_A003
	bool

config SYS_FSL_ERRATUM_DDR_A003474
	bool
```

## release/src-rt-5.04behnd.4916/bootloaders/u-boot-2019.07/drivers/dfu/Kconfig
```kconfig
menu "DFU support"

config DFU
	bool
	imply DFU_OVER_USB if USB_GADGET

config DFU_OVER_USB
	bool
	select HASH
	depends on USB_GADGET

config DFU_OVER_TFTP
	bool
	depends on NET

if DFU
config DFU_TFTP
	bool "DFU via TFTP"
	select DFU_OVER_TFTP
	help
	  This option allows performing update of DFU-managed medium with data
	  sent via TFTP boot.

	  Detailed description of this feature can be found at ./doc/README.dfutftp

config DFU_MMC
	bool "MMC back end for DFU"
	help
	  This option enables using DFU to read and write to MMC based storage.

config DFU_NAND
	bool "NAND back end for DFU"
	depends on CMD_MTDPARTS
	help
	  This option enables using DFU to read and write to NAND based
	  storage.

config DFU_RAM
	bool "RAM back end for DFU"
	help
	  This option enables using DFU to read and write RAM on the target.

config DFU_SF
	bool "SPI flash back end for DFU"
	help
	  This option enables using DFU to read and write to SPI flash based
	  storage.

endif
endmenu
```

## release/src-rt-5.04behnd.4916/bootloaders/u-boot-2019.07/drivers/dma/ti/Kconfig
```kconfig
# SPDX-License-Identifier: GPL-2.0+

if ARCH_K3

config TI_K3_NAVSS_UDMA
        bool "Texas Instruments UDMA"
        depends on ARCH_K3
        select DMA
        select TI_K3_NAVSS_RINGACC
        select TI_K3_NAVSS_PSILCFG
        default n
        help
          Support for UDMA used in K3 devices.
endif
```

## release/src-rt-5.04behnd.4916/bootloaders/u-boot-2019.07/drivers/fastboot/Kconfig
```kconfig
menu "Fastboot support"

config FASTBOOT
	bool
	imply ANDROID_BOOT_IMAGE
	imply CMD_FASTBOOT

config USB_FUNCTION_FASTBOOT
	bool "Enable USB fastboot gadget"
	depends on USB_GADGET
	default y if ARCH_SUNXI && USB_MUSB_GADGET
	select FASTBOOT
	select USB_GADGET_DOWNLOAD
	help
	  This enables the USB part of the fastboot gadget.

config UDP_FUNCTION_FASTBOOT
	depends on NET
	select FASTBOOT
	bool "Enable fastboot protocol over UDP"
	help
	  This enables the fastboot protocol over UDP.

if FASTBOOT

config FASTBOOT_BUF_ADDR
	hex "Define FASTBOOT buffer address"
	default 0x82000000 if MX6SX || MX6SL || MX6UL || MX6SLL
	default 0x81000000 if ARCH_OMAP2PLUS
	default 0x42000000 if ARCH_SUNXI && !MACH_SUN9I
	default 0x22000000 if ARCH_SUNXI && MACH_SUN9I
	default 0x60800800 if ROCKCHIP_RK3036 || ROCKCHIP_RK3188 || \
				ROCKCHIP_RK322X
	default 0x800800 if ROCKCHIP_RK3288 || ROCKCHIP_RK3329 || \
				ROCKCHIP_RK3399
	default 0x280000 if ROCKCHIP_RK3368
	default 0x100000 if ARCH_ZYNQMP
	default 0 if SANDBOX
	help
	  The fastboot protocol requires a large memory buffer for
	  downloads. Define this to the starting RAM address to use for
	  downloaded images.

config FASTBOOT_BUF_SIZE
	hex "Define FASTBOOT buffer size"
	default 0x8000000 if ARCH_ROCKCHIP
	default 0x6000000 if ARCH_ZYNQMP
	default 0x2000000 if ARCH_SUNXI
	default 0x8192 if SANDBOX
	default 0x7000000
	help
	  The fastboot protocol requires a large memory buffer for
	  downloads. This buffer should be as large as possible for a
	  platform. Define this to the size available RAM for fastboot.

config FASTBOOT_USB_DEV
	int "USB controller number"
	depends on USB_FUNCTION_FASTBOOT
	default 0
	help
	  Some boards have USB OTG controller other than 0. Define this
	  option so it can be used in compiled environment (e.g. in
	  CONFIG_BOOTCOMMAND).

config FASTBOOT_FLASH
	bool "Enable FASTBOOT FLASH command"
	default y if ARCH_SUNXI
	depends on MMC || (NAND && CMD_MTDPARTS)
	select IMAGE_SPARSE
	help
	  The fastboot protocol includes a "flash" command for writing
	  the downloaded image to a non-volatile storage device. Define
	  this to enable the "fastboot flash" command.

choice
	prompt "Flash provider for FASTBOOT"
	depends on FASTBOOT_FLASH

config FASTBOOT_FLASH_MMC
	bool "FASTBOOT on MMC"
	depends on MMC

config FASTBOOT_FLASH_NAND
	bool "FASTBOOT on NAND"
	depends on NAND && CMD_MTDPARTS

endchoice

config FASTBOOT_FLASH_MMC_DEV
	int "Define FASTBOOT MMC FLASH default device"
	depends on FASTBOOT_FLASH_MMC
	default 0 if ARCH_SUNXI && MMC_SUNXI_SLOT_EXTRA = -1
	default 1 if ARCH_SUNXI && MMC_SUNXI_SLOT_EXTRA != -1
	help
	  The fastboot "flash" command requires additional information
	  regarding the non-volatile storage device. Define this to
	  the eMMC device that fastboot should use to store the image.

config FASTBOOT_FLASH_NAND_TRIMFFS
	bool "Skip empty pages when flashing NAND"
	depends on FASTBOOT_FLASH_NAND
	help
	  When flashing NAND enable the DROP_FFS flag to drop trailing all-0xff
	  pages.

config FASTBOOT_GPT_NAME
	string "Target name for updating GPT"
	depends on FASTBOOT_FLASH_MMC && EFI_PARTITION
	default "gpt"
	help
	  The fastboot "flash" command supports writing the downloaded
	  image to the Protective MBR and the Primary GUID Partition
	  Table. (Additionally, this downloaded image is post-processed
	  to generate and write the Backup GUID Partition Table.)
	  This occurs when the specified "partition name" on the
	  "fastboot flash" command line matches the value defined here.
	  The default target name for updating GPT is "gpt".

config FASTBOOT_MBR_NAME
	string "Target name for updating MBR"
	depends on FASTBOOT_FLASH_MMC && DOS_PARTITION
	default "mbr"
	help
	  The fastboot "flash" command allows to write the downloaded image
	  to the Master Boot Record. This occurs when the "partition name"
	  specified on the "fastboot flash" command line matches the value
	  defined here. The default target name for updating MBR is "mbr".

config FASTBOOT_CMD_OEM_FORMAT
	bool "Enable the 'oem format' command"
	depends on FASTBOOT_FLASH_MMC && CMD_GPT
	help
	  Add support for the "oem format" command from a client. This
	  relies on the env variable partitions to contain the list of
	  partitions as required by the gpt command.

endif # FASTBOOT

endmenu
```
