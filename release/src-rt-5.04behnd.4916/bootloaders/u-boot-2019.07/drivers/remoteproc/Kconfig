## release/src-rt-5.04behnd.4916/bootloaders/u-boot-2019.07/lib/efi/Kconfig
```kconfig
config EFI
	bool "Support running U-Boot from EFI"
	depends on X86
	help
	  U-Boot can be started from EFI on certain platforms. This allows
	  EFI to perform most of the system init and then jump to U-Boot for
	  final system boot. Another option is to run U-Boot as an EFI
	  application, with U-Boot using EFI's drivers instead of its own.

choice
	prompt "Select EFI mode to use"
	depends on X86 && EFI

config EFI_APP
	bool "Support running as an EFI application"
	help
	  Build U-Boot as an application which can be started from EFI. This
	  is useful for examining a platform in the early stages of porting
	  U-Boot to it. It allows only very basic functionality, such as a
	  command prompt and memory and I/O functions. Use 'reset' to return
	  to EFI.

config EFI_STUB
	bool "Support running as an EFI payload"

endchoice

config EFI_RAM_SIZE
	hex "Amount of EFI RAM for U-Boot"
	depends on EFI_APP
	default 0x2000000
	help
	  Set the amount of EFI RAM which is claimed by U-Boot for its own
	  use. U-Boot allocates this from EFI on start-up (along with a few
	  other smaller amounts) and it can never be increased after that.
	  It is used as the RAM size in with U-Boot.

choice
	prompt "EFI 32/64-bit selection"
	depends on EFI_STUB
	help
	  EFI does not support mixing 32-bit and 64-bit modes. This is a
	  significant problem because it means that you must build a stub with
	  the correct type for EFI to load it correctly. If you are using
	  32-bit EFI, select 32-bit here, else select 64-bit. Failure to do
	  this may produce no error message - it just won't start!

config EFI_STUB_32BIT
	bool "Produce a stub for running with 32-bit EFI"

config EFI_STUB_64BIT
	bool "Produce a stub for running with 64-bit EFI"

endchoice
```

## release/src-rt-5.04behnd.4916/bootloaders/u-boot-2019.07/lib/efi_loader/Kconfig
```kconfig
config EFI_LOADER
	bool "Support running UEFI applications"
	depends on (ARM || X86 || RISCV || SANDBOX) && OF_LIBFDT
	# We need EFI_STUB_64BIT to be set on x86_64 with EFI_STUB
	depends on !EFI_STUB || !X86_64 || EFI_STUB_64BIT
	# We need EFI_STUB_32BIT to be set on x86_32 with EFI_STUB
	depends on !EFI_STUB || !X86 || X86_64 || EFI_STUB_32BIT
	default y
	select LIB_UUID
	select HAVE_BLOCK_DEVICE
	select REGEX
	imply CFB_CONSOLE_ANSI
	help
	  Select this option if you want to run UEFI applications (like GNU
	  GRUB or iPXE) on top of U-Boot. If this option is enabled, U-Boot
	  will expose the UEFI API to a loaded application, enabling it to
	  reuse U-Boot's device drivers.

if EFI_LOADER

config EFI_GET_TIME
	bool "GetTime() runtime service"
	depends on DM_RTC
	default y
	help
	  Provide the GetTime() runtime service at boottime. This service
	  can be used by an EFI application to read the real time clock.

config EFI_SET_TIME
	bool "SetTime() runtime service"
	depends on EFI_GET_TIME
	default n
	help
	  Provide the SetTime() runtime service at boottime. This service
	  can be used by an EFI application to adjust the real time clock.

config EFI_DEVICE_PATH_TO_TEXT
	bool "Device path to text protocol"
	default y
	help
	  The device path to text protocol converts device nodes and paths to
	  human readable strings.

config EFI_LOADER_HII
	bool "HII protocols"
	default y
	help
	  The Human Interface Infrastructure is a complicated framework that
	  allows UEFI applications to draw fancy menus and hook strings using
	  a translation framework.

	  U-Boot implements enough of its features to be able to run the UEFI
	  Shell, but not more than that.

config EFI_UNICODE_COLLATION_PROTOCOL2
	bool "Unicode collation protocol"
	default y
	help
	  The Unicode collation protocol is used for lexical comparisons. It is
	  required to run the UEFI shell.

if EFI_UNICODE_COLLATION_PROTOCOL2

config EFI_UNICODE_CAPITALIZATION
	bool "Support Unicode capitalization"
	default y
	help
	  Select this option to enable correct handling of the capitalization of
	  Unicode codepoints in the range 0x0000-0xffff. If this option is not
	  set, only the the correct handling of the letters of the codepage
	  used by the FAT file system is ensured.

config EFI_UNICODE_COLLATION_PROTOCOL
	bool "Deprecated version of the Unicode collation protocol"
	default n
	help
	  In EFI 1.10 a version of the Unicode collation protocol using ISO
	  639-2 language codes existed. This protocol is not part of the UEFI
	  specification any longer. Unfortunately it is required to run the
	  UEFI Self Certification Test (SCT) II, version 2.6, 2017.

	  Choose this option for testing only. It is bound to be removed.

endif

config EFI_LOADER_BOUNCE_BUFFER
	bool "EFI Applications use bounce buffers for DMA operations"
	depends on ARM64
	default n
	help
	  Some hardware does not support DMA to full 64bit addresses. For this
	  hardware we can create a bounce buffer so that payloads don't have to
	  worry about platform details.

config EFI_PLATFORM_LANG_CODES
	string "Language codes supported by firmware"
	default "en-US"
	help
	  This value is used to initialize the PlatformLangCodes variable. Its
	  value is a semicolon (;) separated list of language codes in native
	  RFC 4646 format, e.g. "en-US;de-DE". The first language code is used
	  to initialize the PlatformLang variable.

endif
```

## release/src-rt-5.04behnd.4916/bootloaders/u-boot-2019.07/lib/efi_selftest/Kconfig
```kconfig
config CMD_BOOTEFI_SELFTEST
	bool "Allow booting an EFI efi_selftest"
	depends on CMD_BOOTEFI
	imply FAT
	imply FAT_WRITE
	help
	  This adds an EFI test application to U-Boot that can be executed
	  with the 'bootefi selftest' command. It provides extended tests of
	  the EFI API implementation.
```

## release/src-rt-5.04behnd.4916/bootloaders/u-boot-2019.07/lib/rsa/Kconfig
```kconfig
config RSA
	bool "Use RSA Library"
	select RSA_FREESCALE_EXP if FSL_CAAM && !ARCH_MX7 && !ARCH_MX6 && !ARCH_MX5
	select RSA_SOFTWARE_EXP if !RSA_FREESCALE_EXP
	help
	  RSA support. This enables the RSA algorithm used for FIT image
	  verification in U-Boot.
	  See doc/uImage.FIT/signature.txt for more details.
	  The Modular Exponentiation algorithm in RSA is implemented using
	  driver model. So CONFIG_DM needs to be enabled by default for this
	  library to function.
	  The signing part is build into mkimage regardless of this
	  option. The software based modular exponentiation is built into
	  mkimage irrespective of this option.

if RSA

config SPL_RSA
	bool "Use RSA Library within SPL"

config RSA_SOFTWARE_EXP
	bool "Enable driver for RSA Modular Exponentiation in software"
	depends on DM
	help
	  Enables driver for modular exponentiation in software. This is a RSA
	  algorithm used in FIT image verification. It required RSA Key as
	  input.
	  See doc/uImage.FIT/signature.txt for more details.

config RSA_FREESCALE_EXP
	bool "Enable RSA Modular Exponentiation with FSL crypto accelerator"
	depends on DM && FSL_CAAM && !ARCH_MX7 && !ARCH_MX6 && !ARCH_MX5
	help
	Enables driver for RSA modular exponentiation using Freescale cryptographic
	accelerator - CAAM.

endif
```

## release/src-rt-5.04behnd.4916/bootloaders/u-boot-2019.07/net/Kconfig
```kconfig
#
# Network configuration
#

menuconfig NET
	bool "Networking support"
	default y

if NET

config NET_RANDOM_ETHADDR
	bool "Random ethaddr if unset"
	help
	  Selecting this will allow the Ethernet interface to function
	  even when the ethaddr variable for that interface is unset.
	  A new MAC address will be generated on every boot and it will
	  not be added to the environment.

config NETCONSOLE
	bool "NetConsole support"
	help
	  Support the 'nc' input/output device for networked console.
	  See README.NetConsole for details.

config IP_DEFRAG
	bool "Support IP datagram reassembly"
	default n
	help
	  Selecting this will enable IP datagram reassembly according
	  to the algorithm in RFC815.

config TFTP_BLOCKSIZE
	int "TFTP block size"
	default 512
	help
	  Default TFTP block size.

endif   # if NET
```

## release/src-rt-5.04behnd.4916/bootloaders/u-boot-2019.07/test/Kconfig
```kconfig
menuconfig UNIT_TEST
	bool "Unit tests"
	help
	  Select this to compile in unit tests for various parts of
	  U-Boot. Test suites will be subcommands of the "ut" command.
	  This does not require sandbox to be included, but it is most
	  often used there.

config UT_LIB
	bool "Unit tests for library functions"
	depends on UNIT_TEST
	default y
	help
	  Enables the 'ut lib' command which tests library functions like
	  memcat(), memcyp(), memmove().

config UT_TIME
	bool "Unit tests for time functions"
	depends on UNIT_TEST
	help
	  Enables the 'ut time' command which tests that the time functions
	  work correctly. The test is fairly simple and will not catch all
	  problems. But if you are having problems with udelay() and the like,
	  this is a good place to start.

config UT_UNICODE
	bool "Unit tests for Unicode functions"
	depends on UNIT_TEST
	default y
	help
	  Enables the 'ut unicode' command which tests that the functions for
	  manipulating Unicode strings work correctly.

source "test/dm/Kconfig"
source "test/env/Kconfig"
source "test/overlay/Kconfig"
```
