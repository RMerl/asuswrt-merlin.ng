## release/src-rt-5.04behnd.4916/bootloaders/u-boot-2019.07/drivers/usb/emul/Kconfig
```kconfig
config USB_EMUL
	bool "Support for USB device emulation"
	depends on DM_USB && SANDBOX
	help
	  Since sandbox does not have access to a real USB bus, it is possible
	  to use device emulators instead. This allows testing of the USB
	  stack on sandbox without needing a real device, or any host machine
	  USB resources.
```

## release/src-rt-5.04behnd.4916/bootloaders/u-boot-2019.07/drivers/usb/eth/Kconfig
```kconfig
menuconfig USB_HOST_ETHER
	bool "USB to Ethernet Controller Drivers"
	---help---
	  Say Y here if you would like to enable support for USB Ethernet
	  adapters.

if USB_HOST_ETHER

config USB_ETHER_ASIX
	bool "ASIX AX8817X (USB 2.0) support"
	depends on USB_HOST_ETHER
	---help---
	  Say Y here if you would like to support ASIX AX8817X based USB 2.0
	  Ethernet Devices.

config USB_ETHER_ASIX88179
	bool "ASIX AX88179 (USB 3.0) support"
	depends on USB_HOST_ETHER
	---help---
	  Say Y here if you would like to support ASIX AX88179 based USB 3.0
	  Ethernet Devices.

config USB_ETHER_LAN75XX
	bool "Microchip LAN75XX support"
	depends on USB_HOST_ETHER
	depends on PHYLIB
	---help---
	  Say Y here if you would like to support Microchip LAN75XX Hi-Speed
	  USB 2.0 to 10/100/1000 Gigabit Ethernet controller.
	  Supports 10Base-T/ 100Base-TX/1000Base-T.
	  This driver supports the internal PHY.

config USB_ETHER_LAN78XX
	bool "Microchip LAN78XX support"
	depends on USB_HOST_ETHER
	depends on PHYLIB
	---help---
	  Say Y here if you would like to support Microchip LAN78XX USB 3.1
	  Gen 1 to 10/100/1000 Gigabit Ethernet controller.
	  Supports 10Base-T/ 100Base-TX/1000Base-T.
	  This driver supports the internal PHY.

config USB_ETHER_MCS7830
	bool "MOSCHIP MCS7830 (7730/7830/7832) suppport"
	depends on USB_HOST_ETHER
	---help---
	  Say Y here if you would like to support MOSCHIP MCS7830 based
	  (7730/7830/7832) USB 2.0 Ethernet Devices.

config USB_ETHER_RTL8152
	bool "Realtek RTL8152B/RTL8153 support"
	depends on USB_HOST_ETHER
	---help---
	  Say Y here if you would like to support Realtek RTL8152B/RTL8153 base
	  USB Ethernet Devices. This driver also supports compatible devices
	  from Samsung, Lenovo, TP-LINK and Nvidia.

config USB_ETHER_SMSC95XX
	bool "SMSC LAN95x support"
	depends on USB_HOST_ETHER
	---help---
	  Say Y here if you would like to support SMSC LAN95xx based USB 2.0
	  Ethernet Devices.

endif
```

## release/src-rt-5.04behnd.4916/bootloaders/u-boot-2019.07/drivers/usb/musb-new/Kconfig
```kconfig
#
# MUSB Controller Driver
#
comment "MUSB Controller Driver"

config USB_MUSB_HOST
	bool "MUSB host mode support"
	select SPL_SPRINTF if SPL
	select TPL_SPRINTF if TPL
	help
	  Enables the MUSB USB dual-role controller in host mode.

config USB_MUSB_GADGET
	bool "MUSB gadget mode support"
	select USB_GADGET_DUALSPEED
	select SPL_SPRINTF if SPL
	select TPL_SPRINTF if TPL
	help
	  Enables the MUSB USB dual-role controller in gadget mode.

config USB_MUSB_TI
	bool "Enable TI OTG USB controller"
	depends on DM_USB
	select USB_MUSB_DSPS
	default n
	help
	  Say y here to enable support for the dual role high
	  speed USB controller based on the Mentor Graphics
	  silicon IP.

config USB_MUSB_OMAP2PLUS
	tristate "OMAP2430 and onwards"
	depends on ARCH_OMAP2PLUS

config USB_MUSB_AM35X
	bool "AM35x"

config USB_MUSB_DSPS
	bool "TI DSPS platforms"

if USB_MUSB_HOST || USB_MUSB_GADGET

config USB_MUSB_PIC32
	bool "Enable Microchip PIC32 DRC USB controller"
	depends on DM_USB && MACH_PIC32
	help
	  Say y to enable PIC32 USB DRC controller support
	  if it is available on your Microchip PIC32 platform.

config USB_MUSB_SUNXI
	bool "Enable sunxi OTG / DRC USB controller"
	depends on ARCH_SUNXI
	default y
	---help---
	Say y here to enable support for the sunxi OTG / DRC USB controller
	used on almost all sunxi boards.

config USB_MUSB_DISABLE_BULK_COMBINE_SPLIT
	bool "Disable MUSB bulk split/combine"
	default y
	help
	  On TI AM335x devices, MUSB has bulk split/combine feature enabled
	  in the ConfigData register, but the current MUSB driver does not
	  support it yet. Select this option to disable the feature until the
	  driver adds the support.

endif

config USB_MUSB_PIO_ONLY
	bool "Disable DMA (always use PIO)"
	default y if USB_MUSB_AM35X || USB_MUSB_PIC32 || USB_MUSB_OMAP2PLUS || USB_MUSB_DSPS || USB_MUSB_SUNXI
	help
	  All data is copied between memory and FIFO by the CPU.
	  DMA controllers are ignored.
```

## release/src-rt-5.04behnd.4916/bootloaders/u-boot-2019.07/drivers/usb/phy/Kconfig
```kconfig
# SPDX-License-Identifier: GPL-2.0+
#
# (C) Copyright 2017
# Adam Ford, Logic PD, aford173@gmail.com

comment "USB Phy"

config TWL4030_USB
	bool "TWL4030 PHY"

config OMAP_USB_PHY
	bool "OMAP PHY"

config ROCKCHIP_USB2_PHY
	bool "Rockchip USB2 PHY"
```

## release/src-rt-5.04behnd.4916/bootloaders/u-boot-2019.07/drivers/usb/ulpi/Kconfig
```kconfig
comment "ULPI drivers"

choice
	prompt "ULPI Viewport type"
	optional
	help
	  Select ULPI viewport (SoC-side interface to ULPI) implementation
	  appropriate for the device if you want to communicate with
	  UTMI (USB PHY) via ULPI interface.

config USB_ULPI_VIEWPORT
	bool "Generic ULPI Viewport"
	help
	  Support generic ULPI Viewport implementation that is used on
	  some Tegra and Snapdragon devices.

config USB_ULPI_VIEWPORT_OMAP
	bool "OMAP ULPI Viewport"
	help
	  Support ULPI Viewport implementation that is used on OMAP devices.

endchoice

config USB_ULPI
	bool "ULPI support"
	depends on (USB_ULPI_VIEWPORT || USB_ULPI_VIEWPORT_OMAP)
	help
	  Select to commnicate with USB PHY via ULPI interface.
	  ULPI is wrapper on UTMI+ core that is used as
	  PHY Transreceiver for USB controllers.

	  This driver uses ULPI viewports that are specific for each SoC.
```

## release/src-rt-5.04behnd.4916/bootloaders/u-boot-2019.07/drivers/video/bridge/Kconfig
```kconfig
config VIDEO_BRIDGE
	bool "Support video bridges"
	depends on DM
	help
	  Some platforms use video bridges to convert from one output to
	  another. For example, where the SoC only supports eDP and the LCD
	  requires LVDS, an eDP->LVDS bridge chip can be used to provide the
	  necessary conversion. This option enables support for these devices.

config VIDEO_BRIDGE_PARADE_PS862X
	bool "Support Parade PS862X DP->LVDS bridge"
	depends on VIDEO_BRIDGE
	help
	  The Parade PS8622 and PS8625 are DisplayPort-to-LVDS (Low voltage
	  differential signalling) converters. They enable an LVDS LCD panel
	  to be connected to an eDP output device such as an SoC that lacks
	  LVDS capability, or where LVDS requires too many signals to route
	  on the PCB. Setup parameters are provided in the device tree.

config VIDEO_BRIDGE_NXP_PTN3460
	bool "Support NXP PTN3460 DP->LVDS bridge"
	depends on VIDEO_BRIDGE
	help
	  The NXP PTN3460 is a DisplayPort-to-LVDS (Low voltage differential
	  signalling) converter. It enables an LVDS LCD panel to be connected
	  to an eDP output device such as an SoC that lacks LVDS capability,
	  or where LVDS requires too many signals to route on the PCB.

config VIDEO_BRIDGE_ANALOGIX_ANX6345
	bool "Support Analogix ANX6345 RGB->DP bridge"
	depends on VIDEO_BRIDGE
	select DM_I2C
	help
	 The Analogix ANX6345 is RGB-to-DP converter. It enables an eDP LCD
	 panel to be connected to an parallel LCD interface.
```

## release/src-rt-5.04behnd.4916/bootloaders/u-boot-2019.07/drivers/video/imx/Kconfig
```kconfig
config VIDEO_IPUV3
	bool "i.MX IPUv3 Core video support"
	depends on (VIDEO || DM_VIDEO) && (MX5 || MX6)
	help
	  This enables framebuffer driver for i.MX processors working
	  on the IPUv3(Image Processing Unit) internal graphic processor.
```

## release/src-rt-5.04behnd.4916/bootloaders/u-boot-2019.07/drivers/video/meson/Kconfig
```kconfig
# SPDX-License-Identifier: GPL-2.0+
#
# Copyright (C) 2018 BayLibre, SAS
#
# Author: Neil Armstrong <narmstrong@baylibre.com>

config VIDEO_MESON
	bool "Enable Amlogic Meson video support"
	depends on DM_VIDEO
	select DISPLAY
	help
	  Enable Amlogic Meson Video Processing Unit video support.
```

## release/src-rt-5.04behnd.4916/bootloaders/u-boot-2019.07/drivers/video/rockchip/Kconfig
```kconfig
#
# Video drivers selection for rockchip soc. These configs only impact the
# compile process. You can surely check all the options. In this case, all the
# display driver will be compiled, but which drivers finally  will be used is
# decided by device tree configuration. What's more, enable needed power for
# display by configure the device tree, and the vop driver will do the rest.
#
# Author: Eric Gao <eric.gao@rock-chips.com>
#

menuconfig VIDEO_ROCKCHIP
	bool "Enable Rockchip Video Support"
	depends on DM_VIDEO
	help
	  Rockchip SoCs provide video output capabilities for High-Definition
	  Multimedia Interface (HDMI), Low-voltage Differential Signalling
	  (LVDS), embedded DisplayPort (eDP) and Display Serial Interface (DSI).

	  This driver supports the on-chip video output device, and targets the
	  Rockchip RK3288 and RK3399.

config VIDEO_ROCKCHIP_MAX_XRES
        int "Maximum horizontal resolution (for memory allocation purposes)"
	depends on VIDEO_ROCKCHIP
	default 1920
	help
	  The maximum horizontal resolution to support for the framebuffer.
	  This configuration is used for reserving/allocating memory for the
	  framebuffer during device-model binding/probing.

config VIDEO_ROCKCHIP_MAX_YRES
        int "Maximum vertical resolution (for memory allocation purposes)"
	depends on VIDEO_ROCKCHIP
	default 1080
	help
	  The maximum vertical resolution to support for the framebuffer.
	  This configuration is used for reserving/allocating memory for the
	  framebuffer during device-model binding/probing.

if VIDEO_ROCKCHIP

config DISPLAY_ROCKCHIP_EDP
	bool "EDP Port"
	depends on VIDEO_ROCKCHIP
	help
	  This enables Embedded DisplayPort(EDP) display support.

config DISPLAY_ROCKCHIP_LVDS
	bool "LVDS Port"
	depends on VIDEO_ROCKCHIP
	help
	  This enables Low-voltage Differential Signaling(LVDS) display
	  support.

config DISPLAY_ROCKCHIP_HDMI
	bool "HDMI port"
	select VIDEO_DW_HDMI
	depends on VIDEO_ROCKCHIP
	help
	  This enables High-Definition Multimedia Interface display support.

config DISPLAY_ROCKCHIP_MIPI
	bool "MIPI Port"
	depends on VIDEO_ROCKCHIP
	help
	  This enables Mobile Industry Processor Interface(MIPI) display
	  support. The mipi controller and dphy on rk3288& rk3399 support
	  16,18, 24 bits per pixel with up to 2k resolution ratio.

endif
```

## release/src-rt-5.04behnd.4916/bootloaders/u-boot-2019.07/drivers/virtio/Kconfig
```kconfig
# SPDX-License-Identifier: GPL-2.0+
#
# Copyright (C) 2018, Tuomas Tynkkynen <tuomas.tynkkynen@iki.fi>
# Copyright (C) 2018, Bin Meng <bmeng.cn@gmail.com>
#
# VirtIO is a virtualization standard for network and disk device drivers
# where just the guest's device driver "knows" it is running in a virtual
# environment, and cooperates with the hypervisor. This enables guests to
# get high performance network and disk operations, and gives most of the
# performance benefits of paravirtualization. In the U-Boot case, the guest
# is U-Boot itself, while the virtual environment are normally QEMU targets
# like ARM, RISC-V and x86.
#
# See http://docs.oasis-open.org/virtio/virtio/v1.0/virtio-v1.0.pdf for
# the VirtIO specification v1.0.

menu "VirtIO Drivers"

config VIRTIO
	bool
	help
	  This option is selected by any driver which implements the virtio
	  transport, such as CONFIG_VIRTIO_MMIO or CONFIG_VIRTIO_PCI.

config VIRTIO_MMIO
	bool "Platform bus driver for memory mapped virtio devices"
	select VIRTIO
	help
	  This driver provides support for memory mapped virtio
	  platform device driver.

config VIRTIO_PCI
	bool "PCI driver for virtio devices"
	depends on DM_PCI
	select VIRTIO
	help
	  This driver provides support for virtio based paravirtual device
	  drivers over PCI.

config VIRTIO_SANDBOX
	bool "Sandbox driver for virtio devices"
	depends on SANDBOX
	select VIRTIO
	help
	  This driver provides support for Sandbox implementation of virtio
	  transport driver which is used for testing purpose only.

config VIRTIO_NET
	bool "virtio net driver"
	depends on VIRTIO
	help
	  This is the virtual net driver for virtio. It can be used with
	  QEMU based targets.

config VIRTIO_BLK
	bool "virtio block driver"
	depends on VIRTIO
	help
	  This is the virtual block driver for virtio. It can be used with
	  QEMU based targets.

endmenu
```

## release/src-rt-5.04behnd.4916/bootloaders/u-boot-2019.07/fs/btrfs/Kconfig
```kconfig
config FS_BTRFS
	bool "Enable BTRFS filesystem support"
	select CRC32C
	select LZO
	select ZSTD
	select RBTREE
	help
	  This provides a single-device read-only BTRFS support. BTRFS is a
	  next-generation Linux file system based on the copy-on-write
	  principle.
```

## release/src-rt-5.04behnd.4916/bootloaders/u-boot-2019.07/fs/ext4/Kconfig
```kconfig
config FS_EXT4
	bool "Enable ext4 filesystem support"
	help
	  This provides support for reading images from the ext4 filesystem.
	  ext4 is a widely used general-purpose filesystem for Linux.
	  You can also enable CMD_EXT4 to get access to ext4 commands.

config EXT4_WRITE
	bool "Enable ext4 filesystem write support"
	depends on FS_EXT4
	help
	  This provides support for creating and writing new files to an
	  existing ext4 filesystem partition.
```

## release/src-rt-5.04behnd.4916/bootloaders/u-boot-2019.07/fs/jffs2/Kconfig
```kconfig
config FS_JFFS2
	bool "Enable JFFS2 filesystem support"
	help
	  This provides support for reading images from JFFS2 (Journalling
	  Flash File System version 2). JFFS2 is a log-structured file system
	  for use with flash memory devices. It supports raw NAND devices,
	  hard links and compression.
```

## release/src-rt-5.04behnd.4916/bootloaders/u-boot-2019.07/fs/ubifs/Kconfig
```kconfig
config UBIFS_SILENCE_MSG
	bool "UBIFS silence verbose messages"
	default ENV_IS_IN_UBI
	help
	  Make the verbose messages from UBIFS stop printing. This leaves
	  warnings and errors enabled.
```

## release/src-rt-5.04behnd.4916/bootloaders/u-boot-2019.07/fs/yaffs2/Kconfig
```kconfig
config YAFFS2
	bool "YAFFS2 filesystem support"
	help
	  This provides access to YAFFS2 filesystems. Yet Another Flash
	  Filesystem 2 is a filesystem designed specifically for NAND flash.
	  It incorporates bad-block management and ensures that device
	  writes are sequential regardless of filesystem activity.
```
