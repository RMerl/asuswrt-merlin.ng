/dts-v1/;

/ {
	#address-cells = <1>;
	#size-cells = <1>;

	binman {
		sort-by-offset;
		end-at-4gb;
		size = <32>;
		u-boot {
			offset = <0xffffffe0>;
		};

		u-boot-spl {
			offset = <0xffffffeb>;
		};
	};
};
