// SPDX-License-Identifier: GPL-2.0+
/*
 * Copyright (C) 2017-2020 Synopsys, Inc. All rights reserved.
 * Author: Eugeniy Paltsev <Eugeniy.Paltsev@synopsys.com>
 */
/dts-v1/;

#include "hsdk-common.dtsi"

/ {
	model = "snps,hsdk";
};
