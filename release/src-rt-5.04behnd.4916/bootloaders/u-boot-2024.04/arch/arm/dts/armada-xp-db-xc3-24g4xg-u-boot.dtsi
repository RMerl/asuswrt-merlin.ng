// SPDX-License-Identifier: (GPL-2.0+ OR MIT)

&nand_controller {
	compatible="marvell,armada370-nand-controller";
	status = "okay";
	label = "pxa3xx_nand-0";
	nand-rb = <0>;
	marvell,nand-keep-config;
	nand-on-flash-bbt;
	nand-ecc-strength = <4>;
	nand-ecc-step-size = <512>;
};

#include "mvebu-u-boot.dtsi"
