// SPDX-License-Identifier: GPL-2.0+
/*
 * Copyright (C) 2017 Texas Instruments Incorporated - https://www.ti.com/
 */

#include "omap5-u-boot.dtsi"

&omap_dwc3_1 {
	bootph-pre-ram;
};

&usb1 {
	bootph-pre-ram;
	dr_mode = "peripheral";
};

&usb2_phy1 {
	bootph-pre-ram;
};

&usb3_phy1 {
	bootph-pre-ram;
};
