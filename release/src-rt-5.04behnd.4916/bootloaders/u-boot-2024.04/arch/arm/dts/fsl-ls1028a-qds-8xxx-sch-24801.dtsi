// SPDX-License-Identifier: GPL-2.0+ OR X11
/*
 * NXP LS1028A-QDS device tree fragment for RCW 8xxx
 *
 * Copyright 2019-2021 NXP
 */

/*
 * This setup is using SCH-24801 cards with VSC8234 quad SGMII PHY in slot 1.
 */
&slot1 {
	#include "fsl-sch-24801.dtsi"
};

&enetc_port0 {
	status = "okay";
	managed = "in-band-status";
	phy-mode = "sgmii";
	phy-handle = <&{/soc/i2c@2000000/fpga@66/mux-mdio@54/mdio@40/phy@1c}>;
};
