// SPDX-License-Identifier: GPL-2.0+ OR X11
/*
 * Device Tree file for Freescale Layerscape-1046A family SoC.
 *
 * Copyright (C) 2016, Freescale Semiconductor
 */

/dts-v1/;
#include "fsl-ls1046a-qds.dtsi"

/ {
       chosen {
               stdout-path = &lpuart0;
       };
};
