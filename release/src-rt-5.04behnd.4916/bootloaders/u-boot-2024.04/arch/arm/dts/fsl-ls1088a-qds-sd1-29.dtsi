// SPDX-License-Identifier: GPL-2.0+ OR X11
/*
 * NXP LS1088AQDS device tree source for SERDES block #1 - protocol 29 (0x1d)
 *
 * Copyright 2020 NXP
 */

#include "fsl-ls1088a-qds.dtsi"

&dpmac1 {
	status = "okay";
	phy-connection-type = "10gbase-r";
};

&dpmac2 {
	status = "okay";
	phy-connection-type = "10gbase-r";
};
