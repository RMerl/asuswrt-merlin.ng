// SPDX-License-Identifier: GPL-2.0+ OR X11
/*
 * NXP LX2162AQDS device tree source for SERDES protocol 18.x
 *
 * Copyright 2020 NXP
 *
 */

/dts-v1/;

#include "fsl-lx2162a-qds-sd1-18.dtsi"

/ {
	model = "NXP Layerscape LX2160AQDS Board (DTS 18.x)";
	compatible = "fsl,lx2162aqds", "fsl,lx2160a";

};
