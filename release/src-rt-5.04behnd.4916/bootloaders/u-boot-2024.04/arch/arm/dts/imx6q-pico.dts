// SPDX-License-Identifier: GPL-2.0
//
// Copyright 2018 Technexion Ltd.
//
// Author: Wig Cheng <wig.cheng@technexion.com>
//	   Richard Hu <richard.hu@technexion.com>
//	   Tapani Utriainen <tapani@technexion.com>

/dts-v1/;

#include "imx6q.dtsi"
#include "imx6qdl-pico.dtsi"

/ {
	model = "TechNexion PICO-IMX6 Quad";
	compatible = "technexion,imx6q-pico", "fsl,imx6q";
};
