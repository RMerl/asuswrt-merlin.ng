// SPDX-License-Identifier: GPL-2.0+
/*
 * Copyright (C) 2018 Jagan Teki <jagan@amarulasolutions.com>
 */

#include "imx6qdl-u-boot.dtsi"

&usdhc3 {
	bootph-pre-ram;
};

&usdhc4 {
	bootph-pre-ram;
};

&pinctrl_usdhc3 {
	bootph-pre-ram;
};

&pinctrl_usdhc4 {
	bootph-pre-ram;
};
