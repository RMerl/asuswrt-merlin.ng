// SPDX-License-Identifier: GPL-2.0

#include "imx6qdl-u-boot.dtsi"

/ {
	aliases {
		mmc0 = &usdhc3;
	};

	wdt-reboot {
		compatible = "wdt-reboot";
		wdt = <&wdog1>;
		bootph-pre-ram;
	};
};

&wdog1 {
	bootph-pre-ram;
};
