// SPDX-License-Identifier: GPL-2.0
/*
 * Copyright (c) 2021 Linumiz
 * Author: Navin Sankar Velliangiri <navin@linumiz.com>
 */

&pinctrl_uart1 {
	bootph-all;
};

&gpmi {
	bootph-pre-ram;
	bootph-all;
};

&usdhc1 {
	bootph-pre-ram;
	bootph-all;
};

&usdhc2 {
	bootph-pre-ram;
	bootph-all;
};
