// SPDX-License-Identifier: GPL-2.0+ OR MIT
/*
 * Copyright (C) 2022 Kontron Electronics GmbH
 */

#include "imx8mm-kontron-bl-common-u-boot.dtsi"

&iomuxc {
	pinctrl_touch: touchgrp {
		fsl,pins = <
			MX8MM_IOMUXC_SAI5_RXD2_GPIO3_IO23	0x19 /* Touch Reset */
		>;
	};
};
