// SPDX-License-Identifier: GPL-2.0+ OR MIT
/*
 * Copyright (C) 2022 Kontron Electronics GmbH
 */

#include "imx8mm-kontron-bl-common-u-boot.dtsi"

&iomuxc {
	pinctrl_touch: touchgrp {
		fsl,pins = <
			MX8MM_IOMUXC_SAI1_TXD3_GPIO4_IO15	0x19 /* Touch Reset */
		>;
	};
};
