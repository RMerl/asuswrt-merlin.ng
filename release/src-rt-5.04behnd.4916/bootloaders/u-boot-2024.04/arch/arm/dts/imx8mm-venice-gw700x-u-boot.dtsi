// SPDX-License-Identifier: GPL-2.0+
/*
 * Copyright 2021 Gateworks Corporation
 */

#include "imx8mm-venice-u-boot.dtsi"

&fec1 {
	phy-reset-gpios = <&gpio3 0 GPIO_ACTIVE_LOW>;
	phy-reset-duration = <1>;
	phy-reset-post-delay = <300>;
};

&pinctrl_fec1 {
	bootph-pre-ram;
};

&{/soc@0/bus@30800000/i2c@30a20000/pmic@69} {
	bootph-pre-ram;
};

&{/soc@0/bus@30800000/i2c@30a20000/pmic@69/regulators} {
	bootph-pre-ram;
};
