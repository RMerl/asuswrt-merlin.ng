// SPDX-License-Identifier: GPL-2.0+
/*
 * Copyright 2023 Gateworks Corporation
 */

#include "imx8mp-venice-u-boot.dtsi"

&eqos {
	/delete-property/ assigned-clocks;
	/delete-property/ assigned-clock-parents;
	/delete-property/ assigned-clock-rates;
};
