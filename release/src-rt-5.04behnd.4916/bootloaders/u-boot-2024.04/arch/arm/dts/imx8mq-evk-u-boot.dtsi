// SPDX-License-Identifier: (GPL-2.0 OR MIT)

#include "imx8mq-u-boot.dtsi"

&pinctrl_uart1 {
	bootph-pre-ram;
};

&usdhc1 {
	mmc-hs400-1_8v;
};

&usdhc2 {
	sd-uhs-sdr104;
	sd-uhs-ddr50;
};

&uart1 {
	bootph-pre-ram;
};
