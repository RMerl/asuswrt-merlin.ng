// SPDX-License-Identifier: (GPL-2.0 OR MIT)

#include "imx8mq-u-boot.dtsi"

&reg_usdhc2_vmmc {
	u-boot,off-on-delay-us = <20000>;
};

&uart1 {
	bootph-pre-ram;
};

&pinctrl_uart1 {
	bootph-pre-ram;
};
