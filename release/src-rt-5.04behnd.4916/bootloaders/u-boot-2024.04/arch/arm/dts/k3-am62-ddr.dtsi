// SPDX-License-Identifier: GPL-2.0+
/*
 * Copyright (C) 2020-2022 Texas Instruments Incorporated - https://www.ti.com/
 */

#include "k3-am64-ddr.dtsi"
&memorycontroller {
	power-domains = <&k3_pds 170 TI_SCI_PD_SHARED>,
			<&k3_pds 55 TI_SCI_PD_SHARED>;
	clocks = <&k3_clks 170 0>, <&k3_clks 16 4>;
};
