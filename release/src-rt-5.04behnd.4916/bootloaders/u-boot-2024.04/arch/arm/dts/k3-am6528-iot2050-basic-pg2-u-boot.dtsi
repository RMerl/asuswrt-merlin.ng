// SPDX-License-Identifier: GPL-2.0
/*
 * Copyright (c) Siemens AG, 2023
 *
 * Authors:
 *   Jan Kiszka <jan.kiszka@siemens.com>
 */

#include "k3-am65-iot2050-common-u-boot.dtsi"
#include "k3-am65-iot2050-common-pg2-u-boot.dtsi"
#include "k3-am65-iot2050-boot-image.dtsi"
