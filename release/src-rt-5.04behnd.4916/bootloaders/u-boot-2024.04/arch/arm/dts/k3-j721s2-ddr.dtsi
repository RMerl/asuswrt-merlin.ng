// SPDX-License-Identifier: GPL-2.0+
/*
 * Copyright (C) 2021 Texas Instruments Incorporated - https://www.ti.com/
 */

&main_navss {
	ranges = <0x00 0x00114000 0x00 0x00114000 0x00 0x00000100>, // ctrl_mmr_lpr
		 <0x00 0x02990000 0x00 0x02990000 0x00 0x00004000>, // ddr0 cfg
		 <0x00 0x029b0000 0x00 0x029b0000 0x00 0x00004000>, // ddr1 cfg
		 <0x00 0x30000000 0x00 0x30000000 0x00 0x0c400000>;

	msmc0: msmc {
		compatible = "ti,j721s2-msmc";
		intrlv-gran = <MULTI_DDR_CFG_INTRLV_GRAN>;
		intrlv-size = <MULTI_DDR_CFG_INTRLV_SIZE>;
		ecc-enable = <MULTI_DDR_CFG_ECC_ENABLE>;
		emif-config = <MULTI_DDR_CFG_HYBRID_SELECT>;
		emif-active = <MULTI_DDR_CFG_EMIFS_ACTIVE>;
		#address-cells = <2>;
		#size-cells = <2>;

		bootph-pre-ram;

		memorycontroller0: memorycontroller@2990000 {
			compatible = "ti,j721s2-ddrss";
			reg = <0x0 0x02990000 0x0 0x4000>,
			      <0x0 0x0114000 0x0 0x100>;
			reg-names = "cfg", "ctrl_mmr_lp4";
			power-domains = <&k3_pds 138 TI_SCI_PD_SHARED>,
				<&k3_pds 96 TI_SCI_PD_SHARED>;
			clocks = <&k3_clks 138 0>, <&k3_clks 43 2>;
			ti,ddr-freq0 = <DDRSS_PLL_FREQUENCY_0>;
			ti,ddr-freq1 = <DDRSS_PLL_FREQUENCY_1>;
			ti,ddr-freq2 = <DDRSS_PLL_FREQUENCY_2>;
			ti,ddr-fhs-cnt = <DDRSS_PLL_FHS_CNT>;
			instance = <0>;

			bootph-pre-ram;

			ti,ctl-data = <
				DDRSS0_CTL_00_DATA
				DDRSS0_CTL_01_DATA
				DDRSS0_CTL_02_DATA
				DDRSS0_CTL_03_DATA
				DDRSS0_CTL_04_DATA
				DDRSS0_CTL_05_DATA
				DDRSS0_CTL_06_DATA
				DDRSS0_CTL_07_DATA
				DDRSS0_CTL_08_DATA
				DDRSS0_CTL_09_DATA
				DDRSS0_CTL_10_DATA
				DDRSS0_CTL_11_DATA
				DDRSS0_CTL_12_DATA
				DDRSS0_CTL_13_DATA
				DDRSS0_CTL_14_DATA
				DDRSS0_CTL_15_DATA
				DDRSS0_CTL_16_DATA
				DDRSS0_CTL_17_DATA
				DDRSS0_CTL_18_DATA
				DDRSS0_CTL_19_DATA
				DDRSS0_CTL_20_DATA
				DDRSS0_CTL_21_DATA
				DDRSS0_CTL_22_DATA
				DDRSS0_CTL_23_DATA
				DDRSS0_CTL_24_DATA
				DDRSS0_CTL_25_DATA
				DDRSS0_CTL_26_DATA
				DDRSS0_CTL_27_DATA
				DDRSS0_CTL_28_DATA
				DDRSS0_CTL_29_DATA
				DDRSS0_CTL_30_DATA
				DDRSS0_CTL_31_DATA
				DDRSS0_CTL_32_DATA
				DDRSS0_CTL_33_DATA
				DDRSS0_CTL_34_DATA
				DDRSS0_CTL_35_DATA
				DDRSS0_CTL_36_DATA
				DDRSS0_CTL_37_DATA
				DDRSS0_CTL_38_DATA
				DDRSS0_CTL_39_DATA
				DDRSS0_CTL_40_DATA
				DDRSS0_CTL_41_DATA
				DDRSS0_CTL_42_DATA
				DDRSS0_CTL_43_DATA
				DDRSS0_CTL_44_DATA
				DDRSS0_CTL_45_DATA
				DDRSS0_CTL_46_DATA
				DDRSS0_CTL_47_DATA
				DDRSS0_CTL_48_DATA
				DDRSS0_CTL_49_DATA
				DDRSS0_CTL_50_DATA
				DDRSS0_CTL_51_DATA
				DDRSS0_CTL_52_DATA
				DDRSS0_CTL_53_DATA
				DDRSS0_CTL_54_DATA
				DDRSS0_CTL_55_DATA
				DDRSS0_CTL_56_DATA
				DDRSS0_CTL_57_DATA
				DDRSS0_CTL_58_DATA
				DDRSS0_CTL_59_DATA
				DDRSS0_CTL_60_DATA
				DDRSS0_CTL_61_DATA
				DDRSS0_CTL_62_DATA
				DDRSS0_CTL_63_DATA
				DDRSS0_CTL_64_DATA
				DDRSS0_CTL_65_DATA
				DDRSS0_CTL_66_DATA
				DDRSS0_CTL_67_DATA
				DDRSS0_CTL_68_DATA
				DDRSS0_CTL_69_DATA
				DDRSS0_CTL_70_DATA
				DDRSS0_CTL_71_DATA
				DDRSS0_CTL_72_DATA
				DDRSS0_CTL_73_DATA
				DDRSS0_CTL_74_DATA
				DDRSS0_CTL_75_DATA
				DDRSS0_CTL_76_DATA
				DDRSS0_CTL_77_DATA
				DDRSS0_CTL_78_DATA
				DDRSS0_CTL_79_DATA
				DDRSS0_CTL_80_DATA
				DDRSS0_CTL_81_DATA
				DDRSS0_CTL_82_DATA
				DDRSS0_CTL_83_DATA
				DDRSS0_CTL_84_DATA
				DDRSS0_CTL_85_DATA
				DDRSS0_CTL_86_DATA
				DDRSS0_CTL_87_DATA
				DDRSS0_CTL_88_DATA
				DDRSS0_CTL_89_DATA
				DDRSS0_CTL_90_DATA
				DDRSS0_CTL_91_DATA
				DDRSS0_CTL_92_DATA
				DDRSS0_CTL_93_DATA
				DDRSS0_CTL_94_DATA
				DDRSS0_CTL_95_DATA
				DDRSS0_CTL_96_DATA
				DDRSS0_CTL_97_DATA
				DDRSS0_CTL_98_DATA
				DDRSS0_CTL_99_DATA
				DDRSS0_CTL_100_DATA
				DDRSS0_CTL_101_DATA
				DDRSS0_CTL_102_DATA
				DDRSS0_CTL_103_DATA
				DDRSS0_CTL_104_DATA
				DDRSS0_CTL_105_DATA
				DDRSS0_CTL_106_DATA
				DDRSS0_CTL_107_DATA
				DDRSS0_CTL_108_DATA
				DDRSS0_CTL_109_DATA
				DDRSS0_CTL_110_DATA
				DDRSS0_CTL_111_DATA
				DDRSS0_CTL_112_DATA
				DDRSS0_CTL_113_DATA
				DDRSS0_CTL_114_DATA
				DDRSS0_CTL_115_DATA
				DDRSS0_CTL_116_DATA
				DDRSS0_CTL_117_DATA
				DDRSS0_CTL_118_DATA
				DDRSS0_CTL_119_DATA
				DDRSS0_CTL_120_DATA
				DDRSS0_CTL_121_DATA
				DDRSS0_CTL_122_DATA
				DDRSS0_CTL_123_DATA
				DDRSS0_CTL_124_DATA
				DDRSS0_CTL_125_DATA
				DDRSS0_CTL_126_DATA
				DDRSS0_CTL_127_DATA
				DDRSS0_CTL_128_DATA
				DDRSS0_CTL_129_DATA
				DDRSS0_CTL_130_DATA
				DDRSS0_CTL_131_DATA
				DDRSS0_CTL_132_DATA
				DDRSS0_CTL_133_DATA
				DDRSS0_CTL_134_DATA
				DDRSS0_CTL_135_DATA
				DDRSS0_CTL_136_DATA
				DDRSS0_CTL_137_DATA
				DDRSS0_CTL_138_DATA
				DDRSS0_CTL_139_DATA
				DDRSS0_CTL_140_DATA
				DDRSS0_CTL_141_DATA
				DDRSS0_CTL_142_DATA
				DDRSS0_CTL_143_DATA
				DDRSS0_CTL_144_DATA
				DDRSS0_CTL_145_DATA
				DDRSS0_CTL_146_DATA
				DDRSS0_CTL_147_DATA
				DDRSS0_CTL_148_DATA
				DDRSS0_CTL_149_DATA
				DDRSS0_CTL_150_DATA
				DDRSS0_CTL_151_DATA
				DDRSS0_CTL_152_DATA
				DDRSS0_CTL_153_DATA
				DDRSS0_CTL_154_DATA
				DDRSS0_CTL_155_DATA
				DDRSS0_CTL_156_DATA
				DDRSS0_CTL_157_DATA
				DDRSS0_CTL_158_DATA
				DDRSS0_CTL_159_DATA
				DDRSS0_CTL_160_DATA
				DDRSS0_CTL_161_DATA
				DDRSS0_CTL_162_DATA
				DDRSS0_CTL_163_DATA
				DDRSS0_CTL_164_DATA
				DDRSS0_CTL_165_DATA
				DDRSS0_CTL_166_DATA
				DDRSS0_CTL_167_DATA
				DDRSS0_CTL_168_DATA
				DDRSS0_CTL_169_DATA
				DDRSS0_CTL_170_DATA
				DDRSS0_CTL_171_DATA
				DDRSS0_CTL_172_DATA
				DDRSS0_CTL_173_DATA
				DDRSS0_CTL_174_DATA
				DDRSS0_CTL_175_DATA
				DDRSS0_CTL_176_DATA
				DDRSS0_CTL_177_DATA
				DDRSS0_CTL_178_DATA
				DDRSS0_CTL_179_DATA
				DDRSS0_CTL_180_DATA
				DDRSS0_CTL_181_DATA
				DDRSS0_CTL_182_DATA
				DDRSS0_CTL_183_DATA
				DDRSS0_CTL_184_DATA
				DDRSS0_CTL_185_DATA
				DDRSS0_CTL_186_DATA
				DDRSS0_CTL_187_DATA
				DDRSS0_CTL_188_DATA
				DDRSS0_CTL_189_DATA
				DDRSS0_CTL_190_DATA
				DDRSS0_CTL_191_DATA
				DDRSS0_CTL_192_DATA
				DDRSS0_CTL_193_DATA
				DDRSS0_CTL_194_DATA
				DDRSS0_CTL_195_DATA
				DDRSS0_CTL_196_DATA
				DDRSS0_CTL_197_DATA
				DDRSS0_CTL_198_DATA
				DDRSS0_CTL_199_DATA
				DDRSS0_CTL_200_DATA
				DDRSS0_CTL_201_DATA
				DDRSS0_CTL_202_DATA
				DDRSS0_CTL_203_DATA
				DDRSS0_CTL_204_DATA
				DDRSS0_CTL_205_DATA
				DDRSS0_CTL_206_DATA
				DDRSS0_CTL_207_DATA
				DDRSS0_CTL_208_DATA
				DDRSS0_CTL_209_DATA
				DDRSS0_CTL_210_DATA
				DDRSS0_CTL_211_DATA
				DDRSS0_CTL_212_DATA
				DDRSS0_CTL_213_DATA
				DDRSS0_CTL_214_DATA
				DDRSS0_CTL_215_DATA
				DDRSS0_CTL_216_DATA
				DDRSS0_CTL_217_DATA
				DDRSS0_CTL_218_DATA
				DDRSS0_CTL_219_DATA
				DDRSS0_CTL_220_DATA
				DDRSS0_CTL_221_DATA
				DDRSS0_CTL_222_DATA
				DDRSS0_CTL_223_DATA
				DDRSS0_CTL_224_DATA
				DDRSS0_CTL_225_DATA
				DDRSS0_CTL_226_DATA
				DDRSS0_CTL_227_DATA
				DDRSS0_CTL_228_DATA
				DDRSS0_CTL_229_DATA
				DDRSS0_CTL_230_DATA
				DDRSS0_CTL_231_DATA
				DDRSS0_CTL_232_DATA
				DDRSS0_CTL_233_DATA
				DDRSS0_CTL_234_DATA
				DDRSS0_CTL_235_DATA
				DDRSS0_CTL_236_DATA
				DDRSS0_CTL_237_DATA
				DDRSS0_CTL_238_DATA
				DDRSS0_CTL_239_DATA
				DDRSS0_CTL_240_DATA
				DDRSS0_CTL_241_DATA
				DDRSS0_CTL_242_DATA
				DDRSS0_CTL_243_DATA
				DDRSS0_CTL_244_DATA
				DDRSS0_CTL_245_DATA
				DDRSS0_CTL_246_DATA
				DDRSS0_CTL_247_DATA
				DDRSS0_CTL_248_DATA
				DDRSS0_CTL_249_DATA
				DDRSS0_CTL_250_DATA
				DDRSS0_CTL_251_DATA
				DDRSS0_CTL_252_DATA
				DDRSS0_CTL_253_DATA
				DDRSS0_CTL_254_DATA
				DDRSS0_CTL_255_DATA
				DDRSS0_CTL_256_DATA
				DDRSS0_CTL_257_DATA
				DDRSS0_CTL_258_DATA
				DDRSS0_CTL_259_DATA
				DDRSS0_CTL_260_DATA
				DDRSS0_CTL_261_DATA
				DDRSS0_CTL_262_DATA
				DDRSS0_CTL_263_DATA
				DDRSS0_CTL_264_DATA
				DDRSS0_CTL_265_DATA
				DDRSS0_CTL_266_DATA
				DDRSS0_CTL_267_DATA
				DDRSS0_CTL_268_DATA
				DDRSS0_CTL_269_DATA
				DDRSS0_CTL_270_DATA
				DDRSS0_CTL_271_DATA
				DDRSS0_CTL_272_DATA
				DDRSS0_CTL_273_DATA
				DDRSS0_CTL_274_DATA
				DDRSS0_CTL_275_DATA
				DDRSS0_CTL_276_DATA
				DDRSS0_CTL_277_DATA
				DDRSS0_CTL_278_DATA
				DDRSS0_CTL_279_DATA
				DDRSS0_CTL_280_DATA
				DDRSS0_CTL_281_DATA
				DDRSS0_CTL_282_DATA
				DDRSS0_CTL_283_DATA
				DDRSS0_CTL_284_DATA
				DDRSS0_CTL_285_DATA
				DDRSS0_CTL_286_DATA
				DDRSS0_CTL_287_DATA
				DDRSS0_CTL_288_DATA
				DDRSS0_CTL_289_DATA
				DDRSS0_CTL_290_DATA
				DDRSS0_CTL_291_DATA
				DDRSS0_CTL_292_DATA
				DDRSS0_CTL_293_DATA
				DDRSS0_CTL_294_DATA
				DDRSS0_CTL_295_DATA
				DDRSS0_CTL_296_DATA
				DDRSS0_CTL_297_DATA
				DDRSS0_CTL_298_DATA
				DDRSS0_CTL_299_DATA
				DDRSS0_CTL_300_DATA
				DDRSS0_CTL_301_DATA
				DDRSS0_CTL_302_DATA
				DDRSS0_CTL_303_DATA
				DDRSS0_CTL_304_DATA
				DDRSS0_CTL_305_DATA
				DDRSS0_CTL_306_DATA
				DDRSS0_CTL_307_DATA
				DDRSS0_CTL_308_DATA
				DDRSS0_CTL_309_DATA
				DDRSS0_CTL_310_DATA
				DDRSS0_CTL_311_DATA
				DDRSS0_CTL_312_DATA
				DDRSS0_CTL_313_DATA
				DDRSS0_CTL_314_DATA
				DDRSS0_CTL_315_DATA
				DDRSS0_CTL_316_DATA
				DDRSS0_CTL_317_DATA
				DDRSS0_CTL_318_DATA
				DDRSS0_CTL_319_DATA
				DDRSS0_CTL_320_DATA
				DDRSS0_CTL_321_DATA
				DDRSS0_CTL_322_DATA
				DDRSS0_CTL_323_DATA
				DDRSS0_CTL_324_DATA
				DDRSS0_CTL_325_DATA
				DDRSS0_CTL_326_DATA
				DDRSS0_CTL_327_DATA
				DDRSS0_CTL_328_DATA
				DDRSS0_CTL_329_DATA
				DDRSS0_CTL_330_DATA
				DDRSS0_CTL_331_DATA
				DDRSS0_CTL_332_DATA
				DDRSS0_CTL_333_DATA
				DDRSS0_CTL_334_DATA
				DDRSS0_CTL_335_DATA
				DDRSS0_CTL_336_DATA
				DDRSS0_CTL_337_DATA
				DDRSS0_CTL_338_DATA
				DDRSS0_CTL_339_DATA
				DDRSS0_CTL_340_DATA
				DDRSS0_CTL_341_DATA
				DDRSS0_CTL_342_DATA
				DDRSS0_CTL_343_DATA
				DDRSS0_CTL_344_DATA
				DDRSS0_CTL_345_DATA
				DDRSS0_CTL_346_DATA
				DDRSS0_CTL_347_DATA
				DDRSS0_CTL_348_DATA
				DDRSS0_CTL_349_DATA
				DDRSS0_CTL_350_DATA
				DDRSS0_CTL_351_DATA
				DDRSS0_CTL_352_DATA
				DDRSS0_CTL_353_DATA
				DDRSS0_CTL_354_DATA
				DDRSS0_CTL_355_DATA
				DDRSS0_CTL_356_DATA
				DDRSS0_CTL_357_DATA
				DDRSS0_CTL_358_DATA
				DDRSS0_CTL_359_DATA
				DDRSS0_CTL_360_DATA
				DDRSS0_CTL_361_DATA
				DDRSS0_CTL_362_DATA
				DDRSS0_CTL_363_DATA
				DDRSS0_CTL_364_DATA
				DDRSS0_CTL_365_DATA
				DDRSS0_CTL_366_DATA
				DDRSS0_CTL_367_DATA
				DDRSS0_CTL_368_DATA
				DDRSS0_CTL_369_DATA
				DDRSS0_CTL_370_DATA
				DDRSS0_CTL_371_DATA
				DDRSS0_CTL_372_DATA
				DDRSS0_CTL_373_DATA
				DDRSS0_CTL_374_DATA
				DDRSS0_CTL_375_DATA
				DDRSS0_CTL_376_DATA
				DDRSS0_CTL_377_DATA
				DDRSS0_CTL_378_DATA
				DDRSS0_CTL_379_DATA
				DDRSS0_CTL_380_DATA
				DDRSS0_CTL_381_DATA
				DDRSS0_CTL_382_DATA
				DDRSS0_CTL_383_DATA
				DDRSS0_CTL_384_DATA
				DDRSS0_CTL_385_DATA
				DDRSS0_CTL_386_DATA
				DDRSS0_CTL_387_DATA
				DDRSS0_CTL_388_DATA
				DDRSS0_CTL_389_DATA
				DDRSS0_CTL_390_DATA
				DDRSS0_CTL_391_DATA
				DDRSS0_CTL_392_DATA
				DDRSS0_CTL_393_DATA
				DDRSS0_CTL_394_DATA
				DDRSS0_CTL_395_DATA
				DDRSS0_CTL_396_DATA
				DDRSS0_CTL_397_DATA
				DDRSS0_CTL_398_DATA
				DDRSS0_CTL_399_DATA
				DDRSS0_CTL_400_DATA
				DDRSS0_CTL_401_DATA
				DDRSS0_CTL_402_DATA
				DDRSS0_CTL_403_DATA
				DDRSS0_CTL_404_DATA
				DDRSS0_CTL_405_DATA
				DDRSS0_CTL_406_DATA
				DDRSS0_CTL_407_DATA
				DDRSS0_CTL_408_DATA
				DDRSS0_CTL_409_DATA
				DDRSS0_CTL_410_DATA
				DDRSS0_CTL_411_DATA
				DDRSS0_CTL_412_DATA
				DDRSS0_CTL_413_DATA
				DDRSS0_CTL_414_DATA
				DDRSS0_CTL_415_DATA
				DDRSS0_CTL_416_DATA
				DDRSS0_CTL_417_DATA
				DDRSS0_CTL_418_DATA
				DDRSS0_CTL_419_DATA
				DDRSS0_CTL_420_DATA
				DDRSS0_CTL_421_DATA
				DDRSS0_CTL_422_DATA
				DDRSS0_CTL_423_DATA
				DDRSS0_CTL_424_DATA
				DDRSS0_CTL_425_DATA
				DDRSS0_CTL_426_DATA
				DDRSS0_CTL_427_DATA
				DDRSS0_CTL_428_DATA
				DDRSS0_CTL_429_DATA
				DDRSS0_CTL_430_DATA
				DDRSS0_CTL_431_DATA
				DDRSS0_CTL_432_DATA
				DDRSS0_CTL_433_DATA
				DDRSS0_CTL_434_DATA
				DDRSS0_CTL_435_DATA
				DDRSS0_CTL_436_DATA
				DDRSS0_CTL_437_DATA
				DDRSS0_CTL_438_DATA
				DDRSS0_CTL_439_DATA
				DDRSS0_CTL_440_DATA
				DDRSS0_CTL_441_DATA
				DDRSS0_CTL_442_DATA
				DDRSS0_CTL_443_DATA
				DDRSS0_CTL_444_DATA
				DDRSS0_CTL_445_DATA
				DDRSS0_CTL_446_DATA
				DDRSS0_CTL_447_DATA
				DDRSS0_CTL_448_DATA
				DDRSS0_CTL_449_DATA
				DDRSS0_CTL_450_DATA
				DDRSS0_CTL_451_DATA
				DDRSS0_CTL_452_DATA
				DDRSS0_CTL_453_DATA
				DDRSS0_CTL_454_DATA
				DDRSS0_CTL_455_DATA
				DDRSS0_CTL_456_DATA
				DDRSS0_CTL_457_DATA
				DDRSS0_CTL_458_DATA
			>;

			ti,pi-data = <
				DDRSS0_PI_00_DATA
				DDRSS0_PI_01_DATA
				DDRSS0_PI_02_DATA
				DDRSS0_PI_03_DATA
				DDRSS0_PI_04_DATA
				DDRSS0_PI_05_DATA
				DDRSS0_PI_06_DATA
				DDRSS0_PI_07_DATA
				DDRSS0_PI_08_DATA
				DDRSS0_PI_09_DATA
				DDRSS0_PI_10_DATA
				DDRSS0_PI_11_DATA
				DDRSS0_PI_12_DATA
				DDRSS0_PI_13_DATA
				DDRSS0_PI_14_DATA
				DDRSS0_PI_15_DATA
				DDRSS0_PI_16_DATA
				DDRSS0_PI_17_DATA
				DDRSS0_PI_18_DATA
				DDRSS0_PI_19_DATA
				DDRSS0_PI_20_DATA
				DDRSS0_PI_21_DATA
				DDRSS0_PI_22_DATA
				DDRSS0_PI_23_DATA
				DDRSS0_PI_24_DATA
				DDRSS0_PI_25_DATA
				DDRSS0_PI_26_DATA
				DDRSS0_PI_27_DATA
				DDRSS0_PI_28_DATA
				DDRSS0_PI_29_DATA
				DDRSS0_PI_30_DATA
				DDRSS0_PI_31_DATA
				DDRSS0_PI_32_DATA
				DDRSS0_PI_33_DATA
				DDRSS0_PI_34_DATA
				DDRSS0_PI_35_DATA
				DDRSS0_PI_36_DATA
				DDRSS0_PI_37_DATA
				DDRSS0_PI_38_DATA
				DDRSS0_PI_39_DATA
				DDRSS0_PI_40_DATA
				DDRSS0_PI_41_DATA
				DDRSS0_PI_42_DATA
				DDRSS0_PI_43_DATA
				DDRSS0_PI_44_DATA
				DDRSS0_PI_45_DATA
				DDRSS0_PI_46_DATA
				DDRSS0_PI_47_DATA
				DDRSS0_PI_48_DATA
				DDRSS0_PI_49_DATA
				DDRSS0_PI_50_DATA
				DDRSS0_PI_51_DATA
				DDRSS0_PI_52_DATA
				DDRSS0_PI_53_DATA
				DDRSS0_PI_54_DATA
				DDRSS0_PI_55_DATA
				DDRSS0_PI_56_DATA
				DDRSS0_PI_57_DATA
				DDRSS0_PI_58_DATA
				DDRSS0_PI_59_DATA
				DDRSS0_PI_60_DATA
				DDRSS0_PI_61_DATA
				DDRSS0_PI_62_DATA
				DDRSS0_PI_63_DATA
				DDRSS0_PI_64_DATA
				DDRSS0_PI_65_DATA
				DDRSS0_PI_66_DATA
				DDRSS0_PI_67_DATA
				DDRSS0_PI_68_DATA
				DDRSS0_PI_69_DATA
				DDRSS0_PI_70_DATA
				DDRSS0_PI_71_DATA
				DDRSS0_PI_72_DATA
				DDRSS0_PI_73_DATA
				DDRSS0_PI_74_DATA
				DDRSS0_PI_75_DATA
				DDRSS0_PI_76_DATA
				DDRSS0_PI_77_DATA
				DDRSS0_PI_78_DATA
				DDRSS0_PI_79_DATA
				DDRSS0_PI_80_DATA
				DDRSS0_PI_81_DATA
				DDRSS0_PI_82_DATA
				DDRSS0_PI_83_DATA
				DDRSS0_PI_84_DATA
				DDRSS0_PI_85_DATA
				DDRSS0_PI_86_DATA
				DDRSS0_PI_87_DATA
				DDRSS0_PI_88_DATA
				DDRSS0_PI_89_DATA
				DDRSS0_PI_90_DATA
				DDRSS0_PI_91_DATA
				DDRSS0_PI_92_DATA
				DDRSS0_PI_93_DATA
				DDRSS0_PI_94_DATA
				DDRSS0_PI_95_DATA
				DDRSS0_PI_96_DATA
				DDRSS0_PI_97_DATA
				DDRSS0_PI_98_DATA
				DDRSS0_PI_99_DATA
				DDRSS0_PI_100_DATA
				DDRSS0_PI_101_DATA
				DDRSS0_PI_102_DATA
				DDRSS0_PI_103_DATA
				DDRSS0_PI_104_DATA
				DDRSS0_PI_105_DATA
				DDRSS0_PI_106_DATA
				DDRSS0_PI_107_DATA
				DDRSS0_PI_108_DATA
				DDRSS0_PI_109_DATA
				DDRSS0_PI_110_DATA
				DDRSS0_PI_111_DATA
				DDRSS0_PI_112_DATA
				DDRSS0_PI_113_DATA
				DDRSS0_PI_114_DATA
				DDRSS0_PI_115_DATA
				DDRSS0_PI_116_DATA
				DDRSS0_PI_117_DATA
				DDRSS0_PI_118_DATA
				DDRSS0_PI_119_DATA
				DDRSS0_PI_120_DATA
				DDRSS0_PI_121_DATA
				DDRSS0_PI_122_DATA
				DDRSS0_PI_123_DATA
				DDRSS0_PI_124_DATA
				DDRSS0_PI_125_DATA
				DDRSS0_PI_126_DATA
				DDRSS0_PI_127_DATA
				DDRSS0_PI_128_DATA
				DDRSS0_PI_129_DATA
				DDRSS0_PI_130_DATA
				DDRSS0_PI_131_DATA
				DDRSS0_PI_132_DATA
				DDRSS0_PI_133_DATA
				DDRSS0_PI_134_DATA
				DDRSS0_PI_135_DATA
				DDRSS0_PI_136_DATA
				DDRSS0_PI_137_DATA
				DDRSS0_PI_138_DATA
				DDRSS0_PI_139_DATA
				DDRSS0_PI_140_DATA
				DDRSS0_PI_141_DATA
				DDRSS0_PI_142_DATA
				DDRSS0_PI_143_DATA
				DDRSS0_PI_144_DATA
				DDRSS0_PI_145_DATA
				DDRSS0_PI_146_DATA
				DDRSS0_PI_147_DATA
				DDRSS0_PI_148_DATA
				DDRSS0_PI_149_DATA
				DDRSS0_PI_150_DATA
				DDRSS0_PI_151_DATA
				DDRSS0_PI_152_DATA
				DDRSS0_PI_153_DATA
				DDRSS0_PI_154_DATA
				DDRSS0_PI_155_DATA
				DDRSS0_PI_156_DATA
				DDRSS0_PI_157_DATA
				DDRSS0_PI_158_DATA
				DDRSS0_PI_159_DATA
				DDRSS0_PI_160_DATA
				DDRSS0_PI_161_DATA
				DDRSS0_PI_162_DATA
				DDRSS0_PI_163_DATA
				DDRSS0_PI_164_DATA
				DDRSS0_PI_165_DATA
				DDRSS0_PI_166_DATA
				DDRSS0_PI_167_DATA
				DDRSS0_PI_168_DATA
				DDRSS0_PI_169_DATA
				DDRSS0_PI_170_DATA
				DDRSS0_PI_171_DATA
				DDRSS0_PI_172_DATA
				DDRSS0_PI_173_DATA
				DDRSS0_PI_174_DATA
				DDRSS0_PI_175_DATA
				DDRSS0_PI_176_DATA
				DDRSS0_PI_177_DATA
				DDRSS0_PI_178_DATA
				DDRSS0_PI_179_DATA
				DDRSS0_PI_180_DATA
				DDRSS0_PI_181_DATA
				DDRSS0_PI_182_DATA
				DDRSS0_PI_183_DATA
				DDRSS0_PI_184_DATA
				DDRSS0_PI_185_DATA
				DDRSS0_PI_186_DATA
				DDRSS0_PI_187_DATA
				DDRSS0_PI_188_DATA
				DDRSS0_PI_189_DATA
				DDRSS0_PI_190_DATA
				DDRSS0_PI_191_DATA
				DDRSS0_PI_192_DATA
				DDRSS0_PI_193_DATA
				DDRSS0_PI_194_DATA
				DDRSS0_PI_195_DATA
				DDRSS0_PI_196_DATA
				DDRSS0_PI_197_DATA
				DDRSS0_PI_198_DATA
				DDRSS0_PI_199_DATA
				DDRSS0_PI_200_DATA
				DDRSS0_PI_201_DATA
				DDRSS0_PI_202_DATA
				DDRSS0_PI_203_DATA
				DDRSS0_PI_204_DATA
				DDRSS0_PI_205_DATA
				DDRSS0_PI_206_DATA
				DDRSS0_PI_207_DATA
				DDRSS0_PI_208_DATA
				DDRSS0_PI_209_DATA
				DDRSS0_PI_210_DATA
				DDRSS0_PI_211_DATA
				DDRSS0_PI_212_DATA
				DDRSS0_PI_213_DATA
				DDRSS0_PI_214_DATA
				DDRSS0_PI_215_DATA
				DDRSS0_PI_216_DATA
				DDRSS0_PI_217_DATA
				DDRSS0_PI_218_DATA
				DDRSS0_PI_219_DATA
				DDRSS0_PI_220_DATA
				DDRSS0_PI_221_DATA
				DDRSS0_PI_222_DATA
				DDRSS0_PI_223_DATA
				DDRSS0_PI_224_DATA
				DDRSS0_PI_225_DATA
				DDRSS0_PI_226_DATA
				DDRSS0_PI_227_DATA
				DDRSS0_PI_228_DATA
				DDRSS0_PI_229_DATA
				DDRSS0_PI_230_DATA
				DDRSS0_PI_231_DATA
				DDRSS0_PI_232_DATA
				DDRSS0_PI_233_DATA
				DDRSS0_PI_234_DATA
				DDRSS0_PI_235_DATA
				DDRSS0_PI_236_DATA
				DDRSS0_PI_237_DATA
				DDRSS0_PI_238_DATA
				DDRSS0_PI_239_DATA
				DDRSS0_PI_240_DATA
				DDRSS0_PI_241_DATA
				DDRSS0_PI_242_DATA
				DDRSS0_PI_243_DATA
				DDRSS0_PI_244_DATA
				DDRSS0_PI_245_DATA
				DDRSS0_PI_246_DATA
				DDRSS0_PI_247_DATA
				DDRSS0_PI_248_DATA
				DDRSS0_PI_249_DATA
				DDRSS0_PI_250_DATA
				DDRSS0_PI_251_DATA
				DDRSS0_PI_252_DATA
				DDRSS0_PI_253_DATA
				DDRSS0_PI_254_DATA
				DDRSS0_PI_255_DATA
				DDRSS0_PI_256_DATA
				DDRSS0_PI_257_DATA
				DDRSS0_PI_258_DATA
				DDRSS0_PI_259_DATA
				DDRSS0_PI_260_DATA
				DDRSS0_PI_261_DATA
				DDRSS0_PI_262_DATA
				DDRSS0_PI_263_DATA
				DDRSS0_PI_264_DATA
				DDRSS0_PI_265_DATA
				DDRSS0_PI_266_DATA
				DDRSS0_PI_267_DATA
				DDRSS0_PI_268_DATA
				DDRSS0_PI_269_DATA
				DDRSS0_PI_270_DATA
				DDRSS0_PI_271_DATA
				DDRSS0_PI_272_DATA
				DDRSS0_PI_273_DATA
				DDRSS0_PI_274_DATA
				DDRSS0_PI_275_DATA
				DDRSS0_PI_276_DATA
				DDRSS0_PI_277_DATA
				DDRSS0_PI_278_DATA
				DDRSS0_PI_279_DATA
				DDRSS0_PI_280_DATA
				DDRSS0_PI_281_DATA
				DDRSS0_PI_282_DATA
				DDRSS0_PI_283_DATA
				DDRSS0_PI_284_DATA
				DDRSS0_PI_285_DATA
				DDRSS0_PI_286_DATA
				DDRSS0_PI_287_DATA
				DDRSS0_PI_288_DATA
				DDRSS0_PI_289_DATA
				DDRSS0_PI_290_DATA
				DDRSS0_PI_291_DATA
				DDRSS0_PI_292_DATA
				DDRSS0_PI_293_DATA
				DDRSS0_PI_294_DATA
				DDRSS0_PI_295_DATA
				DDRSS0_PI_296_DATA
				DDRSS0_PI_297_DATA
				DDRSS0_PI_298_DATA
				DDRSS0_PI_299_DATA
			>;

			ti,phy-data = <
				DDRSS0_PHY_00_DATA
				DDRSS0_PHY_01_DATA
				DDRSS0_PHY_02_DATA
				DDRSS0_PHY_03_DATA
				DDRSS0_PHY_04_DATA
				DDRSS0_PHY_05_DATA
				DDRSS0_PHY_06_DATA
				DDRSS0_PHY_07_DATA
				DDRSS0_PHY_08_DATA
				DDRSS0_PHY_09_DATA
				DDRSS0_PHY_10_DATA
				DDRSS0_PHY_11_DATA
				DDRSS0_PHY_12_DATA
				DDRSS0_PHY_13_DATA
				DDRSS0_PHY_14_DATA
				DDRSS0_PHY_15_DATA
				DDRSS0_PHY_16_DATA
				DDRSS0_PHY_17_DATA
				DDRSS0_PHY_18_DATA
				DDRSS0_PHY_19_DATA
				DDRSS0_PHY_20_DATA
				DDRSS0_PHY_21_DATA
				DDRSS0_PHY_22_DATA
				DDRSS0_PHY_23_DATA
				DDRSS0_PHY_24_DATA
				DDRSS0_PHY_25_DATA
				DDRSS0_PHY_26_DATA
				DDRSS0_PHY_27_DATA
				DDRSS0_PHY_28_DATA
				DDRSS0_PHY_29_DATA
				DDRSS0_PHY_30_DATA
				DDRSS0_PHY_31_DATA
				DDRSS0_PHY_32_DATA
				DDRSS0_PHY_33_DATA
				DDRSS0_PHY_34_DATA
				DDRSS0_PHY_35_DATA
				DDRSS0_PHY_36_DATA
				DDRSS0_PHY_37_DATA
				DDRSS0_PHY_38_DATA
				DDRSS0_PHY_39_DATA
				DDRSS0_PHY_40_DATA
				DDRSS0_PHY_41_DATA
				DDRSS0_PHY_42_DATA
				DDRSS0_PHY_43_DATA
				DDRSS0_PHY_44_DATA
				DDRSS0_PHY_45_DATA
				DDRSS0_PHY_46_DATA
				DDRSS0_PHY_47_DATA
				DDRSS0_PHY_48_DATA
				DDRSS0_PHY_49_DATA
				DDRSS0_PHY_50_DATA
				DDRSS0_PHY_51_DATA
				DDRSS0_PHY_52_DATA
				DDRSS0_PHY_53_DATA
				DDRSS0_PHY_54_DATA
				DDRSS0_PHY_55_DATA
				DDRSS0_PHY_56_DATA
				DDRSS0_PHY_57_DATA
				DDRSS0_PHY_58_DATA
				DDRSS0_PHY_59_DATA
				DDRSS0_PHY_60_DATA
				DDRSS0_PHY_61_DATA
				DDRSS0_PHY_62_DATA
				DDRSS0_PHY_63_DATA
				DDRSS0_PHY_64_DATA
				DDRSS0_PHY_65_DATA
				DDRSS0_PHY_66_DATA
				DDRSS0_PHY_67_DATA
				DDRSS0_PHY_68_DATA
				DDRSS0_PHY_69_DATA
				DDRSS0_PHY_70_DATA
				DDRSS0_PHY_71_DATA
				DDRSS0_PHY_72_DATA
				DDRSS0_PHY_73_DATA
				DDRSS0_PHY_74_DATA
				DDRSS0_PHY_75_DATA
				DDRSS0_PHY_76_DATA
				DDRSS0_PHY_77_DATA
				DDRSS0_PHY_78_DATA
				DDRSS0_PHY_79_DATA
				DDRSS0_PHY_80_DATA
				DDRSS0_PHY_81_DATA
				DDRSS0_PHY_82_DATA
				DDRSS0_PHY_83_DATA
				DDRSS0_PHY_84_DATA
				DDRSS0_PHY_85_DATA
				DDRSS0_PHY_86_DATA
				DDRSS0_PHY_87_DATA
				DDRSS0_PHY_88_DATA
				DDRSS0_PHY_89_DATA
				DDRSS0_PHY_90_DATA
				DDRSS0_PHY_91_DATA
				DDRSS0_PHY_92_DATA
				DDRSS0_PHY_93_DATA
				DDRSS0_PHY_94_DATA
				DDRSS0_PHY_95_DATA
				DDRSS0_PHY_96_DATA
				DDRSS0_PHY_97_DATA
				DDRSS0_PHY_98_DATA
				DDRSS0_PHY_99_DATA
				DDRSS0_PHY_100_DATA
				DDRSS0_PHY_101_DATA
				DDRSS0_PHY_102_DATA
				DDRSS0_PHY_103_DATA
				DDRSS0_PHY_104_DATA
				DDRSS0_PHY_105_DATA
				DDRSS0_PHY_106_DATA
				DDRSS0_PHY_107_DATA
				DDRSS0_PHY_108_DATA
				DDRSS0_PHY_109_DATA
				DDRSS0_PHY_110_DATA
				DDRSS0_PHY_111_DATA
				DDRSS0_PHY_112_DATA
				DDRSS0_PHY_113_DATA
				DDRSS0_PHY_114_DATA
				DDRSS0_PHY_115_DATA
				DDRSS0_PHY_116_DATA
				DDRSS0_PHY_117_DATA
				DDRSS0_PHY_118_DATA
				DDRSS0_PHY_119_DATA
				DDRSS0_PHY_120_DATA
				DDRSS0_PHY_121_DATA
				DDRSS0_PHY_122_DATA
				DDRSS0_PHY_123_DATA
				DDRSS0_PHY_124_DATA
				DDRSS0_PHY_125_DATA
				DDRSS0_PHY_126_DATA
				DDRSS0_PHY_127_DATA
				DDRSS0_PHY_128_DATA
				DDRSS0_PHY_129_DATA
				DDRSS0_PHY_130_DATA
				DDRSS0_PHY_131_DATA
				DDRSS0_PHY_132_DATA
				DDRSS0_PHY_133_DATA
				DDRSS0_PHY_134_DATA
				DDRSS0_PHY_135_DATA
				DDRSS0_PHY_136_DATA
				DDRSS0_PHY_137_DATA
				DDRSS0_PHY_138_DATA
				DDRSS0_PHY_139_DATA
				DDRSS0_PHY_140_DATA
				DDRSS0_PHY_141_DATA
				DDRSS0_PHY_142_DATA
				DDRSS0_PHY_143_DATA
				DDRSS0_PHY_144_DATA
				DDRSS0_PHY_145_DATA
				DDRSS0_PHY_146_DATA
				DDRSS0_PHY_147_DATA
				DDRSS0_PHY_148_DATA
				DDRSS0_PHY_149_DATA
				DDRSS0_PHY_150_DATA
				DDRSS0_PHY_151_DATA
				DDRSS0_PHY_152_DATA
				DDRSS0_PHY_153_DATA
				DDRSS0_PHY_154_DATA
				DDRSS0_PHY_155_DATA
				DDRSS0_PHY_156_DATA
				DDRSS0_PHY_157_DATA
				DDRSS0_PHY_158_DATA
				DDRSS0_PHY_159_DATA
				DDRSS0_PHY_160_DATA
				DDRSS0_PHY_161_DATA
				DDRSS0_PHY_162_DATA
				DDRSS0_PHY_163_DATA
				DDRSS0_PHY_164_DATA
				DDRSS0_PHY_165_DATA
				DDRSS0_PHY_166_DATA
				DDRSS0_PHY_167_DATA
				DDRSS0_PHY_168_DATA
				DDRSS0_PHY_169_DATA
				DDRSS0_PHY_170_DATA
				DDRSS0_PHY_171_DATA
				DDRSS0_PHY_172_DATA
				DDRSS0_PHY_173_DATA
				DDRSS0_PHY_174_DATA
				DDRSS0_PHY_175_DATA
				DDRSS0_PHY_176_DATA
				DDRSS0_PHY_177_DATA
				DDRSS0_PHY_178_DATA
				DDRSS0_PHY_179_DATA
				DDRSS0_PHY_180_DATA
				DDRSS0_PHY_181_DATA
				DDRSS0_PHY_182_DATA
				DDRSS0_PHY_183_DATA
				DDRSS0_PHY_184_DATA
				DDRSS0_PHY_185_DATA
				DDRSS0_PHY_186_DATA
				DDRSS0_PHY_187_DATA
				DDRSS0_PHY_188_DATA
				DDRSS0_PHY_189_DATA
				DDRSS0_PHY_190_DATA
				DDRSS0_PHY_191_DATA
				DDRSS0_PHY_192_DATA
				DDRSS0_PHY_193_DATA
				DDRSS0_PHY_194_DATA
				DDRSS0_PHY_195_DATA
				DDRSS0_PHY_196_DATA
				DDRSS0_PHY_197_DATA
				DDRSS0_PHY_198_DATA
				DDRSS0_PHY_199_DATA
				DDRSS0_PHY_200_DATA
				DDRSS0_PHY_201_DATA
				DDRSS0_PHY_202_DATA
				DDRSS0_PHY_203_DATA
				DDRSS0_PHY_204_DATA
				DDRSS0_PHY_205_DATA
				DDRSS0_PHY_206_DATA
				DDRSS0_PHY_207_DATA
				DDRSS0_PHY_208_DATA
				DDRSS0_PHY_209_DATA
				DDRSS0_PHY_210_DATA
				DDRSS0_PHY_211_DATA
				DDRSS0_PHY_212_DATA
				DDRSS0_PHY_213_DATA
				DDRSS0_PHY_214_DATA
				DDRSS0_PHY_215_DATA
				DDRSS0_PHY_216_DATA
				DDRSS0_PHY_217_DATA
				DDRSS0_PHY_218_DATA
				DDRSS0_PHY_219_DATA
				DDRSS0_PHY_220_DATA
				DDRSS0_PHY_221_DATA
				DDRSS0_PHY_222_DATA
				DDRSS0_PHY_223_DATA
				DDRSS0_PHY_224_DATA
				DDRSS0_PHY_225_DATA
				DDRSS0_PHY_226_DATA
				DDRSS0_PHY_227_DATA
				DDRSS0_PHY_228_DATA
				DDRSS0_PHY_229_DATA
				DDRSS0_PHY_230_DATA
				DDRSS0_PHY_231_DATA
				DDRSS0_PHY_232_DATA
				DDRSS0_PHY_233_DATA
				DDRSS0_PHY_234_DATA
				DDRSS0_PHY_235_DATA
				DDRSS0_PHY_236_DATA
				DDRSS0_PHY_237_DATA
				DDRSS0_PHY_238_DATA
				DDRSS0_PHY_239_DATA
				DDRSS0_PHY_240_DATA
				DDRSS0_PHY_241_DATA
				DDRSS0_PHY_242_DATA
				DDRSS0_PHY_243_DATA
				DDRSS0_PHY_244_DATA
				DDRSS0_PHY_245_DATA
				DDRSS0_PHY_246_DATA
				DDRSS0_PHY_247_DATA
				DDRSS0_PHY_248_DATA
				DDRSS0_PHY_249_DATA
				DDRSS0_PHY_250_DATA
				DDRSS0_PHY_251_DATA
				DDRSS0_PHY_252_DATA
				DDRSS0_PHY_253_DATA
				DDRSS0_PHY_254_DATA
				DDRSS0_PHY_255_DATA
				DDRSS0_PHY_256_DATA
				DDRSS0_PHY_257_DATA
				DDRSS0_PHY_258_DATA
				DDRSS0_PHY_259_DATA
				DDRSS0_PHY_260_DATA
				DDRSS0_PHY_261_DATA
				DDRSS0_PHY_262_DATA
				DDRSS0_PHY_263_DATA
				DDRSS0_PHY_264_DATA
				DDRSS0_PHY_265_DATA
				DDRSS0_PHY_266_DATA
				DDRSS0_PHY_267_DATA
				DDRSS0_PHY_268_DATA
				DDRSS0_PHY_269_DATA
				DDRSS0_PHY_270_DATA
				DDRSS0_PHY_271_DATA
				DDRSS0_PHY_272_DATA
				DDRSS0_PHY_273_DATA
				DDRSS0_PHY_274_DATA
				DDRSS0_PHY_275_DATA
				DDRSS0_PHY_276_DATA
				DDRSS0_PHY_277_DATA
				DDRSS0_PHY_278_DATA
				DDRSS0_PHY_279_DATA
				DDRSS0_PHY_280_DATA
				DDRSS0_PHY_281_DATA
				DDRSS0_PHY_282_DATA
				DDRSS0_PHY_283_DATA
				DDRSS0_PHY_284_DATA
				DDRSS0_PHY_285_DATA
				DDRSS0_PHY_286_DATA
				DDRSS0_PHY_287_DATA
				DDRSS0_PHY_288_DATA
				DDRSS0_PHY_289_DATA
				DDRSS0_PHY_290_DATA
				DDRSS0_PHY_291_DATA
				DDRSS0_PHY_292_DATA
				DDRSS0_PHY_293_DATA
				DDRSS0_PHY_294_DATA
				DDRSS0_PHY_295_DATA
				DDRSS0_PHY_296_DATA
				DDRSS0_PHY_297_DATA
				DDRSS0_PHY_298_DATA
				DDRSS0_PHY_299_DATA
				DDRSS0_PHY_300_DATA
				DDRSS0_PHY_301_DATA
				DDRSS0_PHY_302_DATA
				DDRSS0_PHY_303_DATA
				DDRSS0_PHY_304_DATA
				DDRSS0_PHY_305_DATA
				DDRSS0_PHY_306_DATA
				DDRSS0_PHY_307_DATA
				DDRSS0_PHY_308_DATA
				DDRSS0_PHY_309_DATA
				DDRSS0_PHY_310_DATA
				DDRSS0_PHY_311_DATA
				DDRSS0_PHY_312_DATA
				DDRSS0_PHY_313_DATA
				DDRSS0_PHY_314_DATA
				DDRSS0_PHY_315_DATA
				DDRSS0_PHY_316_DATA
				DDRSS0_PHY_317_DATA
				DDRSS0_PHY_318_DATA
				DDRSS0_PHY_319_DATA
				DDRSS0_PHY_320_DATA
				DDRSS0_PHY_321_DATA
				DDRSS0_PHY_322_DATA
				DDRSS0_PHY_323_DATA
				DDRSS0_PHY_324_DATA
				DDRSS0_PHY_325_DATA
				DDRSS0_PHY_326_DATA
				DDRSS0_PHY_327_DATA
				DDRSS0_PHY_328_DATA
				DDRSS0_PHY_329_DATA
				DDRSS0_PHY_330_DATA
				DDRSS0_PHY_331_DATA
				DDRSS0_PHY_332_DATA
				DDRSS0_PHY_333_DATA
				DDRSS0_PHY_334_DATA
				DDRSS0_PHY_335_DATA
				DDRSS0_PHY_336_DATA
				DDRSS0_PHY_337_DATA
				DDRSS0_PHY_338_DATA
				DDRSS0_PHY_339_DATA
				DDRSS0_PHY_340_DATA
				DDRSS0_PHY_341_DATA
				DDRSS0_PHY_342_DATA
				DDRSS0_PHY_343_DATA
				DDRSS0_PHY_344_DATA
				DDRSS0_PHY_345_DATA
				DDRSS0_PHY_346_DATA
				DDRSS0_PHY_347_DATA
				DDRSS0_PHY_348_DATA
				DDRSS0_PHY_349_DATA
				DDRSS0_PHY_350_DATA
				DDRSS0_PHY_351_DATA
				DDRSS0_PHY_352_DATA
				DDRSS0_PHY_353_DATA
				DDRSS0_PHY_354_DATA
				DDRSS0_PHY_355_DATA
				DDRSS0_PHY_356_DATA
				DDRSS0_PHY_357_DATA
				DDRSS0_PHY_358_DATA
				DDRSS0_PHY_359_DATA
				DDRSS0_PHY_360_DATA
				DDRSS0_PHY_361_DATA
				DDRSS0_PHY_362_DATA
				DDRSS0_PHY_363_DATA
				DDRSS0_PHY_364_DATA
				DDRSS0_PHY_365_DATA
				DDRSS0_PHY_366_DATA
				DDRSS0_PHY_367_DATA
				DDRSS0_PHY_368_DATA
				DDRSS0_PHY_369_DATA
				DDRSS0_PHY_370_DATA
				DDRSS0_PHY_371_DATA
				DDRSS0_PHY_372_DATA
				DDRSS0_PHY_373_DATA
				DDRSS0_PHY_374_DATA
				DDRSS0_PHY_375_DATA
				DDRSS0_PHY_376_DATA
				DDRSS0_PHY_377_DATA
				DDRSS0_PHY_378_DATA
				DDRSS0_PHY_379_DATA
				DDRSS0_PHY_380_DATA
				DDRSS0_PHY_381_DATA
				DDRSS0_PHY_382_DATA
				DDRSS0_PHY_383_DATA
				DDRSS0_PHY_384_DATA
				DDRSS0_PHY_385_DATA
				DDRSS0_PHY_386_DATA
				DDRSS0_PHY_387_DATA
				DDRSS0_PHY_388_DATA
				DDRSS0_PHY_389_DATA
				DDRSS0_PHY_390_DATA
				DDRSS0_PHY_391_DATA
				DDRSS0_PHY_392_DATA
				DDRSS0_PHY_393_DATA
				DDRSS0_PHY_394_DATA
				DDRSS0_PHY_395_DATA
				DDRSS0_PHY_396_DATA
				DDRSS0_PHY_397_DATA
				DDRSS0_PHY_398_DATA
				DDRSS0_PHY_399_DATA
				DDRSS0_PHY_400_DATA
				DDRSS0_PHY_401_DATA
				DDRSS0_PHY_402_DATA
				DDRSS0_PHY_403_DATA
				DDRSS0_PHY_404_DATA
				DDRSS0_PHY_405_DATA
				DDRSS0_PHY_406_DATA
				DDRSS0_PHY_407_DATA
				DDRSS0_PHY_408_DATA
				DDRSS0_PHY_409_DATA
				DDRSS0_PHY_410_DATA
				DDRSS0_PHY_411_DATA
				DDRSS0_PHY_412_DATA
				DDRSS0_PHY_413_DATA
				DDRSS0_PHY_414_DATA
				DDRSS0_PHY_415_DATA
				DDRSS0_PHY_416_DATA
				DDRSS0_PHY_417_DATA
				DDRSS0_PHY_418_DATA
				DDRSS0_PHY_419_DATA
				DDRSS0_PHY_420_DATA
				DDRSS0_PHY_421_DATA
				DDRSS0_PHY_422_DATA
				DDRSS0_PHY_423_DATA
				DDRSS0_PHY_424_DATA
				DDRSS0_PHY_425_DATA
				DDRSS0_PHY_426_DATA
				DDRSS0_PHY_427_DATA
				DDRSS0_PHY_428_DATA
				DDRSS0_PHY_429_DATA
				DDRSS0_PHY_430_DATA
				DDRSS0_PHY_431_DATA
				DDRSS0_PHY_432_DATA
				DDRSS0_PHY_433_DATA
				DDRSS0_PHY_434_DATA
				DDRSS0_PHY_435_DATA
				DDRSS0_PHY_436_DATA
				DDRSS0_PHY_437_DATA
				DDRSS0_PHY_438_DATA
				DDRSS0_PHY_439_DATA
				DDRSS0_PHY_440_DATA
				DDRSS0_PHY_441_DATA
				DDRSS0_PHY_442_DATA
				DDRSS0_PHY_443_DATA
				DDRSS0_PHY_444_DATA
				DDRSS0_PHY_445_DATA
				DDRSS0_PHY_446_DATA
				DDRSS0_PHY_447_DATA
				DDRSS0_PHY_448_DATA
				DDRSS0_PHY_449_DATA
				DDRSS0_PHY_450_DATA
				DDRSS0_PHY_451_DATA
				DDRSS0_PHY_452_DATA
				DDRSS0_PHY_453_DATA
				DDRSS0_PHY_454_DATA
				DDRSS0_PHY_455_DATA
				DDRSS0_PHY_456_DATA
				DDRSS0_PHY_457_DATA
				DDRSS0_PHY_458_DATA
				DDRSS0_PHY_459_DATA
				DDRSS0_PHY_460_DATA
				DDRSS0_PHY_461_DATA
				DDRSS0_PHY_462_DATA
				DDRSS0_PHY_463_DATA
				DDRSS0_PHY_464_DATA
				DDRSS0_PHY_465_DATA
				DDRSS0_PHY_466_DATA
				DDRSS0_PHY_467_DATA
				DDRSS0_PHY_468_DATA
				DDRSS0_PHY_469_DATA
				DDRSS0_PHY_470_DATA
				DDRSS0_PHY_471_DATA
				DDRSS0_PHY_472_DATA
				DDRSS0_PHY_473_DATA
				DDRSS0_PHY_474_DATA
				DDRSS0_PHY_475_DATA
				DDRSS0_PHY_476_DATA
				DDRSS0_PHY_477_DATA
				DDRSS0_PHY_478_DATA
				DDRSS0_PHY_479_DATA
				DDRSS0_PHY_480_DATA
				DDRSS0_PHY_481_DATA
				DDRSS0_PHY_482_DATA
				DDRSS0_PHY_483_DATA
				DDRSS0_PHY_484_DATA
				DDRSS0_PHY_485_DATA
				DDRSS0_PHY_486_DATA
				DDRSS0_PHY_487_DATA
				DDRSS0_PHY_488_DATA
				DDRSS0_PHY_489_DATA
				DDRSS0_PHY_490_DATA
				DDRSS0_PHY_491_DATA
				DDRSS0_PHY_492_DATA
				DDRSS0_PHY_493_DATA
				DDRSS0_PHY_494_DATA
				DDRSS0_PHY_495_DATA
				DDRSS0_PHY_496_DATA
				DDRSS0_PHY_497_DATA
				DDRSS0_PHY_498_DATA
				DDRSS0_PHY_499_DATA
				DDRSS0_PHY_500_DATA
				DDRSS0_PHY_501_DATA
				DDRSS0_PHY_502_DATA
				DDRSS0_PHY_503_DATA
				DDRSS0_PHY_504_DATA
				DDRSS0_PHY_505_DATA
				DDRSS0_PHY_506_DATA
				DDRSS0_PHY_507_DATA
				DDRSS0_PHY_508_DATA
				DDRSS0_PHY_509_DATA
				DDRSS0_PHY_510_DATA
				DDRSS0_PHY_511_DATA
				DDRSS0_PHY_512_DATA
				DDRSS0_PHY_513_DATA
				DDRSS0_PHY_514_DATA
				DDRSS0_PHY_515_DATA
				DDRSS0_PHY_516_DATA
				DDRSS0_PHY_517_DATA
				DDRSS0_PHY_518_DATA
				DDRSS0_PHY_519_DATA
				DDRSS0_PHY_520_DATA
				DDRSS0_PHY_521_DATA
				DDRSS0_PHY_522_DATA
				DDRSS0_PHY_523_DATA
				DDRSS0_PHY_524_DATA
				DDRSS0_PHY_525_DATA
				DDRSS0_PHY_526_DATA
				DDRSS0_PHY_527_DATA
				DDRSS0_PHY_528_DATA
				DDRSS0_PHY_529_DATA
				DDRSS0_PHY_530_DATA
				DDRSS0_PHY_531_DATA
				DDRSS0_PHY_532_DATA
				DDRSS0_PHY_533_DATA
				DDRSS0_PHY_534_DATA
				DDRSS0_PHY_535_DATA
				DDRSS0_PHY_536_DATA
				DDRSS0_PHY_537_DATA
				DDRSS0_PHY_538_DATA
				DDRSS0_PHY_539_DATA
				DDRSS0_PHY_540_DATA
				DDRSS0_PHY_541_DATA
				DDRSS0_PHY_542_DATA
				DDRSS0_PHY_543_DATA
				DDRSS0_PHY_544_DATA
				DDRSS0_PHY_545_DATA
				DDRSS0_PHY_546_DATA
				DDRSS0_PHY_547_DATA
				DDRSS0_PHY_548_DATA
				DDRSS0_PHY_549_DATA
				DDRSS0_PHY_550_DATA
				DDRSS0_PHY_551_DATA
				DDRSS0_PHY_552_DATA
				DDRSS0_PHY_553_DATA
				DDRSS0_PHY_554_DATA
				DDRSS0_PHY_555_DATA
				DDRSS0_PHY_556_DATA
				DDRSS0_PHY_557_DATA
				DDRSS0_PHY_558_DATA
				DDRSS0_PHY_559_DATA
				DDRSS0_PHY_560_DATA
				DDRSS0_PHY_561_DATA
				DDRSS0_PHY_562_DATA
				DDRSS0_PHY_563_DATA
				DDRSS0_PHY_564_DATA
				DDRSS0_PHY_565_DATA
				DDRSS0_PHY_566_DATA
				DDRSS0_PHY_567_DATA
				DDRSS0_PHY_568_DATA
				DDRSS0_PHY_569_DATA
				DDRSS0_PHY_570_DATA
				DDRSS0_PHY_571_DATA
				DDRSS0_PHY_572_DATA
				DDRSS0_PHY_573_DATA
				DDRSS0_PHY_574_DATA
				DDRSS0_PHY_575_DATA
				DDRSS0_PHY_576_DATA
				DDRSS0_PHY_577_DATA
				DDRSS0_PHY_578_DATA
				DDRSS0_PHY_579_DATA
				DDRSS0_PHY_580_DATA
				DDRSS0_PHY_581_DATA
				DDRSS0_PHY_582_DATA
				DDRSS0_PHY_583_DATA
				DDRSS0_PHY_584_DATA
				DDRSS0_PHY_585_DATA
				DDRSS0_PHY_586_DATA
				DDRSS0_PHY_587_DATA
				DDRSS0_PHY_588_DATA
				DDRSS0_PHY_589_DATA
				DDRSS0_PHY_590_DATA
				DDRSS0_PHY_591_DATA
				DDRSS0_PHY_592_DATA
				DDRSS0_PHY_593_DATA
				DDRSS0_PHY_594_DATA
				DDRSS0_PHY_595_DATA
				DDRSS0_PHY_596_DATA
				DDRSS0_PHY_597_DATA
				DDRSS0_PHY_598_DATA
				DDRSS0_PHY_599_DATA
				DDRSS0_PHY_600_DATA
				DDRSS0_PHY_601_DATA
				DDRSS0_PHY_602_DATA
				DDRSS0_PHY_603_DATA
				DDRSS0_PHY_604_DATA
				DDRSS0_PHY_605_DATA
				DDRSS0_PHY_606_DATA
				DDRSS0_PHY_607_DATA
				DDRSS0_PHY_608_DATA
				DDRSS0_PHY_609_DATA
				DDRSS0_PHY_610_DATA
				DDRSS0_PHY_611_DATA
				DDRSS0_PHY_612_DATA
				DDRSS0_PHY_613_DATA
				DDRSS0_PHY_614_DATA
				DDRSS0_PHY_615_DATA
				DDRSS0_PHY_616_DATA
				DDRSS0_PHY_617_DATA
				DDRSS0_PHY_618_DATA
				DDRSS0_PHY_619_DATA
				DDRSS0_PHY_620_DATA
				DDRSS0_PHY_621_DATA
				DDRSS0_PHY_622_DATA
				DDRSS0_PHY_623_DATA
				DDRSS0_PHY_624_DATA
				DDRSS0_PHY_625_DATA
				DDRSS0_PHY_626_DATA
				DDRSS0_PHY_627_DATA
				DDRSS0_PHY_628_DATA
				DDRSS0_PHY_629_DATA
				DDRSS0_PHY_630_DATA
				DDRSS0_PHY_631_DATA
				DDRSS0_PHY_632_DATA
				DDRSS0_PHY_633_DATA
				DDRSS0_PHY_634_DATA
				DDRSS0_PHY_635_DATA
				DDRSS0_PHY_636_DATA
				DDRSS0_PHY_637_DATA
				DDRSS0_PHY_638_DATA
				DDRSS0_PHY_639_DATA
				DDRSS0_PHY_640_DATA
				DDRSS0_PHY_641_DATA
				DDRSS0_PHY_642_DATA
				DDRSS0_PHY_643_DATA
				DDRSS0_PHY_644_DATA
				DDRSS0_PHY_645_DATA
				DDRSS0_PHY_646_DATA
				DDRSS0_PHY_647_DATA
				DDRSS0_PHY_648_DATA
				DDRSS0_PHY_649_DATA
				DDRSS0_PHY_650_DATA
				DDRSS0_PHY_651_DATA
				DDRSS0_PHY_652_DATA
				DDRSS0_PHY_653_DATA
				DDRSS0_PHY_654_DATA
				DDRSS0_PHY_655_DATA
				DDRSS0_PHY_656_DATA
				DDRSS0_PHY_657_DATA
				DDRSS0_PHY_658_DATA
				DDRSS0_PHY_659_DATA
				DDRSS0_PHY_660_DATA
				DDRSS0_PHY_661_DATA
				DDRSS0_PHY_662_DATA
				DDRSS0_PHY_663_DATA
				DDRSS0_PHY_664_DATA
				DDRSS0_PHY_665_DATA
				DDRSS0_PHY_666_DATA
				DDRSS0_PHY_667_DATA
				DDRSS0_PHY_668_DATA
				DDRSS0_PHY_669_DATA
				DDRSS0_PHY_670_DATA
				DDRSS0_PHY_671_DATA
				DDRSS0_PHY_672_DATA
				DDRSS0_PHY_673_DATA
				DDRSS0_PHY_674_DATA
				DDRSS0_PHY_675_DATA
				DDRSS0_PHY_676_DATA
				DDRSS0_PHY_677_DATA
				DDRSS0_PHY_678_DATA
				DDRSS0_PHY_679_DATA
				DDRSS0_PHY_680_DATA
				DDRSS0_PHY_681_DATA
				DDRSS0_PHY_682_DATA
				DDRSS0_PHY_683_DATA
				DDRSS0_PHY_684_DATA
				DDRSS0_PHY_685_DATA
				DDRSS0_PHY_686_DATA
				DDRSS0_PHY_687_DATA
				DDRSS0_PHY_688_DATA
				DDRSS0_PHY_689_DATA
				DDRSS0_PHY_690_DATA
				DDRSS0_PHY_691_DATA
				DDRSS0_PHY_692_DATA
				DDRSS0_PHY_693_DATA
				DDRSS0_PHY_694_DATA
				DDRSS0_PHY_695_DATA
				DDRSS0_PHY_696_DATA
				DDRSS0_PHY_697_DATA
				DDRSS0_PHY_698_DATA
				DDRSS0_PHY_699_DATA
				DDRSS0_PHY_700_DATA
				DDRSS0_PHY_701_DATA
				DDRSS0_PHY_702_DATA
				DDRSS0_PHY_703_DATA
				DDRSS0_PHY_704_DATA
				DDRSS0_PHY_705_DATA
				DDRSS0_PHY_706_DATA
				DDRSS0_PHY_707_DATA
				DDRSS0_PHY_708_DATA
				DDRSS0_PHY_709_DATA
				DDRSS0_PHY_710_DATA
				DDRSS0_PHY_711_DATA
				DDRSS0_PHY_712_DATA
				DDRSS0_PHY_713_DATA
				DDRSS0_PHY_714_DATA
				DDRSS0_PHY_715_DATA
				DDRSS0_PHY_716_DATA
				DDRSS0_PHY_717_DATA
				DDRSS0_PHY_718_DATA
				DDRSS0_PHY_719_DATA
				DDRSS0_PHY_720_DATA
				DDRSS0_PHY_721_DATA
				DDRSS0_PHY_722_DATA
				DDRSS0_PHY_723_DATA
				DDRSS0_PHY_724_DATA
				DDRSS0_PHY_725_DATA
				DDRSS0_PHY_726_DATA
				DDRSS0_PHY_727_DATA
				DDRSS0_PHY_728_DATA
				DDRSS0_PHY_729_DATA
				DDRSS0_PHY_730_DATA
				DDRSS0_PHY_731_DATA
				DDRSS0_PHY_732_DATA
				DDRSS0_PHY_733_DATA
				DDRSS0_PHY_734_DATA
				DDRSS0_PHY_735_DATA
				DDRSS0_PHY_736_DATA
				DDRSS0_PHY_737_DATA
				DDRSS0_PHY_738_DATA
				DDRSS0_PHY_739_DATA
				DDRSS0_PHY_740_DATA
				DDRSS0_PHY_741_DATA
				DDRSS0_PHY_742_DATA
				DDRSS0_PHY_743_DATA
				DDRSS0_PHY_744_DATA
				DDRSS0_PHY_745_DATA
				DDRSS0_PHY_746_DATA
				DDRSS0_PHY_747_DATA
				DDRSS0_PHY_748_DATA
				DDRSS0_PHY_749_DATA
				DDRSS0_PHY_750_DATA
				DDRSS0_PHY_751_DATA
				DDRSS0_PHY_752_DATA
				DDRSS0_PHY_753_DATA
				DDRSS0_PHY_754_DATA
				DDRSS0_PHY_755_DATA
				DDRSS0_PHY_756_DATA
				DDRSS0_PHY_757_DATA
				DDRSS0_PHY_758_DATA
				DDRSS0_PHY_759_DATA
				DDRSS0_PHY_760_DATA
				DDRSS0_PHY_761_DATA
				DDRSS0_PHY_762_DATA
				DDRSS0_PHY_763_DATA
				DDRSS0_PHY_764_DATA
				DDRSS0_PHY_765_DATA
				DDRSS0_PHY_766_DATA
				DDRSS0_PHY_767_DATA
				DDRSS0_PHY_768_DATA
				DDRSS0_PHY_769_DATA
				DDRSS0_PHY_770_DATA
				DDRSS0_PHY_771_DATA
				DDRSS0_PHY_772_DATA
				DDRSS0_PHY_773_DATA
				DDRSS0_PHY_774_DATA
				DDRSS0_PHY_775_DATA
				DDRSS0_PHY_776_DATA
				DDRSS0_PHY_777_DATA
				DDRSS0_PHY_778_DATA
				DDRSS0_PHY_779_DATA
				DDRSS0_PHY_780_DATA
				DDRSS0_PHY_781_DATA
				DDRSS0_PHY_782_DATA
				DDRSS0_PHY_783_DATA
				DDRSS0_PHY_784_DATA
				DDRSS0_PHY_785_DATA
				DDRSS0_PHY_786_DATA
				DDRSS0_PHY_787_DATA
				DDRSS0_PHY_788_DATA
				DDRSS0_PHY_789_DATA
				DDRSS0_PHY_790_DATA
				DDRSS0_PHY_791_DATA
				DDRSS0_PHY_792_DATA
				DDRSS0_PHY_793_DATA
				DDRSS0_PHY_794_DATA
				DDRSS0_PHY_795_DATA
				DDRSS0_PHY_796_DATA
				DDRSS0_PHY_797_DATA
				DDRSS0_PHY_798_DATA
				DDRSS0_PHY_799_DATA
				DDRSS0_PHY_800_DATA
				DDRSS0_PHY_801_DATA
				DDRSS0_PHY_802_DATA
				DDRSS0_PHY_803_DATA
				DDRSS0_PHY_804_DATA
				DDRSS0_PHY_805_DATA
				DDRSS0_PHY_806_DATA
				DDRSS0_PHY_807_DATA
				DDRSS0_PHY_808_DATA
				DDRSS0_PHY_809_DATA
				DDRSS0_PHY_810_DATA
				DDRSS0_PHY_811_DATA
				DDRSS0_PHY_812_DATA
				DDRSS0_PHY_813_DATA
				DDRSS0_PHY_814_DATA
				DDRSS0_PHY_815_DATA
				DDRSS0_PHY_816_DATA
				DDRSS0_PHY_817_DATA
				DDRSS0_PHY_818_DATA
				DDRSS0_PHY_819_DATA
				DDRSS0_PHY_820_DATA
				DDRSS0_PHY_821_DATA
				DDRSS0_PHY_822_DATA
				DDRSS0_PHY_823_DATA
				DDRSS0_PHY_824_DATA
				DDRSS0_PHY_825_DATA
				DDRSS0_PHY_826_DATA
				DDRSS0_PHY_827_DATA
				DDRSS0_PHY_828_DATA
				DDRSS0_PHY_829_DATA
				DDRSS0_PHY_830_DATA
				DDRSS0_PHY_831_DATA
				DDRSS0_PHY_832_DATA
				DDRSS0_PHY_833_DATA
				DDRSS0_PHY_834_DATA
				DDRSS0_PHY_835_DATA
				DDRSS0_PHY_836_DATA
				DDRSS0_PHY_837_DATA
				DDRSS0_PHY_838_DATA
				DDRSS0_PHY_839_DATA
				DDRSS0_PHY_840_DATA
				DDRSS0_PHY_841_DATA
				DDRSS0_PHY_842_DATA
				DDRSS0_PHY_843_DATA
				DDRSS0_PHY_844_DATA
				DDRSS0_PHY_845_DATA
				DDRSS0_PHY_846_DATA
				DDRSS0_PHY_847_DATA
				DDRSS0_PHY_848_DATA
				DDRSS0_PHY_849_DATA
				DDRSS0_PHY_850_DATA
				DDRSS0_PHY_851_DATA
				DDRSS0_PHY_852_DATA
				DDRSS0_PHY_853_DATA
				DDRSS0_PHY_854_DATA
				DDRSS0_PHY_855_DATA
				DDRSS0_PHY_856_DATA
				DDRSS0_PHY_857_DATA
				DDRSS0_PHY_858_DATA
				DDRSS0_PHY_859_DATA
				DDRSS0_PHY_860_DATA
				DDRSS0_PHY_861_DATA
				DDRSS0_PHY_862_DATA
				DDRSS0_PHY_863_DATA
				DDRSS0_PHY_864_DATA
				DDRSS0_PHY_865_DATA
				DDRSS0_PHY_866_DATA
				DDRSS0_PHY_867_DATA
				DDRSS0_PHY_868_DATA
				DDRSS0_PHY_869_DATA
				DDRSS0_PHY_870_DATA
				DDRSS0_PHY_871_DATA
				DDRSS0_PHY_872_DATA
				DDRSS0_PHY_873_DATA
				DDRSS0_PHY_874_DATA
				DDRSS0_PHY_875_DATA
				DDRSS0_PHY_876_DATA
				DDRSS0_PHY_877_DATA
				DDRSS0_PHY_878_DATA
				DDRSS0_PHY_879_DATA
				DDRSS0_PHY_880_DATA
				DDRSS0_PHY_881_DATA
				DDRSS0_PHY_882_DATA
				DDRSS0_PHY_883_DATA
				DDRSS0_PHY_884_DATA
				DDRSS0_PHY_885_DATA
				DDRSS0_PHY_886_DATA
				DDRSS0_PHY_887_DATA
				DDRSS0_PHY_888_DATA
				DDRSS0_PHY_889_DATA
				DDRSS0_PHY_890_DATA
				DDRSS0_PHY_891_DATA
				DDRSS0_PHY_892_DATA
				DDRSS0_PHY_893_DATA
				DDRSS0_PHY_894_DATA
				DDRSS0_PHY_895_DATA
				DDRSS0_PHY_896_DATA
				DDRSS0_PHY_897_DATA
				DDRSS0_PHY_898_DATA
				DDRSS0_PHY_899_DATA
				DDRSS0_PHY_900_DATA
				DDRSS0_PHY_901_DATA
				DDRSS0_PHY_902_DATA
				DDRSS0_PHY_903_DATA
				DDRSS0_PHY_904_DATA
				DDRSS0_PHY_905_DATA
				DDRSS0_PHY_906_DATA
				DDRSS0_PHY_907_DATA
				DDRSS0_PHY_908_DATA
				DDRSS0_PHY_909_DATA
				DDRSS0_PHY_910_DATA
				DDRSS0_PHY_911_DATA
				DDRSS0_PHY_912_DATA
				DDRSS0_PHY_913_DATA
				DDRSS0_PHY_914_DATA
				DDRSS0_PHY_915_DATA
				DDRSS0_PHY_916_DATA
				DDRSS0_PHY_917_DATA
				DDRSS0_PHY_918_DATA
				DDRSS0_PHY_919_DATA
				DDRSS0_PHY_920_DATA
				DDRSS0_PHY_921_DATA
				DDRSS0_PHY_922_DATA
				DDRSS0_PHY_923_DATA
				DDRSS0_PHY_924_DATA
				DDRSS0_PHY_925_DATA
				DDRSS0_PHY_926_DATA
				DDRSS0_PHY_927_DATA
				DDRSS0_PHY_928_DATA
				DDRSS0_PHY_929_DATA
				DDRSS0_PHY_930_DATA
				DDRSS0_PHY_931_DATA
				DDRSS0_PHY_932_DATA
				DDRSS0_PHY_933_DATA
				DDRSS0_PHY_934_DATA
				DDRSS0_PHY_935_DATA
				DDRSS0_PHY_936_DATA
				DDRSS0_PHY_937_DATA
				DDRSS0_PHY_938_DATA
				DDRSS0_PHY_939_DATA
				DDRSS0_PHY_940_DATA
				DDRSS0_PHY_941_DATA
				DDRSS0_PHY_942_DATA
				DDRSS0_PHY_943_DATA
				DDRSS0_PHY_944_DATA
				DDRSS0_PHY_945_DATA
				DDRSS0_PHY_946_DATA
				DDRSS0_PHY_947_DATA
				DDRSS0_PHY_948_DATA
				DDRSS0_PHY_949_DATA
				DDRSS0_PHY_950_DATA
				DDRSS0_PHY_951_DATA
				DDRSS0_PHY_952_DATA
				DDRSS0_PHY_953_DATA
				DDRSS0_PHY_954_DATA
				DDRSS0_PHY_955_DATA
				DDRSS0_PHY_956_DATA
				DDRSS0_PHY_957_DATA
				DDRSS0_PHY_958_DATA
				DDRSS0_PHY_959_DATA
				DDRSS0_PHY_960_DATA
				DDRSS0_PHY_961_DATA
				DDRSS0_PHY_962_DATA
				DDRSS0_PHY_963_DATA
				DDRSS0_PHY_964_DATA
				DDRSS0_PHY_965_DATA
				DDRSS0_PHY_966_DATA
				DDRSS0_PHY_967_DATA
				DDRSS0_PHY_968_DATA
				DDRSS0_PHY_969_DATA
				DDRSS0_PHY_970_DATA
				DDRSS0_PHY_971_DATA
				DDRSS0_PHY_972_DATA
				DDRSS0_PHY_973_DATA
				DDRSS0_PHY_974_DATA
				DDRSS0_PHY_975_DATA
				DDRSS0_PHY_976_DATA
				DDRSS0_PHY_977_DATA
				DDRSS0_PHY_978_DATA
				DDRSS0_PHY_979_DATA
				DDRSS0_PHY_980_DATA
				DDRSS0_PHY_981_DATA
				DDRSS0_PHY_982_DATA
				DDRSS0_PHY_983_DATA
				DDRSS0_PHY_984_DATA
				DDRSS0_PHY_985_DATA
				DDRSS0_PHY_986_DATA
				DDRSS0_PHY_987_DATA
				DDRSS0_PHY_988_DATA
				DDRSS0_PHY_989_DATA
				DDRSS0_PHY_990_DATA
				DDRSS0_PHY_991_DATA
				DDRSS0_PHY_992_DATA
				DDRSS0_PHY_993_DATA
				DDRSS0_PHY_994_DATA
				DDRSS0_PHY_995_DATA
				DDRSS0_PHY_996_DATA
				DDRSS0_PHY_997_DATA
				DDRSS0_PHY_998_DATA
				DDRSS0_PHY_999_DATA
				DDRSS0_PHY_1000_DATA
				DDRSS0_PHY_1001_DATA
				DDRSS0_PHY_1002_DATA
				DDRSS0_PHY_1003_DATA
				DDRSS0_PHY_1004_DATA
				DDRSS0_PHY_1005_DATA
				DDRSS0_PHY_1006_DATA
				DDRSS0_PHY_1007_DATA
				DDRSS0_PHY_1008_DATA
				DDRSS0_PHY_1009_DATA
				DDRSS0_PHY_1010_DATA
				DDRSS0_PHY_1011_DATA
				DDRSS0_PHY_1012_DATA
				DDRSS0_PHY_1013_DATA
				DDRSS0_PHY_1014_DATA
				DDRSS0_PHY_1015_DATA
				DDRSS0_PHY_1016_DATA
				DDRSS0_PHY_1017_DATA
				DDRSS0_PHY_1018_DATA
				DDRSS0_PHY_1019_DATA
				DDRSS0_PHY_1020_DATA
				DDRSS0_PHY_1021_DATA
				DDRSS0_PHY_1022_DATA
				DDRSS0_PHY_1023_DATA
				DDRSS0_PHY_1024_DATA
				DDRSS0_PHY_1025_DATA
				DDRSS0_PHY_1026_DATA
				DDRSS0_PHY_1027_DATA
				DDRSS0_PHY_1028_DATA
				DDRSS0_PHY_1029_DATA
				DDRSS0_PHY_1030_DATA
				DDRSS0_PHY_1031_DATA
				DDRSS0_PHY_1032_DATA
				DDRSS0_PHY_1033_DATA
				DDRSS0_PHY_1034_DATA
				DDRSS0_PHY_1035_DATA
				DDRSS0_PHY_1036_DATA
				DDRSS0_PHY_1037_DATA
				DDRSS0_PHY_1038_DATA
				DDRSS0_PHY_1039_DATA
				DDRSS0_PHY_1040_DATA
				DDRSS0_PHY_1041_DATA
				DDRSS0_PHY_1042_DATA
				DDRSS0_PHY_1043_DATA
				DDRSS0_PHY_1044_DATA
				DDRSS0_PHY_1045_DATA
				DDRSS0_PHY_1046_DATA
				DDRSS0_PHY_1047_DATA
				DDRSS0_PHY_1048_DATA
				DDRSS0_PHY_1049_DATA
				DDRSS0_PHY_1050_DATA
				DDRSS0_PHY_1051_DATA
				DDRSS0_PHY_1052_DATA
				DDRSS0_PHY_1053_DATA
				DDRSS0_PHY_1054_DATA
				DDRSS0_PHY_1055_DATA
				DDRSS0_PHY_1056_DATA
				DDRSS0_PHY_1057_DATA
				DDRSS0_PHY_1058_DATA
				DDRSS0_PHY_1059_DATA
				DDRSS0_PHY_1060_DATA
				DDRSS0_PHY_1061_DATA
				DDRSS0_PHY_1062_DATA
				DDRSS0_PHY_1063_DATA
				DDRSS0_PHY_1064_DATA
				DDRSS0_PHY_1065_DATA
				DDRSS0_PHY_1066_DATA
				DDRSS0_PHY_1067_DATA
				DDRSS0_PHY_1068_DATA
				DDRSS0_PHY_1069_DATA
				DDRSS0_PHY_1070_DATA
				DDRSS0_PHY_1071_DATA
				DDRSS0_PHY_1072_DATA
				DDRSS0_PHY_1073_DATA
				DDRSS0_PHY_1074_DATA
				DDRSS0_PHY_1075_DATA
				DDRSS0_PHY_1076_DATA
				DDRSS0_PHY_1077_DATA
				DDRSS0_PHY_1078_DATA
				DDRSS0_PHY_1079_DATA
				DDRSS0_PHY_1080_DATA
				DDRSS0_PHY_1081_DATA
				DDRSS0_PHY_1082_DATA
				DDRSS0_PHY_1083_DATA
				DDRSS0_PHY_1084_DATA
				DDRSS0_PHY_1085_DATA
				DDRSS0_PHY_1086_DATA
				DDRSS0_PHY_1087_DATA
				DDRSS0_PHY_1088_DATA
				DDRSS0_PHY_1089_DATA
				DDRSS0_PHY_1090_DATA
				DDRSS0_PHY_1091_DATA
				DDRSS0_PHY_1092_DATA
				DDRSS0_PHY_1093_DATA
				DDRSS0_PHY_1094_DATA
				DDRSS0_PHY_1095_DATA
				DDRSS0_PHY_1096_DATA
				DDRSS0_PHY_1097_DATA
				DDRSS0_PHY_1098_DATA
				DDRSS0_PHY_1099_DATA
				DDRSS0_PHY_1100_DATA
				DDRSS0_PHY_1101_DATA
				DDRSS0_PHY_1102_DATA
				DDRSS0_PHY_1103_DATA
				DDRSS0_PHY_1104_DATA
				DDRSS0_PHY_1105_DATA
				DDRSS0_PHY_1106_DATA
				DDRSS0_PHY_1107_DATA
				DDRSS0_PHY_1108_DATA
				DDRSS0_PHY_1109_DATA
				DDRSS0_PHY_1110_DATA
				DDRSS0_PHY_1111_DATA
				DDRSS0_PHY_1112_DATA
				DDRSS0_PHY_1113_DATA
				DDRSS0_PHY_1114_DATA
				DDRSS0_PHY_1115_DATA
				DDRSS0_PHY_1116_DATA
				DDRSS0_PHY_1117_DATA
				DDRSS0_PHY_1118_DATA
				DDRSS0_PHY_1119_DATA
				DDRSS0_PHY_1120_DATA
				DDRSS0_PHY_1121_DATA
				DDRSS0_PHY_1122_DATA
				DDRSS0_PHY_1123_DATA
				DDRSS0_PHY_1124_DATA
				DDRSS0_PHY_1125_DATA
				DDRSS0_PHY_1126_DATA
				DDRSS0_PHY_1127_DATA
				DDRSS0_PHY_1128_DATA
				DDRSS0_PHY_1129_DATA
				DDRSS0_PHY_1130_DATA
				DDRSS0_PHY_1131_DATA
				DDRSS0_PHY_1132_DATA
				DDRSS0_PHY_1133_DATA
				DDRSS0_PHY_1134_DATA
				DDRSS0_PHY_1135_DATA
				DDRSS0_PHY_1136_DATA
				DDRSS0_PHY_1137_DATA
				DDRSS0_PHY_1138_DATA
				DDRSS0_PHY_1139_DATA
				DDRSS0_PHY_1140_DATA
				DDRSS0_PHY_1141_DATA
				DDRSS0_PHY_1142_DATA
				DDRSS0_PHY_1143_DATA
				DDRSS0_PHY_1144_DATA
				DDRSS0_PHY_1145_DATA
				DDRSS0_PHY_1146_DATA
				DDRSS0_PHY_1147_DATA
				DDRSS0_PHY_1148_DATA
				DDRSS0_PHY_1149_DATA
				DDRSS0_PHY_1150_DATA
				DDRSS0_PHY_1151_DATA
				DDRSS0_PHY_1152_DATA
				DDRSS0_PHY_1153_DATA
				DDRSS0_PHY_1154_DATA
				DDRSS0_PHY_1155_DATA
				DDRSS0_PHY_1156_DATA
				DDRSS0_PHY_1157_DATA
				DDRSS0_PHY_1158_DATA
				DDRSS0_PHY_1159_DATA
				DDRSS0_PHY_1160_DATA
				DDRSS0_PHY_1161_DATA
				DDRSS0_PHY_1162_DATA
				DDRSS0_PHY_1163_DATA
				DDRSS0_PHY_1164_DATA
				DDRSS0_PHY_1165_DATA
				DDRSS0_PHY_1166_DATA
				DDRSS0_PHY_1167_DATA
				DDRSS0_PHY_1168_DATA
				DDRSS0_PHY_1169_DATA
				DDRSS0_PHY_1170_DATA
				DDRSS0_PHY_1171_DATA
				DDRSS0_PHY_1172_DATA
				DDRSS0_PHY_1173_DATA
				DDRSS0_PHY_1174_DATA
				DDRSS0_PHY_1175_DATA
				DDRSS0_PHY_1176_DATA
				DDRSS0_PHY_1177_DATA
				DDRSS0_PHY_1178_DATA
				DDRSS0_PHY_1179_DATA
				DDRSS0_PHY_1180_DATA
				DDRSS0_PHY_1181_DATA
				DDRSS0_PHY_1182_DATA
				DDRSS0_PHY_1183_DATA
				DDRSS0_PHY_1184_DATA
				DDRSS0_PHY_1185_DATA
				DDRSS0_PHY_1186_DATA
				DDRSS0_PHY_1187_DATA
				DDRSS0_PHY_1188_DATA
				DDRSS0_PHY_1189_DATA
				DDRSS0_PHY_1190_DATA
				DDRSS0_PHY_1191_DATA
				DDRSS0_PHY_1192_DATA
				DDRSS0_PHY_1193_DATA
				DDRSS0_PHY_1194_DATA
				DDRSS0_PHY_1195_DATA
				DDRSS0_PHY_1196_DATA
				DDRSS0_PHY_1197_DATA
				DDRSS0_PHY_1198_DATA
				DDRSS0_PHY_1199_DATA
				DDRSS0_PHY_1200_DATA
				DDRSS0_PHY_1201_DATA
				DDRSS0_PHY_1202_DATA
				DDRSS0_PHY_1203_DATA
				DDRSS0_PHY_1204_DATA
				DDRSS0_PHY_1205_DATA
				DDRSS0_PHY_1206_DATA
				DDRSS0_PHY_1207_DATA
				DDRSS0_PHY_1208_DATA
				DDRSS0_PHY_1209_DATA
				DDRSS0_PHY_1210_DATA
				DDRSS0_PHY_1211_DATA
				DDRSS0_PHY_1212_DATA
				DDRSS0_PHY_1213_DATA
				DDRSS0_PHY_1214_DATA
				DDRSS0_PHY_1215_DATA
				DDRSS0_PHY_1216_DATA
				DDRSS0_PHY_1217_DATA
				DDRSS0_PHY_1218_DATA
				DDRSS0_PHY_1219_DATA
				DDRSS0_PHY_1220_DATA
				DDRSS0_PHY_1221_DATA
				DDRSS0_PHY_1222_DATA
				DDRSS0_PHY_1223_DATA
				DDRSS0_PHY_1224_DATA
				DDRSS0_PHY_1225_DATA
				DDRSS0_PHY_1226_DATA
				DDRSS0_PHY_1227_DATA
				DDRSS0_PHY_1228_DATA
				DDRSS0_PHY_1229_DATA
				DDRSS0_PHY_1230_DATA
				DDRSS0_PHY_1231_DATA
				DDRSS0_PHY_1232_DATA
				DDRSS0_PHY_1233_DATA
				DDRSS0_PHY_1234_DATA
				DDRSS0_PHY_1235_DATA
				DDRSS0_PHY_1236_DATA
				DDRSS0_PHY_1237_DATA
				DDRSS0_PHY_1238_DATA
				DDRSS0_PHY_1239_DATA
				DDRSS0_PHY_1240_DATA
				DDRSS0_PHY_1241_DATA
				DDRSS0_PHY_1242_DATA
				DDRSS0_PHY_1243_DATA
				DDRSS0_PHY_1244_DATA
				DDRSS0_PHY_1245_DATA
				DDRSS0_PHY_1246_DATA
				DDRSS0_PHY_1247_DATA
				DDRSS0_PHY_1248_DATA
				DDRSS0_PHY_1249_DATA
				DDRSS0_PHY_1250_DATA
				DDRSS0_PHY_1251_DATA
				DDRSS0_PHY_1252_DATA
				DDRSS0_PHY_1253_DATA
				DDRSS0_PHY_1254_DATA
				DDRSS0_PHY_1255_DATA
				DDRSS0_PHY_1256_DATA
				DDRSS0_PHY_1257_DATA
				DDRSS0_PHY_1258_DATA
				DDRSS0_PHY_1259_DATA
				DDRSS0_PHY_1260_DATA
				DDRSS0_PHY_1261_DATA
				DDRSS0_PHY_1262_DATA
				DDRSS0_PHY_1263_DATA
				DDRSS0_PHY_1264_DATA
				DDRSS0_PHY_1265_DATA
				DDRSS0_PHY_1266_DATA
				DDRSS0_PHY_1267_DATA
				DDRSS0_PHY_1268_DATA
				DDRSS0_PHY_1269_DATA
				DDRSS0_PHY_1270_DATA
				DDRSS0_PHY_1271_DATA
				DDRSS0_PHY_1272_DATA
				DDRSS0_PHY_1273_DATA
				DDRSS0_PHY_1274_DATA
				DDRSS0_PHY_1275_DATA
				DDRSS0_PHY_1276_DATA
				DDRSS0_PHY_1277_DATA
				DDRSS0_PHY_1278_DATA
				DDRSS0_PHY_1279_DATA
				DDRSS0_PHY_1280_DATA
				DDRSS0_PHY_1281_DATA
				DDRSS0_PHY_1282_DATA
				DDRSS0_PHY_1283_DATA
				DDRSS0_PHY_1284_DATA
				DDRSS0_PHY_1285_DATA
				DDRSS0_PHY_1286_DATA
				DDRSS0_PHY_1287_DATA
				DDRSS0_PHY_1288_DATA
				DDRSS0_PHY_1289_DATA
				DDRSS0_PHY_1290_DATA
				DDRSS0_PHY_1291_DATA
				DDRSS0_PHY_1292_DATA
				DDRSS0_PHY_1293_DATA
				DDRSS0_PHY_1294_DATA
				DDRSS0_PHY_1295_DATA
				DDRSS0_PHY_1296_DATA
				DDRSS0_PHY_1297_DATA
				DDRSS0_PHY_1298_DATA
				DDRSS0_PHY_1299_DATA
				DDRSS0_PHY_1300_DATA
				DDRSS0_PHY_1301_DATA
				DDRSS0_PHY_1302_DATA
				DDRSS0_PHY_1303_DATA
				DDRSS0_PHY_1304_DATA
				DDRSS0_PHY_1305_DATA
				DDRSS0_PHY_1306_DATA
				DDRSS0_PHY_1307_DATA
				DDRSS0_PHY_1308_DATA
				DDRSS0_PHY_1309_DATA
				DDRSS0_PHY_1310_DATA
				DDRSS0_PHY_1311_DATA
				DDRSS0_PHY_1312_DATA
				DDRSS0_PHY_1313_DATA
				DDRSS0_PHY_1314_DATA
				DDRSS0_PHY_1315_DATA
				DDRSS0_PHY_1316_DATA
				DDRSS0_PHY_1317_DATA
				DDRSS0_PHY_1318_DATA
				DDRSS0_PHY_1319_DATA
				DDRSS0_PHY_1320_DATA
				DDRSS0_PHY_1321_DATA
				DDRSS0_PHY_1322_DATA
				DDRSS0_PHY_1323_DATA
				DDRSS0_PHY_1324_DATA
				DDRSS0_PHY_1325_DATA
				DDRSS0_PHY_1326_DATA
				DDRSS0_PHY_1327_DATA
				DDRSS0_PHY_1328_DATA
				DDRSS0_PHY_1329_DATA
				DDRSS0_PHY_1330_DATA
				DDRSS0_PHY_1331_DATA
				DDRSS0_PHY_1332_DATA
				DDRSS0_PHY_1333_DATA
				DDRSS0_PHY_1334_DATA
				DDRSS0_PHY_1335_DATA
				DDRSS0_PHY_1336_DATA
				DDRSS0_PHY_1337_DATA
				DDRSS0_PHY_1338_DATA
				DDRSS0_PHY_1339_DATA
				DDRSS0_PHY_1340_DATA
				DDRSS0_PHY_1341_DATA
				DDRSS0_PHY_1342_DATA
				DDRSS0_PHY_1343_DATA
				DDRSS0_PHY_1344_DATA
				DDRSS0_PHY_1345_DATA
				DDRSS0_PHY_1346_DATA
				DDRSS0_PHY_1347_DATA
				DDRSS0_PHY_1348_DATA
				DDRSS0_PHY_1349_DATA
				DDRSS0_PHY_1350_DATA
				DDRSS0_PHY_1351_DATA
				DDRSS0_PHY_1352_DATA
				DDRSS0_PHY_1353_DATA
				DDRSS0_PHY_1354_DATA
				DDRSS0_PHY_1355_DATA
				DDRSS0_PHY_1356_DATA
				DDRSS0_PHY_1357_DATA
				DDRSS0_PHY_1358_DATA
				DDRSS0_PHY_1359_DATA
				DDRSS0_PHY_1360_DATA
				DDRSS0_PHY_1361_DATA
				DDRSS0_PHY_1362_DATA
				DDRSS0_PHY_1363_DATA
				DDRSS0_PHY_1364_DATA
				DDRSS0_PHY_1365_DATA
				DDRSS0_PHY_1366_DATA
				DDRSS0_PHY_1367_DATA
				DDRSS0_PHY_1368_DATA
				DDRSS0_PHY_1369_DATA
				DDRSS0_PHY_1370_DATA
				DDRSS0_PHY_1371_DATA
				DDRSS0_PHY_1372_DATA
				DDRSS0_PHY_1373_DATA
				DDRSS0_PHY_1374_DATA
				DDRSS0_PHY_1375_DATA
				DDRSS0_PHY_1376_DATA
				DDRSS0_PHY_1377_DATA
				DDRSS0_PHY_1378_DATA
				DDRSS0_PHY_1379_DATA
				DDRSS0_PHY_1380_DATA
				DDRSS0_PHY_1381_DATA
				DDRSS0_PHY_1382_DATA
				DDRSS0_PHY_1383_DATA
				DDRSS0_PHY_1384_DATA
				DDRSS0_PHY_1385_DATA
				DDRSS0_PHY_1386_DATA
				DDRSS0_PHY_1387_DATA
				DDRSS0_PHY_1388_DATA
				DDRSS0_PHY_1389_DATA
				DDRSS0_PHY_1390_DATA
				DDRSS0_PHY_1391_DATA
				DDRSS0_PHY_1392_DATA
				DDRSS0_PHY_1393_DATA
				DDRSS0_PHY_1394_DATA
				DDRSS0_PHY_1395_DATA
				DDRSS0_PHY_1396_DATA
				DDRSS0_PHY_1397_DATA
				DDRSS0_PHY_1398_DATA
				DDRSS0_PHY_1399_DATA
				DDRSS0_PHY_1400_DATA
				DDRSS0_PHY_1401_DATA
				DDRSS0_PHY_1402_DATA
				DDRSS0_PHY_1403_DATA
				DDRSS0_PHY_1404_DATA
				DDRSS0_PHY_1405_DATA
				DDRSS0_PHY_1406_DATA
				DDRSS0_PHY_1407_DATA
				DDRSS0_PHY_1408_DATA
				DDRSS0_PHY_1409_DATA
				DDRSS0_PHY_1410_DATA
				DDRSS0_PHY_1411_DATA
				DDRSS0_PHY_1412_DATA
				DDRSS0_PHY_1413_DATA
				DDRSS0_PHY_1414_DATA
				DDRSS0_PHY_1415_DATA
				DDRSS0_PHY_1416_DATA
				DDRSS0_PHY_1417_DATA
				DDRSS0_PHY_1418_DATA
				DDRSS0_PHY_1419_DATA
				DDRSS0_PHY_1420_DATA
				DDRSS0_PHY_1421_DATA
				DDRSS0_PHY_1422_DATA
			>;
		};

		memorycontroller1: memorycontroller@29b0000 {
			compatible = "ti,j721s2-ddrss";
			reg = <0x0 0x029b0000 0x0 0x4000>,
			      <0x0 0x0114000 0x0 0x100>;
			reg-names = "cfg", "ctrl_mmr_lp4";
			power-domains = <&k3_pds 139 TI_SCI_PD_SHARED>,
				<&k3_pds 97 TI_SCI_PD_SHARED>;
			clocks = <&k3_clks 139 0>, <&k3_clks 43 2>;
			ti,ddr-freq0 = <DDRSS_PLL_FREQUENCY_0>;
			ti,ddr-freq1 = <DDRSS_PLL_FREQUENCY_1>;
			ti,ddr-freq2 = <DDRSS_PLL_FREQUENCY_2>;
			ti,ddr-fhs-cnt = <DDRSS_PLL_FHS_CNT>;
			instance = <1>;

			bootph-pre-ram;

			ti,ctl-data = <
				DDRSS1_CTL_00_DATA
				DDRSS1_CTL_01_DATA
				DDRSS1_CTL_02_DATA
				DDRSS1_CTL_03_DATA
				DDRSS1_CTL_04_DATA
				DDRSS1_CTL_05_DATA
				DDRSS1_CTL_06_DATA
				DDRSS1_CTL_07_DATA
				DDRSS1_CTL_08_DATA
				DDRSS1_CTL_09_DATA
				DDRSS1_CTL_10_DATA
				DDRSS1_CTL_11_DATA
				DDRSS1_CTL_12_DATA
				DDRSS1_CTL_13_DATA
				DDRSS1_CTL_14_DATA
				DDRSS1_CTL_15_DATA
				DDRSS1_CTL_16_DATA
				DDRSS1_CTL_17_DATA
				DDRSS1_CTL_18_DATA
				DDRSS1_CTL_19_DATA
				DDRSS1_CTL_20_DATA
				DDRSS1_CTL_21_DATA
				DDRSS1_CTL_22_DATA
				DDRSS1_CTL_23_DATA
				DDRSS1_CTL_24_DATA
				DDRSS1_CTL_25_DATA
				DDRSS1_CTL_26_DATA
				DDRSS1_CTL_27_DATA
				DDRSS1_CTL_28_DATA
				DDRSS1_CTL_29_DATA
				DDRSS1_CTL_30_DATA
				DDRSS1_CTL_31_DATA
				DDRSS1_CTL_32_DATA
				DDRSS1_CTL_33_DATA
				DDRSS1_CTL_34_DATA
				DDRSS1_CTL_35_DATA
				DDRSS1_CTL_36_DATA
				DDRSS1_CTL_37_DATA
				DDRSS1_CTL_38_DATA
				DDRSS1_CTL_39_DATA
				DDRSS1_CTL_40_DATA
				DDRSS1_CTL_41_DATA
				DDRSS1_CTL_42_DATA
				DDRSS1_CTL_43_DATA
				DDRSS1_CTL_44_DATA
				DDRSS1_CTL_45_DATA
				DDRSS1_CTL_46_DATA
				DDRSS1_CTL_47_DATA
				DDRSS1_CTL_48_DATA
				DDRSS1_CTL_49_DATA
				DDRSS1_CTL_50_DATA
				DDRSS1_CTL_51_DATA
				DDRSS1_CTL_52_DATA
				DDRSS1_CTL_53_DATA
				DDRSS1_CTL_54_DATA
				DDRSS1_CTL_55_DATA
				DDRSS1_CTL_56_DATA
				DDRSS1_CTL_57_DATA
				DDRSS1_CTL_58_DATA
				DDRSS1_CTL_59_DATA
				DDRSS1_CTL_60_DATA
				DDRSS1_CTL_61_DATA
				DDRSS1_CTL_62_DATA
				DDRSS1_CTL_63_DATA
				DDRSS1_CTL_64_DATA
				DDRSS1_CTL_65_DATA
				DDRSS1_CTL_66_DATA
				DDRSS1_CTL_67_DATA
				DDRSS1_CTL_68_DATA
				DDRSS1_CTL_69_DATA
				DDRSS1_CTL_70_DATA
				DDRSS1_CTL_71_DATA
				DDRSS1_CTL_72_DATA
				DDRSS1_CTL_73_DATA
				DDRSS1_CTL_74_DATA
				DDRSS1_CTL_75_DATA
				DDRSS1_CTL_76_DATA
				DDRSS1_CTL_77_DATA
				DDRSS1_CTL_78_DATA
				DDRSS1_CTL_79_DATA
				DDRSS1_CTL_80_DATA
				DDRSS1_CTL_81_DATA
				DDRSS1_CTL_82_DATA
				DDRSS1_CTL_83_DATA
				DDRSS1_CTL_84_DATA
				DDRSS1_CTL_85_DATA
				DDRSS1_CTL_86_DATA
				DDRSS1_CTL_87_DATA
				DDRSS1_CTL_88_DATA
				DDRSS1_CTL_89_DATA
				DDRSS1_CTL_90_DATA
				DDRSS1_CTL_91_DATA
				DDRSS1_CTL_92_DATA
				DDRSS1_CTL_93_DATA
				DDRSS1_CTL_94_DATA
				DDRSS1_CTL_95_DATA
				DDRSS1_CTL_96_DATA
				DDRSS1_CTL_97_DATA
				DDRSS1_CTL_98_DATA
				DDRSS1_CTL_99_DATA
				DDRSS1_CTL_100_DATA
				DDRSS1_CTL_101_DATA
				DDRSS1_CTL_102_DATA
				DDRSS1_CTL_103_DATA
				DDRSS1_CTL_104_DATA
				DDRSS1_CTL_105_DATA
				DDRSS1_CTL_106_DATA
				DDRSS1_CTL_107_DATA
				DDRSS1_CTL_108_DATA
				DDRSS1_CTL_109_DATA
				DDRSS1_CTL_110_DATA
				DDRSS1_CTL_111_DATA
				DDRSS1_CTL_112_DATA
				DDRSS1_CTL_113_DATA
				DDRSS1_CTL_114_DATA
				DDRSS1_CTL_115_DATA
				DDRSS1_CTL_116_DATA
				DDRSS1_CTL_117_DATA
				DDRSS1_CTL_118_DATA
				DDRSS1_CTL_119_DATA
				DDRSS1_CTL_120_DATA
				DDRSS1_CTL_121_DATA
				DDRSS1_CTL_122_DATA
				DDRSS1_CTL_123_DATA
				DDRSS1_CTL_124_DATA
				DDRSS1_CTL_125_DATA
				DDRSS1_CTL_126_DATA
				DDRSS1_CTL_127_DATA
				DDRSS1_CTL_128_DATA
				DDRSS1_CTL_129_DATA
				DDRSS1_CTL_130_DATA
				DDRSS1_CTL_131_DATA
				DDRSS1_CTL_132_DATA
				DDRSS1_CTL_133_DATA
				DDRSS1_CTL_134_DATA
				DDRSS1_CTL_135_DATA
				DDRSS1_CTL_136_DATA
				DDRSS1_CTL_137_DATA
				DDRSS1_CTL_138_DATA
				DDRSS1_CTL_139_DATA
				DDRSS1_CTL_140_DATA
				DDRSS1_CTL_141_DATA
				DDRSS1_CTL_142_DATA
				DDRSS1_CTL_143_DATA
				DDRSS1_CTL_144_DATA
				DDRSS1_CTL_145_DATA
				DDRSS1_CTL_146_DATA
				DDRSS1_CTL_147_DATA
				DDRSS1_CTL_148_DATA
				DDRSS1_CTL_149_DATA
				DDRSS1_CTL_150_DATA
				DDRSS1_CTL_151_DATA
				DDRSS1_CTL_152_DATA
				DDRSS1_CTL_153_DATA
				DDRSS1_CTL_154_DATA
				DDRSS1_CTL_155_DATA
				DDRSS1_CTL_156_DATA
				DDRSS1_CTL_157_DATA
				DDRSS1_CTL_158_DATA
				DDRSS1_CTL_159_DATA
				DDRSS1_CTL_160_DATA
				DDRSS1_CTL_161_DATA
				DDRSS1_CTL_162_DATA
				DDRSS1_CTL_163_DATA
				DDRSS1_CTL_164_DATA
				DDRSS1_CTL_165_DATA
				DDRSS1_CTL_166_DATA
				DDRSS1_CTL_167_DATA
				DDRSS1_CTL_168_DATA
				DDRSS1_CTL_169_DATA
				DDRSS1_CTL_170_DATA
				DDRSS1_CTL_171_DATA
				DDRSS1_CTL_172_DATA
				DDRSS1_CTL_173_DATA
				DDRSS1_CTL_174_DATA
				DDRSS1_CTL_175_DATA
				DDRSS1_CTL_176_DATA
				DDRSS1_CTL_177_DATA
				DDRSS1_CTL_178_DATA
				DDRSS1_CTL_179_DATA
				DDRSS1_CTL_180_DATA
				DDRSS1_CTL_181_DATA
				DDRSS1_CTL_182_DATA
				DDRSS1_CTL_183_DATA
				DDRSS1_CTL_184_DATA
				DDRSS1_CTL_185_DATA
				DDRSS1_CTL_186_DATA
				DDRSS1_CTL_187_DATA
				DDRSS1_CTL_188_DATA
				DDRSS1_CTL_189_DATA
				DDRSS1_CTL_190_DATA
				DDRSS1_CTL_191_DATA
				DDRSS1_CTL_192_DATA
				DDRSS1_CTL_193_DATA
				DDRSS1_CTL_194_DATA
				DDRSS1_CTL_195_DATA
				DDRSS1_CTL_196_DATA
				DDRSS1_CTL_197_DATA
				DDRSS1_CTL_198_DATA
				DDRSS1_CTL_199_DATA
				DDRSS1_CTL_200_DATA
				DDRSS1_CTL_201_DATA
				DDRSS1_CTL_202_DATA
				DDRSS1_CTL_203_DATA
				DDRSS1_CTL_204_DATA
				DDRSS1_CTL_205_DATA
				DDRSS1_CTL_206_DATA
				DDRSS1_CTL_207_DATA
				DDRSS1_CTL_208_DATA
				DDRSS1_CTL_209_DATA
				DDRSS1_CTL_210_DATA
				DDRSS1_CTL_211_DATA
				DDRSS1_CTL_212_DATA
				DDRSS1_CTL_213_DATA
				DDRSS1_CTL_214_DATA
				DDRSS1_CTL_215_DATA
				DDRSS1_CTL_216_DATA
				DDRSS1_CTL_217_DATA
				DDRSS1_CTL_218_DATA
				DDRSS1_CTL_219_DATA
				DDRSS1_CTL_220_DATA
				DDRSS1_CTL_221_DATA
				DDRSS1_CTL_222_DATA
				DDRSS1_CTL_223_DATA
				DDRSS1_CTL_224_DATA
				DDRSS1_CTL_225_DATA
				DDRSS1_CTL_226_DATA
				DDRSS1_CTL_227_DATA
				DDRSS1_CTL_228_DATA
				DDRSS1_CTL_229_DATA
				DDRSS1_CTL_230_DATA
				DDRSS1_CTL_231_DATA
				DDRSS1_CTL_232_DATA
				DDRSS1_CTL_233_DATA
				DDRSS1_CTL_234_DATA
				DDRSS1_CTL_235_DATA
				DDRSS1_CTL_236_DATA
				DDRSS1_CTL_237_DATA
				DDRSS1_CTL_238_DATA
				DDRSS1_CTL_239_DATA
				DDRSS1_CTL_240_DATA
				DDRSS1_CTL_241_DATA
				DDRSS1_CTL_242_DATA
				DDRSS1_CTL_243_DATA
				DDRSS1_CTL_244_DATA
				DDRSS1_CTL_245_DATA
				DDRSS1_CTL_246_DATA
				DDRSS1_CTL_247_DATA
				DDRSS1_CTL_248_DATA
				DDRSS1_CTL_249_DATA
				DDRSS1_CTL_250_DATA
				DDRSS1_CTL_251_DATA
				DDRSS1_CTL_252_DATA
				DDRSS1_CTL_253_DATA
				DDRSS1_CTL_254_DATA
				DDRSS1_CTL_255_DATA
				DDRSS1_CTL_256_DATA
				DDRSS1_CTL_257_DATA
				DDRSS1_CTL_258_DATA
				DDRSS1_CTL_259_DATA
				DDRSS1_CTL_260_DATA
				DDRSS1_CTL_261_DATA
				DDRSS1_CTL_262_DATA
				DDRSS1_CTL_263_DATA
				DDRSS1_CTL_264_DATA
				DDRSS1_CTL_265_DATA
				DDRSS1_CTL_266_DATA
				DDRSS1_CTL_267_DATA
				DDRSS1_CTL_268_DATA
				DDRSS1_CTL_269_DATA
				DDRSS1_CTL_270_DATA
				DDRSS1_CTL_271_DATA
				DDRSS1_CTL_272_DATA
				DDRSS1_CTL_273_DATA
				DDRSS1_CTL_274_DATA
				DDRSS1_CTL_275_DATA
				DDRSS1_CTL_276_DATA
				DDRSS1_CTL_277_DATA
				DDRSS1_CTL_278_DATA
				DDRSS1_CTL_279_DATA
				DDRSS1_CTL_280_DATA
				DDRSS1_CTL_281_DATA
				DDRSS1_CTL_282_DATA
				DDRSS1_CTL_283_DATA
				DDRSS1_CTL_284_DATA
				DDRSS1_CTL_285_DATA
				DDRSS1_CTL_286_DATA
				DDRSS1_CTL_287_DATA
				DDRSS1_CTL_288_DATA
				DDRSS1_CTL_289_DATA
				DDRSS1_CTL_290_DATA
				DDRSS1_CTL_291_DATA
				DDRSS1_CTL_292_DATA
				DDRSS1_CTL_293_DATA
				DDRSS1_CTL_294_DATA
				DDRSS1_CTL_295_DATA
				DDRSS1_CTL_296_DATA
				DDRSS1_CTL_297_DATA
				DDRSS1_CTL_298_DATA
				DDRSS1_CTL_299_DATA
				DDRSS1_CTL_300_DATA
				DDRSS1_CTL_301_DATA
				DDRSS1_CTL_302_DATA
				DDRSS1_CTL_303_DATA
				DDRSS1_CTL_304_DATA
				DDRSS1_CTL_305_DATA
				DDRSS1_CTL_306_DATA
				DDRSS1_CTL_307_DATA
				DDRSS1_CTL_308_DATA
				DDRSS1_CTL_309_DATA
				DDRSS1_CTL_310_DATA
				DDRSS1_CTL_311_DATA
				DDRSS1_CTL_312_DATA
				DDRSS1_CTL_313_DATA
				DDRSS1_CTL_314_DATA
				DDRSS1_CTL_315_DATA
				DDRSS1_CTL_316_DATA
				DDRSS1_CTL_317_DATA
				DDRSS1_CTL_318_DATA
				DDRSS1_CTL_319_DATA
				DDRSS1_CTL_320_DATA
				DDRSS1_CTL_321_DATA
				DDRSS1_CTL_322_DATA
				DDRSS1_CTL_323_DATA
				DDRSS1_CTL_324_DATA
				DDRSS1_CTL_325_DATA
				DDRSS1_CTL_326_DATA
				DDRSS1_CTL_327_DATA
				DDRSS1_CTL_328_DATA
				DDRSS1_CTL_329_DATA
				DDRSS1_CTL_330_DATA
				DDRSS1_CTL_331_DATA
				DDRSS1_CTL_332_DATA
				DDRSS1_CTL_333_DATA
				DDRSS1_CTL_334_DATA
				DDRSS1_CTL_335_DATA
				DDRSS1_CTL_336_DATA
				DDRSS1_CTL_337_DATA
				DDRSS1_CTL_338_DATA
				DDRSS1_CTL_339_DATA
				DDRSS1_CTL_340_DATA
				DDRSS1_CTL_341_DATA
				DDRSS1_CTL_342_DATA
				DDRSS1_CTL_343_DATA
				DDRSS1_CTL_344_DATA
				DDRSS1_CTL_345_DATA
				DDRSS1_CTL_346_DATA
				DDRSS1_CTL_347_DATA
				DDRSS1_CTL_348_DATA
				DDRSS1_CTL_349_DATA
				DDRSS1_CTL_350_DATA
				DDRSS1_CTL_351_DATA
				DDRSS1_CTL_352_DATA
				DDRSS1_CTL_353_DATA
				DDRSS1_CTL_354_DATA
				DDRSS1_CTL_355_DATA
				DDRSS1_CTL_356_DATA
				DDRSS1_CTL_357_DATA
				DDRSS1_CTL_358_DATA
				DDRSS1_CTL_359_DATA
				DDRSS1_CTL_360_DATA
				DDRSS1_CTL_361_DATA
				DDRSS1_CTL_362_DATA
				DDRSS1_CTL_363_DATA
				DDRSS1_CTL_364_DATA
				DDRSS1_CTL_365_DATA
				DDRSS1_CTL_366_DATA
				DDRSS1_CTL_367_DATA
				DDRSS1_CTL_368_DATA
				DDRSS1_CTL_369_DATA
				DDRSS1_CTL_370_DATA
				DDRSS1_CTL_371_DATA
				DDRSS1_CTL_372_DATA
				DDRSS1_CTL_373_DATA
				DDRSS1_CTL_374_DATA
				DDRSS1_CTL_375_DATA
				DDRSS1_CTL_376_DATA
				DDRSS1_CTL_377_DATA
				DDRSS1_CTL_378_DATA
				DDRSS1_CTL_379_DATA
				DDRSS1_CTL_380_DATA
				DDRSS1_CTL_381_DATA
				DDRSS1_CTL_382_DATA
				DDRSS1_CTL_383_DATA
				DDRSS1_CTL_384_DATA
				DDRSS1_CTL_385_DATA
				DDRSS1_CTL_386_DATA
				DDRSS1_CTL_387_DATA
				DDRSS1_CTL_388_DATA
				DDRSS1_CTL_389_DATA
				DDRSS1_CTL_390_DATA
				DDRSS1_CTL_391_DATA
				DDRSS1_CTL_392_DATA
				DDRSS1_CTL_393_DATA
				DDRSS1_CTL_394_DATA
				DDRSS1_CTL_395_DATA
				DDRSS1_CTL_396_DATA
				DDRSS1_CTL_397_DATA
				DDRSS1_CTL_398_DATA
				DDRSS1_CTL_399_DATA
				DDRSS1_CTL_400_DATA
				DDRSS1_CTL_401_DATA
				DDRSS1_CTL_402_DATA
				DDRSS1_CTL_403_DATA
				DDRSS1_CTL_404_DATA
				DDRSS1_CTL_405_DATA
				DDRSS1_CTL_406_DATA
				DDRSS1_CTL_407_DATA
				DDRSS1_CTL_408_DATA
				DDRSS1_CTL_409_DATA
				DDRSS1_CTL_410_DATA
				DDRSS1_CTL_411_DATA
				DDRSS1_CTL_412_DATA
				DDRSS1_CTL_413_DATA
				DDRSS1_CTL_414_DATA
				DDRSS1_CTL_415_DATA
				DDRSS1_CTL_416_DATA
				DDRSS1_CTL_417_DATA
				DDRSS1_CTL_418_DATA
				DDRSS1_CTL_419_DATA
				DDRSS1_CTL_420_DATA
				DDRSS1_CTL_421_DATA
				DDRSS1_CTL_422_DATA
				DDRSS1_CTL_423_DATA
				DDRSS1_CTL_424_DATA
				DDRSS1_CTL_425_DATA
				DDRSS1_CTL_426_DATA
				DDRSS1_CTL_427_DATA
				DDRSS1_CTL_428_DATA
				DDRSS1_CTL_429_DATA
				DDRSS1_CTL_430_DATA
				DDRSS1_CTL_431_DATA
				DDRSS1_CTL_432_DATA
				DDRSS1_CTL_433_DATA
				DDRSS1_CTL_434_DATA
				DDRSS1_CTL_435_DATA
				DDRSS1_CTL_436_DATA
				DDRSS1_CTL_437_DATA
				DDRSS1_CTL_438_DATA
				DDRSS1_CTL_439_DATA
				DDRSS1_CTL_440_DATA
				DDRSS1_CTL_441_DATA
				DDRSS1_CTL_442_DATA
				DDRSS1_CTL_443_DATA
				DDRSS1_CTL_444_DATA
				DDRSS1_CTL_445_DATA
				DDRSS1_CTL_446_DATA
				DDRSS1_CTL_447_DATA
				DDRSS1_CTL_448_DATA
				DDRSS1_CTL_449_DATA
				DDRSS1_CTL_450_DATA
				DDRSS1_CTL_451_DATA
				DDRSS1_CTL_452_DATA
				DDRSS1_CTL_453_DATA
				DDRSS1_CTL_454_DATA
				DDRSS1_CTL_455_DATA
				DDRSS1_CTL_456_DATA
				DDRSS1_CTL_457_DATA
				DDRSS1_CTL_458_DATA
			>;

			ti,pi-data = <
				DDRSS1_PI_00_DATA
				DDRSS1_PI_01_DATA
				DDRSS1_PI_02_DATA
				DDRSS1_PI_03_DATA
				DDRSS1_PI_04_DATA
				DDRSS1_PI_05_DATA
				DDRSS1_PI_06_DATA
				DDRSS1_PI_07_DATA
				DDRSS1_PI_08_DATA
				DDRSS1_PI_09_DATA
				DDRSS1_PI_10_DATA
				DDRSS1_PI_11_DATA
				DDRSS1_PI_12_DATA
				DDRSS1_PI_13_DATA
				DDRSS1_PI_14_DATA
				DDRSS1_PI_15_DATA
				DDRSS1_PI_16_DATA
				DDRSS1_PI_17_DATA
				DDRSS1_PI_18_DATA
				DDRSS1_PI_19_DATA
				DDRSS1_PI_20_DATA
				DDRSS1_PI_21_DATA
				DDRSS1_PI_22_DATA
				DDRSS1_PI_23_DATA
				DDRSS1_PI_24_DATA
				DDRSS1_PI_25_DATA
				DDRSS1_PI_26_DATA
				DDRSS1_PI_27_DATA
				DDRSS1_PI_28_DATA
				DDRSS1_PI_29_DATA
				DDRSS1_PI_30_DATA
				DDRSS1_PI_31_DATA
				DDRSS1_PI_32_DATA
				DDRSS1_PI_33_DATA
				DDRSS1_PI_34_DATA
				DDRSS1_PI_35_DATA
				DDRSS1_PI_36_DATA
				DDRSS1_PI_37_DATA
				DDRSS1_PI_38_DATA
				DDRSS1_PI_39_DATA
				DDRSS1_PI_40_DATA
				DDRSS1_PI_41_DATA
				DDRSS1_PI_42_DATA
				DDRSS1_PI_43_DATA
				DDRSS1_PI_44_DATA
				DDRSS1_PI_45_DATA
				DDRSS1_PI_46_DATA
				DDRSS1_PI_47_DATA
				DDRSS1_PI_48_DATA
				DDRSS1_PI_49_DATA
				DDRSS1_PI_50_DATA
				DDRSS1_PI_51_DATA
				DDRSS1_PI_52_DATA
				DDRSS1_PI_53_DATA
				DDRSS1_PI_54_DATA
				DDRSS1_PI_55_DATA
				DDRSS1_PI_56_DATA
				DDRSS1_PI_57_DATA
				DDRSS1_PI_58_DATA
				DDRSS1_PI_59_DATA
				DDRSS1_PI_60_DATA
				DDRSS1_PI_61_DATA
				DDRSS1_PI_62_DATA
				DDRSS1_PI_63_DATA
				DDRSS1_PI_64_DATA
				DDRSS1_PI_65_DATA
				DDRSS1_PI_66_DATA
				DDRSS1_PI_67_DATA
				DDRSS1_PI_68_DATA
				DDRSS1_PI_69_DATA
				DDRSS1_PI_70_DATA
				DDRSS1_PI_71_DATA
				DDRSS1_PI_72_DATA
				DDRSS1_PI_73_DATA
				DDRSS1_PI_74_DATA
				DDRSS1_PI_75_DATA
				DDRSS1_PI_76_DATA
				DDRSS1_PI_77_DATA
				DDRSS1_PI_78_DATA
				DDRSS1_PI_79_DATA
				DDRSS1_PI_80_DATA
				DDRSS1_PI_81_DATA
				DDRSS1_PI_82_DATA
				DDRSS1_PI_83_DATA
				DDRSS1_PI_84_DATA
				DDRSS1_PI_85_DATA
				DDRSS1_PI_86_DATA
				DDRSS1_PI_87_DATA
				DDRSS1_PI_88_DATA
				DDRSS1_PI_89_DATA
				DDRSS1_PI_90_DATA
				DDRSS1_PI_91_DATA
				DDRSS1_PI_92_DATA
				DDRSS1_PI_93_DATA
				DDRSS1_PI_94_DATA
				DDRSS1_PI_95_DATA
				DDRSS1_PI_96_DATA
				DDRSS1_PI_97_DATA
				DDRSS1_PI_98_DATA
				DDRSS1_PI_99_DATA
				DDRSS1_PI_100_DATA
				DDRSS1_PI_101_DATA
				DDRSS1_PI_102_DATA
				DDRSS1_PI_103_DATA
				DDRSS1_PI_104_DATA
				DDRSS1_PI_105_DATA
				DDRSS1_PI_106_DATA
				DDRSS1_PI_107_DATA
				DDRSS1_PI_108_DATA
				DDRSS1_PI_109_DATA
				DDRSS1_PI_110_DATA
				DDRSS1_PI_111_DATA
				DDRSS1_PI_112_DATA
				DDRSS1_PI_113_DATA
				DDRSS1_PI_114_DATA
				DDRSS1_PI_115_DATA
				DDRSS1_PI_116_DATA
				DDRSS1_PI_117_DATA
				DDRSS1_PI_118_DATA
				DDRSS1_PI_119_DATA
				DDRSS1_PI_120_DATA
				DDRSS1_PI_121_DATA
				DDRSS1_PI_122_DATA
				DDRSS1_PI_123_DATA
				DDRSS1_PI_124_DATA
				DDRSS1_PI_125_DATA
				DDRSS1_PI_126_DATA
				DDRSS1_PI_127_DATA
				DDRSS1_PI_128_DATA
				DDRSS1_PI_129_DATA
				DDRSS1_PI_130_DATA
				DDRSS1_PI_131_DATA
				DDRSS1_PI_132_DATA
				DDRSS1_PI_133_DATA
				DDRSS1_PI_134_DATA
				DDRSS1_PI_135_DATA
				DDRSS1_PI_136_DATA
				DDRSS1_PI_137_DATA
				DDRSS1_PI_138_DATA
				DDRSS1_PI_139_DATA
				DDRSS1_PI_140_DATA
				DDRSS1_PI_141_DATA
				DDRSS1_PI_142_DATA
				DDRSS1_PI_143_DATA
				DDRSS1_PI_144_DATA
				DDRSS1_PI_145_DATA
				DDRSS1_PI_146_DATA
				DDRSS1_PI_147_DATA
				DDRSS1_PI_148_DATA
				DDRSS1_PI_149_DATA
				DDRSS1_PI_150_DATA
				DDRSS1_PI_151_DATA
				DDRSS1_PI_152_DATA
				DDRSS1_PI_153_DATA
				DDRSS1_PI_154_DATA
				DDRSS1_PI_155_DATA
				DDRSS1_PI_156_DATA
				DDRSS1_PI_157_DATA
				DDRSS1_PI_158_DATA
				DDRSS1_PI_159_DATA
				DDRSS1_PI_160_DATA
				DDRSS1_PI_161_DATA
				DDRSS1_PI_162_DATA
				DDRSS1_PI_163_DATA
				DDRSS1_PI_164_DATA
				DDRSS1_PI_165_DATA
				DDRSS1_PI_166_DATA
				DDRSS1_PI_167_DATA
				DDRSS1_PI_168_DATA
				DDRSS1_PI_169_DATA
				DDRSS1_PI_170_DATA
				DDRSS1_PI_171_DATA
				DDRSS1_PI_172_DATA
				DDRSS1_PI_173_DATA
				DDRSS1_PI_174_DATA
				DDRSS1_PI_175_DATA
				DDRSS1_PI_176_DATA
				DDRSS1_PI_177_DATA
				DDRSS1_PI_178_DATA
				DDRSS1_PI_179_DATA
				DDRSS1_PI_180_DATA
				DDRSS1_PI_181_DATA
				DDRSS1_PI_182_DATA
				DDRSS1_PI_183_DATA
				DDRSS1_PI_184_DATA
				DDRSS1_PI_185_DATA
				DDRSS1_PI_186_DATA
				DDRSS1_PI_187_DATA
				DDRSS1_PI_188_DATA
				DDRSS1_PI_189_DATA
				DDRSS1_PI_190_DATA
				DDRSS1_PI_191_DATA
				DDRSS1_PI_192_DATA
				DDRSS1_PI_193_DATA
				DDRSS1_PI_194_DATA
				DDRSS1_PI_195_DATA
				DDRSS1_PI_196_DATA
				DDRSS1_PI_197_DATA
				DDRSS1_PI_198_DATA
				DDRSS1_PI_199_DATA
				DDRSS1_PI_200_DATA
				DDRSS1_PI_201_DATA
				DDRSS1_PI_202_DATA
				DDRSS1_PI_203_DATA
				DDRSS1_PI_204_DATA
				DDRSS1_PI_205_DATA
				DDRSS1_PI_206_DATA
				DDRSS1_PI_207_DATA
				DDRSS1_PI_208_DATA
				DDRSS1_PI_209_DATA
				DDRSS1_PI_210_DATA
				DDRSS1_PI_211_DATA
				DDRSS1_PI_212_DATA
				DDRSS1_PI_213_DATA
				DDRSS1_PI_214_DATA
				DDRSS1_PI_215_DATA
				DDRSS1_PI_216_DATA
				DDRSS1_PI_217_DATA
				DDRSS1_PI_218_DATA
				DDRSS1_PI_219_DATA
				DDRSS1_PI_220_DATA
				DDRSS1_PI_221_DATA
				DDRSS1_PI_222_DATA
				DDRSS1_PI_223_DATA
				DDRSS1_PI_224_DATA
				DDRSS1_PI_225_DATA
				DDRSS1_PI_226_DATA
				DDRSS1_PI_227_DATA
				DDRSS1_PI_228_DATA
				DDRSS1_PI_229_DATA
				DDRSS1_PI_230_DATA
				DDRSS1_PI_231_DATA
				DDRSS1_PI_232_DATA
				DDRSS1_PI_233_DATA
				DDRSS1_PI_234_DATA
				DDRSS1_PI_235_DATA
				DDRSS1_PI_236_DATA
				DDRSS1_PI_237_DATA
				DDRSS1_PI_238_DATA
				DDRSS1_PI_239_DATA
				DDRSS1_PI_240_DATA
				DDRSS1_PI_241_DATA
				DDRSS1_PI_242_DATA
				DDRSS1_PI_243_DATA
				DDRSS1_PI_244_DATA
				DDRSS1_PI_245_DATA
				DDRSS1_PI_246_DATA
				DDRSS1_PI_247_DATA
				DDRSS1_PI_248_DATA
				DDRSS1_PI_249_DATA
				DDRSS1_PI_250_DATA
				DDRSS1_PI_251_DATA
				DDRSS1_PI_252_DATA
				DDRSS1_PI_253_DATA
				DDRSS1_PI_254_DATA
				DDRSS1_PI_255_DATA
				DDRSS1_PI_256_DATA
				DDRSS1_PI_257_DATA
				DDRSS1_PI_258_DATA
				DDRSS1_PI_259_DATA
				DDRSS1_PI_260_DATA
				DDRSS1_PI_261_DATA
				DDRSS1_PI_262_DATA
				DDRSS1_PI_263_DATA
				DDRSS1_PI_264_DATA
				DDRSS1_PI_265_DATA
				DDRSS1_PI_266_DATA
				DDRSS1_PI_267_DATA
				DDRSS1_PI_268_DATA
				DDRSS1_PI_269_DATA
				DDRSS1_PI_270_DATA
				DDRSS1_PI_271_DATA
				DDRSS1_PI_272_DATA
				DDRSS1_PI_273_DATA
				DDRSS1_PI_274_DATA
				DDRSS1_PI_275_DATA
				DDRSS1_PI_276_DATA
				DDRSS1_PI_277_DATA
				DDRSS1_PI_278_DATA
				DDRSS1_PI_279_DATA
				DDRSS1_PI_280_DATA
				DDRSS1_PI_281_DATA
				DDRSS1_PI_282_DATA
				DDRSS1_PI_283_DATA
				DDRSS1_PI_284_DATA
				DDRSS1_PI_285_DATA
				DDRSS1_PI_286_DATA
				DDRSS1_PI_287_DATA
				DDRSS1_PI_288_DATA
				DDRSS1_PI_289_DATA
				DDRSS1_PI_290_DATA
				DDRSS1_PI_291_DATA
				DDRSS1_PI_292_DATA
				DDRSS1_PI_293_DATA
				DDRSS1_PI_294_DATA
				DDRSS1_PI_295_DATA
				DDRSS1_PI_296_DATA
				DDRSS1_PI_297_DATA
				DDRSS1_PI_298_DATA
				DDRSS1_PI_299_DATA
			>;

			ti,phy-data = <
				DDRSS1_PHY_00_DATA
				DDRSS1_PHY_01_DATA
				DDRSS1_PHY_02_DATA
				DDRSS1_PHY_03_DATA
				DDRSS1_PHY_04_DATA
				DDRSS1_PHY_05_DATA
				DDRSS1_PHY_06_DATA
				DDRSS1_PHY_07_DATA
				DDRSS1_PHY_08_DATA
				DDRSS1_PHY_09_DATA
				DDRSS1_PHY_10_DATA
				DDRSS1_PHY_11_DATA
				DDRSS1_PHY_12_DATA
				DDRSS1_PHY_13_DATA
				DDRSS1_PHY_14_DATA
				DDRSS1_PHY_15_DATA
				DDRSS1_PHY_16_DATA
				DDRSS1_PHY_17_DATA
				DDRSS1_PHY_18_DATA
				DDRSS1_PHY_19_DATA
				DDRSS1_PHY_20_DATA
				DDRSS1_PHY_21_DATA
				DDRSS1_PHY_22_DATA
				DDRSS1_PHY_23_DATA
				DDRSS1_PHY_24_DATA
				DDRSS1_PHY_25_DATA
				DDRSS1_PHY_26_DATA
				DDRSS1_PHY_27_DATA
				DDRSS1_PHY_28_DATA
				DDRSS1_PHY_29_DATA
				DDRSS1_PHY_30_DATA
				DDRSS1_PHY_31_DATA
				DDRSS1_PHY_32_DATA
				DDRSS1_PHY_33_DATA
				DDRSS1_PHY_34_DATA
				DDRSS1_PHY_35_DATA
				DDRSS1_PHY_36_DATA
				DDRSS1_PHY_37_DATA
				DDRSS1_PHY_38_DATA
				DDRSS1_PHY_39_DATA
				DDRSS1_PHY_40_DATA
				DDRSS1_PHY_41_DATA
				DDRSS1_PHY_42_DATA
				DDRSS1_PHY_43_DATA
				DDRSS1_PHY_44_DATA
				DDRSS1_PHY_45_DATA
				DDRSS1_PHY_46_DATA
				DDRSS1_PHY_47_DATA
				DDRSS1_PHY_48_DATA
				DDRSS1_PHY_49_DATA
				DDRSS1_PHY_50_DATA
				DDRSS1_PHY_51_DATA
				DDRSS1_PHY_52_DATA
				DDRSS1_PHY_53_DATA
				DDRSS1_PHY_54_DATA
				DDRSS1_PHY_55_DATA
				DDRSS1_PHY_56_DATA
				DDRSS1_PHY_57_DATA
				DDRSS1_PHY_58_DATA
				DDRSS1_PHY_59_DATA
				DDRSS1_PHY_60_DATA
				DDRSS1_PHY_61_DATA
				DDRSS1_PHY_62_DATA
				DDRSS1_PHY_63_DATA
				DDRSS1_PHY_64_DATA
				DDRSS1_PHY_65_DATA
				DDRSS1_PHY_66_DATA
				DDRSS1_PHY_67_DATA
				DDRSS1_PHY_68_DATA
				DDRSS1_PHY_69_DATA
				DDRSS1_PHY_70_DATA
				DDRSS1_PHY_71_DATA
				DDRSS1_PHY_72_DATA
				DDRSS1_PHY_73_DATA
				DDRSS1_PHY_74_DATA
				DDRSS1_PHY_75_DATA
				DDRSS1_PHY_76_DATA
				DDRSS1_PHY_77_DATA
				DDRSS1_PHY_78_DATA
				DDRSS1_PHY_79_DATA
				DDRSS1_PHY_80_DATA
				DDRSS1_PHY_81_DATA
				DDRSS1_PHY_82_DATA
				DDRSS1_PHY_83_DATA
				DDRSS1_PHY_84_DATA
				DDRSS1_PHY_85_DATA
				DDRSS1_PHY_86_DATA
				DDRSS1_PHY_87_DATA
				DDRSS1_PHY_88_DATA
				DDRSS1_PHY_89_DATA
				DDRSS1_PHY_90_DATA
				DDRSS1_PHY_91_DATA
				DDRSS1_PHY_92_DATA
				DDRSS1_PHY_93_DATA
				DDRSS1_PHY_94_DATA
				DDRSS1_PHY_95_DATA
				DDRSS1_PHY_96_DATA
				DDRSS1_PHY_97_DATA
				DDRSS1_PHY_98_DATA
				DDRSS1_PHY_99_DATA
				DDRSS1_PHY_100_DATA
				DDRSS1_PHY_101_DATA
				DDRSS1_PHY_102_DATA
				DDRSS1_PHY_103_DATA
				DDRSS1_PHY_104_DATA
				DDRSS1_PHY_105_DATA
				DDRSS1_PHY_106_DATA
				DDRSS1_PHY_107_DATA
				DDRSS1_PHY_108_DATA
				DDRSS1_PHY_109_DATA
				DDRSS1_PHY_110_DATA
				DDRSS1_PHY_111_DATA
				DDRSS1_PHY_112_DATA
				DDRSS1_PHY_113_DATA
				DDRSS1_PHY_114_DATA
				DDRSS1_PHY_115_DATA
				DDRSS1_PHY_116_DATA
				DDRSS1_PHY_117_DATA
				DDRSS1_PHY_118_DATA
				DDRSS1_PHY_119_DATA
				DDRSS1_PHY_120_DATA
				DDRSS1_PHY_121_DATA
				DDRSS1_PHY_122_DATA
				DDRSS1_PHY_123_DATA
				DDRSS1_PHY_124_DATA
				DDRSS1_PHY_125_DATA
				DDRSS1_PHY_126_DATA
				DDRSS1_PHY_127_DATA
				DDRSS1_PHY_128_DATA
				DDRSS1_PHY_129_DATA
				DDRSS1_PHY_130_DATA
				DDRSS1_PHY_131_DATA
				DDRSS1_PHY_132_DATA
				DDRSS1_PHY_133_DATA
				DDRSS1_PHY_134_DATA
				DDRSS1_PHY_135_DATA
				DDRSS1_PHY_136_DATA
				DDRSS1_PHY_137_DATA
				DDRSS1_PHY_138_DATA
				DDRSS1_PHY_139_DATA
				DDRSS1_PHY_140_DATA
				DDRSS1_PHY_141_DATA
				DDRSS1_PHY_142_DATA
				DDRSS1_PHY_143_DATA
				DDRSS1_PHY_144_DATA
				DDRSS1_PHY_145_DATA
				DDRSS1_PHY_146_DATA
				DDRSS1_PHY_147_DATA
				DDRSS1_PHY_148_DATA
				DDRSS1_PHY_149_DATA
				DDRSS1_PHY_150_DATA
				DDRSS1_PHY_151_DATA
				DDRSS1_PHY_152_DATA
				DDRSS1_PHY_153_DATA
				DDRSS1_PHY_154_DATA
				DDRSS1_PHY_155_DATA
				DDRSS1_PHY_156_DATA
				DDRSS1_PHY_157_DATA
				DDRSS1_PHY_158_DATA
				DDRSS1_PHY_159_DATA
				DDRSS1_PHY_160_DATA
				DDRSS1_PHY_161_DATA
				DDRSS1_PHY_162_DATA
				DDRSS1_PHY_163_DATA
				DDRSS1_PHY_164_DATA
				DDRSS1_PHY_165_DATA
				DDRSS1_PHY_166_DATA
				DDRSS1_PHY_167_DATA
				DDRSS1_PHY_168_DATA
				DDRSS1_PHY_169_DATA
				DDRSS1_PHY_170_DATA
				DDRSS1_PHY_171_DATA
				DDRSS1_PHY_172_DATA
				DDRSS1_PHY_173_DATA
				DDRSS1_PHY_174_DATA
				DDRSS1_PHY_175_DATA
				DDRSS1_PHY_176_DATA
				DDRSS1_PHY_177_DATA
				DDRSS1_PHY_178_DATA
				DDRSS1_PHY_179_DATA
				DDRSS1_PHY_180_DATA
				DDRSS1_PHY_181_DATA
				DDRSS1_PHY_182_DATA
				DDRSS1_PHY_183_DATA
				DDRSS1_PHY_184_DATA
				DDRSS1_PHY_185_DATA
				DDRSS1_PHY_186_DATA
				DDRSS1_PHY_187_DATA
				DDRSS1_PHY_188_DATA
				DDRSS1_PHY_189_DATA
				DDRSS1_PHY_190_DATA
				DDRSS1_PHY_191_DATA
				DDRSS1_PHY_192_DATA
				DDRSS1_PHY_193_DATA
				DDRSS1_PHY_194_DATA
				DDRSS1_PHY_195_DATA
				DDRSS1_PHY_196_DATA
				DDRSS1_PHY_197_DATA
				DDRSS1_PHY_198_DATA
				DDRSS1_PHY_199_DATA
				DDRSS1_PHY_200_DATA
				DDRSS1_PHY_201_DATA
				DDRSS1_PHY_202_DATA
				DDRSS1_PHY_203_DATA
				DDRSS1_PHY_204_DATA
				DDRSS1_PHY_205_DATA
				DDRSS1_PHY_206_DATA
				DDRSS1_PHY_207_DATA
				DDRSS1_PHY_208_DATA
				DDRSS1_PHY_209_DATA
				DDRSS1_PHY_210_DATA
				DDRSS1_PHY_211_DATA
				DDRSS1_PHY_212_DATA
				DDRSS1_PHY_213_DATA
				DDRSS1_PHY_214_DATA
				DDRSS1_PHY_215_DATA
				DDRSS1_PHY_216_DATA
				DDRSS1_PHY_217_DATA
				DDRSS1_PHY_218_DATA
				DDRSS1_PHY_219_DATA
				DDRSS1_PHY_220_DATA
				DDRSS1_PHY_221_DATA
				DDRSS1_PHY_222_DATA
				DDRSS1_PHY_223_DATA
				DDRSS1_PHY_224_DATA
				DDRSS1_PHY_225_DATA
				DDRSS1_PHY_226_DATA
				DDRSS1_PHY_227_DATA
				DDRSS1_PHY_228_DATA
				DDRSS1_PHY_229_DATA
				DDRSS1_PHY_230_DATA
				DDRSS1_PHY_231_DATA
				DDRSS1_PHY_232_DATA
				DDRSS1_PHY_233_DATA
				DDRSS1_PHY_234_DATA
				DDRSS1_PHY_235_DATA
				DDRSS1_PHY_236_DATA
				DDRSS1_PHY_237_DATA
				DDRSS1_PHY_238_DATA
				DDRSS1_PHY_239_DATA
				DDRSS1_PHY_240_DATA
				DDRSS1_PHY_241_DATA
				DDRSS1_PHY_242_DATA
				DDRSS1_PHY_243_DATA
				DDRSS1_PHY_244_DATA
				DDRSS1_PHY_245_DATA
				DDRSS1_PHY_246_DATA
				DDRSS1_PHY_247_DATA
				DDRSS1_PHY_248_DATA
				DDRSS1_PHY_249_DATA
				DDRSS1_PHY_250_DATA
				DDRSS1_PHY_251_DATA
				DDRSS1_PHY_252_DATA
				DDRSS1_PHY_253_DATA
				DDRSS1_PHY_254_DATA
				DDRSS1_PHY_255_DATA
				DDRSS1_PHY_256_DATA
				DDRSS1_PHY_257_DATA
				DDRSS1_PHY_258_DATA
				DDRSS1_PHY_259_DATA
				DDRSS1_PHY_260_DATA
				DDRSS1_PHY_261_DATA
				DDRSS1_PHY_262_DATA
				DDRSS1_PHY_263_DATA
				DDRSS1_PHY_264_DATA
				DDRSS1_PHY_265_DATA
				DDRSS1_PHY_266_DATA
				DDRSS1_PHY_267_DATA
				DDRSS1_PHY_268_DATA
				DDRSS1_PHY_269_DATA
				DDRSS1_PHY_270_DATA
				DDRSS1_PHY_271_DATA
				DDRSS1_PHY_272_DATA
				DDRSS1_PHY_273_DATA
				DDRSS1_PHY_274_DATA
				DDRSS1_PHY_275_DATA
				DDRSS1_PHY_276_DATA
				DDRSS1_PHY_277_DATA
				DDRSS1_PHY_278_DATA
				DDRSS1_PHY_279_DATA
				DDRSS1_PHY_280_DATA
				DDRSS1_PHY_281_DATA
				DDRSS1_PHY_282_DATA
				DDRSS1_PHY_283_DATA
				DDRSS1_PHY_284_DATA
				DDRSS1_PHY_285_DATA
				DDRSS1_PHY_286_DATA
				DDRSS1_PHY_287_DATA
				DDRSS1_PHY_288_DATA
				DDRSS1_PHY_289_DATA
				DDRSS1_PHY_290_DATA
				DDRSS1_PHY_291_DATA
				DDRSS1_PHY_292_DATA
				DDRSS1_PHY_293_DATA
				DDRSS1_PHY_294_DATA
				DDRSS1_PHY_295_DATA
				DDRSS1_PHY_296_DATA
				DDRSS1_PHY_297_DATA
				DDRSS1_PHY_298_DATA
				DDRSS1_PHY_299_DATA
				DDRSS1_PHY_300_DATA
				DDRSS1_PHY_301_DATA
				DDRSS1_PHY_302_DATA
				DDRSS1_PHY_303_DATA
				DDRSS1_PHY_304_DATA
				DDRSS1_PHY_305_DATA
				DDRSS1_PHY_306_DATA
				DDRSS1_PHY_307_DATA
				DDRSS1_PHY_308_DATA
				DDRSS1_PHY_309_DATA
				DDRSS1_PHY_310_DATA
				DDRSS1_PHY_311_DATA
				DDRSS1_PHY_312_DATA
				DDRSS1_PHY_313_DATA
				DDRSS1_PHY_314_DATA
				DDRSS1_PHY_315_DATA
				DDRSS1_PHY_316_DATA
				DDRSS1_PHY_317_DATA
				DDRSS1_PHY_318_DATA
				DDRSS1_PHY_319_DATA
				DDRSS1_PHY_320_DATA
				DDRSS1_PHY_321_DATA
				DDRSS1_PHY_322_DATA
				DDRSS1_PHY_323_DATA
				DDRSS1_PHY_324_DATA
				DDRSS1_PHY_325_DATA
				DDRSS1_PHY_326_DATA
				DDRSS1_PHY_327_DATA
				DDRSS1_PHY_328_DATA
				DDRSS1_PHY_329_DATA
				DDRSS1_PHY_330_DATA
				DDRSS1_PHY_331_DATA
				DDRSS1_PHY_332_DATA
				DDRSS1_PHY_333_DATA
				DDRSS1_PHY_334_DATA
				DDRSS1_PHY_335_DATA
				DDRSS1_PHY_336_DATA
				DDRSS1_PHY_337_DATA
				DDRSS1_PHY_338_DATA
				DDRSS1_PHY_339_DATA
				DDRSS1_PHY_340_DATA
				DDRSS1_PHY_341_DATA
				DDRSS1_PHY_342_DATA
				DDRSS1_PHY_343_DATA
				DDRSS1_PHY_344_DATA
				DDRSS1_PHY_345_DATA
				DDRSS1_PHY_346_DATA
				DDRSS1_PHY_347_DATA
				DDRSS1_PHY_348_DATA
				DDRSS1_PHY_349_DATA
				DDRSS1_PHY_350_DATA
				DDRSS1_PHY_351_DATA
				DDRSS1_PHY_352_DATA
				DDRSS1_PHY_353_DATA
				DDRSS1_PHY_354_DATA
				DDRSS1_PHY_355_DATA
				DDRSS1_PHY_356_DATA
				DDRSS1_PHY_357_DATA
				DDRSS1_PHY_358_DATA
				DDRSS1_PHY_359_DATA
				DDRSS1_PHY_360_DATA
				DDRSS1_PHY_361_DATA
				DDRSS1_PHY_362_DATA
				DDRSS1_PHY_363_DATA
				DDRSS1_PHY_364_DATA
				DDRSS1_PHY_365_DATA
				DDRSS1_PHY_366_DATA
				DDRSS1_PHY_367_DATA
				DDRSS1_PHY_368_DATA
				DDRSS1_PHY_369_DATA
				DDRSS1_PHY_370_DATA
				DDRSS1_PHY_371_DATA
				DDRSS1_PHY_372_DATA
				DDRSS1_PHY_373_DATA
				DDRSS1_PHY_374_DATA
				DDRSS1_PHY_375_DATA
				DDRSS1_PHY_376_DATA
				DDRSS1_PHY_377_DATA
				DDRSS1_PHY_378_DATA
				DDRSS1_PHY_379_DATA
				DDRSS1_PHY_380_DATA
				DDRSS1_PHY_381_DATA
				DDRSS1_PHY_382_DATA
				DDRSS1_PHY_383_DATA
				DDRSS1_PHY_384_DATA
				DDRSS1_PHY_385_DATA
				DDRSS1_PHY_386_DATA
				DDRSS1_PHY_387_DATA
				DDRSS1_PHY_388_DATA
				DDRSS1_PHY_389_DATA
				DDRSS1_PHY_390_DATA
				DDRSS1_PHY_391_DATA
				DDRSS1_PHY_392_DATA
				DDRSS1_PHY_393_DATA
				DDRSS1_PHY_394_DATA
				DDRSS1_PHY_395_DATA
				DDRSS1_PHY_396_DATA
				DDRSS1_PHY_397_DATA
				DDRSS1_PHY_398_DATA
				DDRSS1_PHY_399_DATA
				DDRSS1_PHY_400_DATA
				DDRSS1_PHY_401_DATA
				DDRSS1_PHY_402_DATA
				DDRSS1_PHY_403_DATA
				DDRSS1_PHY_404_DATA
				DDRSS1_PHY_405_DATA
				DDRSS1_PHY_406_DATA
				DDRSS1_PHY_407_DATA
				DDRSS1_PHY_408_DATA
				DDRSS1_PHY_409_DATA
				DDRSS1_PHY_410_DATA
				DDRSS1_PHY_411_DATA
				DDRSS1_PHY_412_DATA
				DDRSS1_PHY_413_DATA
				DDRSS1_PHY_414_DATA
				DDRSS1_PHY_415_DATA
				DDRSS1_PHY_416_DATA
				DDRSS1_PHY_417_DATA
				DDRSS1_PHY_418_DATA
				DDRSS1_PHY_419_DATA
				DDRSS1_PHY_420_DATA
				DDRSS1_PHY_421_DATA
				DDRSS1_PHY_422_DATA
				DDRSS1_PHY_423_DATA
				DDRSS1_PHY_424_DATA
				DDRSS1_PHY_425_DATA
				DDRSS1_PHY_426_DATA
				DDRSS1_PHY_427_DATA
				DDRSS1_PHY_428_DATA
				DDRSS1_PHY_429_DATA
				DDRSS1_PHY_430_DATA
				DDRSS1_PHY_431_DATA
				DDRSS1_PHY_432_DATA
				DDRSS1_PHY_433_DATA
				DDRSS1_PHY_434_DATA
				DDRSS1_PHY_435_DATA
				DDRSS1_PHY_436_DATA
				DDRSS1_PHY_437_DATA
				DDRSS1_PHY_438_DATA
				DDRSS1_PHY_439_DATA
				DDRSS1_PHY_440_DATA
				DDRSS1_PHY_441_DATA
				DDRSS1_PHY_442_DATA
				DDRSS1_PHY_443_DATA
				DDRSS1_PHY_444_DATA
				DDRSS1_PHY_445_DATA
				DDRSS1_PHY_446_DATA
				DDRSS1_PHY_447_DATA
				DDRSS1_PHY_448_DATA
				DDRSS1_PHY_449_DATA
				DDRSS1_PHY_450_DATA
				DDRSS1_PHY_451_DATA
				DDRSS1_PHY_452_DATA
				DDRSS1_PHY_453_DATA
				DDRSS1_PHY_454_DATA
				DDRSS1_PHY_455_DATA
				DDRSS1_PHY_456_DATA
				DDRSS1_PHY_457_DATA
				DDRSS1_PHY_458_DATA
				DDRSS1_PHY_459_DATA
				DDRSS1_PHY_460_DATA
				DDRSS1_PHY_461_DATA
				DDRSS1_PHY_462_DATA
				DDRSS1_PHY_463_DATA
				DDRSS1_PHY_464_DATA
				DDRSS1_PHY_465_DATA
				DDRSS1_PHY_466_DATA
				DDRSS1_PHY_467_DATA
				DDRSS1_PHY_468_DATA
				DDRSS1_PHY_469_DATA
				DDRSS1_PHY_470_DATA
				DDRSS1_PHY_471_DATA
				DDRSS1_PHY_472_DATA
				DDRSS1_PHY_473_DATA
				DDRSS1_PHY_474_DATA
				DDRSS1_PHY_475_DATA
				DDRSS1_PHY_476_DATA
				DDRSS1_PHY_477_DATA
				DDRSS1_PHY_478_DATA
				DDRSS1_PHY_479_DATA
				DDRSS1_PHY_480_DATA
				DDRSS1_PHY_481_DATA
				DDRSS1_PHY_482_DATA
				DDRSS1_PHY_483_DATA
				DDRSS1_PHY_484_DATA
				DDRSS1_PHY_485_DATA
				DDRSS1_PHY_486_DATA
				DDRSS1_PHY_487_DATA
				DDRSS1_PHY_488_DATA
				DDRSS1_PHY_489_DATA
				DDRSS1_PHY_490_DATA
				DDRSS1_PHY_491_DATA
				DDRSS1_PHY_492_DATA
				DDRSS1_PHY_493_DATA
				DDRSS1_PHY_494_DATA
				DDRSS1_PHY_495_DATA
				DDRSS1_PHY_496_DATA
				DDRSS1_PHY_497_DATA
				DDRSS1_PHY_498_DATA
				DDRSS1_PHY_499_DATA
				DDRSS1_PHY_500_DATA
				DDRSS1_PHY_501_DATA
				DDRSS1_PHY_502_DATA
				DDRSS1_PHY_503_DATA
				DDRSS1_PHY_504_DATA
				DDRSS1_PHY_505_DATA
				DDRSS1_PHY_506_DATA
				DDRSS1_PHY_507_DATA
				DDRSS1_PHY_508_DATA
				DDRSS1_PHY_509_DATA
				DDRSS1_PHY_510_DATA
				DDRSS1_PHY_511_DATA
				DDRSS1_PHY_512_DATA
				DDRSS1_PHY_513_DATA
				DDRSS1_PHY_514_DATA
				DDRSS1_PHY_515_DATA
				DDRSS1_PHY_516_DATA
				DDRSS1_PHY_517_DATA
				DDRSS1_PHY_518_DATA
				DDRSS1_PHY_519_DATA
				DDRSS1_PHY_520_DATA
				DDRSS1_PHY_521_DATA
				DDRSS1_PHY_522_DATA
				DDRSS1_PHY_523_DATA
				DDRSS1_PHY_524_DATA
				DDRSS1_PHY_525_DATA
				DDRSS1_PHY_526_DATA
				DDRSS1_PHY_527_DATA
				DDRSS1_PHY_528_DATA
				DDRSS1_PHY_529_DATA
				DDRSS1_PHY_530_DATA
				DDRSS1_PHY_531_DATA
				DDRSS1_PHY_532_DATA
				DDRSS1_PHY_533_DATA
				DDRSS1_PHY_534_DATA
				DDRSS1_PHY_535_DATA
				DDRSS1_PHY_536_DATA
				DDRSS1_PHY_537_DATA
				DDRSS1_PHY_538_DATA
				DDRSS1_PHY_539_DATA
				DDRSS1_PHY_540_DATA
				DDRSS1_PHY_541_DATA
				DDRSS1_PHY_542_DATA
				DDRSS1_PHY_543_DATA
				DDRSS1_PHY_544_DATA
				DDRSS1_PHY_545_DATA
				DDRSS1_PHY_546_DATA
				DDRSS1_PHY_547_DATA
				DDRSS1_PHY_548_DATA
				DDRSS1_PHY_549_DATA
				DDRSS1_PHY_550_DATA
				DDRSS1_PHY_551_DATA
				DDRSS1_PHY_552_DATA
				DDRSS1_PHY_553_DATA
				DDRSS1_PHY_554_DATA
				DDRSS1_PHY_555_DATA
				DDRSS1_PHY_556_DATA
				DDRSS1_PHY_557_DATA
				DDRSS1_PHY_558_DATA
				DDRSS1_PHY_559_DATA
				DDRSS1_PHY_560_DATA
				DDRSS1_PHY_561_DATA
				DDRSS1_PHY_562_DATA
				DDRSS1_PHY_563_DATA
				DDRSS1_PHY_564_DATA
				DDRSS1_PHY_565_DATA
				DDRSS1_PHY_566_DATA
				DDRSS1_PHY_567_DATA
				DDRSS1_PHY_568_DATA
				DDRSS1_PHY_569_DATA
				DDRSS1_PHY_570_DATA
				DDRSS1_PHY_571_DATA
				DDRSS1_PHY_572_DATA
				DDRSS1_PHY_573_DATA
				DDRSS1_PHY_574_DATA
				DDRSS1_PHY_575_DATA
				DDRSS1_PHY_576_DATA
				DDRSS1_PHY_577_DATA
				DDRSS1_PHY_578_DATA
				DDRSS1_PHY_579_DATA
				DDRSS1_PHY_580_DATA
				DDRSS1_PHY_581_DATA
				DDRSS1_PHY_582_DATA
				DDRSS1_PHY_583_DATA
				DDRSS1_PHY_584_DATA
				DDRSS1_PHY_585_DATA
				DDRSS1_PHY_586_DATA
				DDRSS1_PHY_587_DATA
				DDRSS1_PHY_588_DATA
				DDRSS1_PHY_589_DATA
				DDRSS1_PHY_590_DATA
				DDRSS1_PHY_591_DATA
				DDRSS1_PHY_592_DATA
				DDRSS1_PHY_593_DATA
				DDRSS1_PHY_594_DATA
				DDRSS1_PHY_595_DATA
				DDRSS1_PHY_596_DATA
				DDRSS1_PHY_597_DATA
				DDRSS1_PHY_598_DATA
				DDRSS1_PHY_599_DATA
				DDRSS1_PHY_600_DATA
				DDRSS1_PHY_601_DATA
				DDRSS1_PHY_602_DATA
				DDRSS1_PHY_603_DATA
				DDRSS1_PHY_604_DATA
				DDRSS1_PHY_605_DATA
				DDRSS1_PHY_606_DATA
				DDRSS1_PHY_607_DATA
				DDRSS1_PHY_608_DATA
				DDRSS1_PHY_609_DATA
				DDRSS1_PHY_610_DATA
				DDRSS1_PHY_611_DATA
				DDRSS1_PHY_612_DATA
				DDRSS1_PHY_613_DATA
				DDRSS1_PHY_614_DATA
				DDRSS1_PHY_615_DATA
				DDRSS1_PHY_616_DATA
				DDRSS1_PHY_617_DATA
				DDRSS1_PHY_618_DATA
				DDRSS1_PHY_619_DATA
				DDRSS1_PHY_620_DATA
				DDRSS1_PHY_621_DATA
				DDRSS1_PHY_622_DATA
				DDRSS1_PHY_623_DATA
				DDRSS1_PHY_624_DATA
				DDRSS1_PHY_625_DATA
				DDRSS1_PHY_626_DATA
				DDRSS1_PHY_627_DATA
				DDRSS1_PHY_628_DATA
				DDRSS1_PHY_629_DATA
				DDRSS1_PHY_630_DATA
				DDRSS1_PHY_631_DATA
				DDRSS1_PHY_632_DATA
				DDRSS1_PHY_633_DATA
				DDRSS1_PHY_634_DATA
				DDRSS1_PHY_635_DATA
				DDRSS1_PHY_636_DATA
				DDRSS1_PHY_637_DATA
				DDRSS1_PHY_638_DATA
				DDRSS1_PHY_639_DATA
				DDRSS1_PHY_640_DATA
				DDRSS1_PHY_641_DATA
				DDRSS1_PHY_642_DATA
				DDRSS1_PHY_643_DATA
				DDRSS1_PHY_644_DATA
				DDRSS1_PHY_645_DATA
				DDRSS1_PHY_646_DATA
				DDRSS1_PHY_647_DATA
				DDRSS1_PHY_648_DATA
				DDRSS1_PHY_649_DATA
				DDRSS1_PHY_650_DATA
				DDRSS1_PHY_651_DATA
				DDRSS1_PHY_652_DATA
				DDRSS1_PHY_653_DATA
				DDRSS1_PHY_654_DATA
				DDRSS1_PHY_655_DATA
				DDRSS1_PHY_656_DATA
				DDRSS1_PHY_657_DATA
				DDRSS1_PHY_658_DATA
				DDRSS1_PHY_659_DATA
				DDRSS1_PHY_660_DATA
				DDRSS1_PHY_661_DATA
				DDRSS1_PHY_662_DATA
				DDRSS1_PHY_663_DATA
				DDRSS1_PHY_664_DATA
				DDRSS1_PHY_665_DATA
				DDRSS1_PHY_666_DATA
				DDRSS1_PHY_667_DATA
				DDRSS1_PHY_668_DATA
				DDRSS1_PHY_669_DATA
				DDRSS1_PHY_670_DATA
				DDRSS1_PHY_671_DATA
				DDRSS1_PHY_672_DATA
				DDRSS1_PHY_673_DATA
				DDRSS1_PHY_674_DATA
				DDRSS1_PHY_675_DATA
				DDRSS1_PHY_676_DATA
				DDRSS1_PHY_677_DATA
				DDRSS1_PHY_678_DATA
				DDRSS1_PHY_679_DATA
				DDRSS1_PHY_680_DATA
				DDRSS1_PHY_681_DATA
				DDRSS1_PHY_682_DATA
				DDRSS1_PHY_683_DATA
				DDRSS1_PHY_684_DATA
				DDRSS1_PHY_685_DATA
				DDRSS1_PHY_686_DATA
				DDRSS1_PHY_687_DATA
				DDRSS1_PHY_688_DATA
				DDRSS1_PHY_689_DATA
				DDRSS1_PHY_690_DATA
				DDRSS1_PHY_691_DATA
				DDRSS1_PHY_692_DATA
				DDRSS1_PHY_693_DATA
				DDRSS1_PHY_694_DATA
				DDRSS1_PHY_695_DATA
				DDRSS1_PHY_696_DATA
				DDRSS1_PHY_697_DATA
				DDRSS1_PHY_698_DATA
				DDRSS1_PHY_699_DATA
				DDRSS1_PHY_700_DATA
				DDRSS1_PHY_701_DATA
				DDRSS1_PHY_702_DATA
				DDRSS1_PHY_703_DATA
				DDRSS1_PHY_704_DATA
				DDRSS1_PHY_705_DATA
				DDRSS1_PHY_706_DATA
				DDRSS1_PHY_707_DATA
				DDRSS1_PHY_708_DATA
				DDRSS1_PHY_709_DATA
				DDRSS1_PHY_710_DATA
				DDRSS1_PHY_711_DATA
				DDRSS1_PHY_712_DATA
				DDRSS1_PHY_713_DATA
				DDRSS1_PHY_714_DATA
				DDRSS1_PHY_715_DATA
				DDRSS1_PHY_716_DATA
				DDRSS1_PHY_717_DATA
				DDRSS1_PHY_718_DATA
				DDRSS1_PHY_719_DATA
				DDRSS1_PHY_720_DATA
				DDRSS1_PHY_721_DATA
				DDRSS1_PHY_722_DATA
				DDRSS1_PHY_723_DATA
				DDRSS1_PHY_724_DATA
				DDRSS1_PHY_725_DATA
				DDRSS1_PHY_726_DATA
				DDRSS1_PHY_727_DATA
				DDRSS1_PHY_728_DATA
				DDRSS1_PHY_729_DATA
				DDRSS1_PHY_730_DATA
				DDRSS1_PHY_731_DATA
				DDRSS1_PHY_732_DATA
				DDRSS1_PHY_733_DATA
				DDRSS1_PHY_734_DATA
				DDRSS1_PHY_735_DATA
				DDRSS1_PHY_736_DATA
				DDRSS1_PHY_737_DATA
				DDRSS1_PHY_738_DATA
				DDRSS1_PHY_739_DATA
				DDRSS1_PHY_740_DATA
				DDRSS1_PHY_741_DATA
				DDRSS1_PHY_742_DATA
				DDRSS1_PHY_743_DATA
				DDRSS1_PHY_744_DATA
				DDRSS1_PHY_745_DATA
				DDRSS1_PHY_746_DATA
				DDRSS1_PHY_747_DATA
				DDRSS1_PHY_748_DATA
				DDRSS1_PHY_749_DATA
				DDRSS1_PHY_750_DATA
				DDRSS1_PHY_751_DATA
				DDRSS1_PHY_752_DATA
				DDRSS1_PHY_753_DATA
				DDRSS1_PHY_754_DATA
				DDRSS1_PHY_755_DATA
				DDRSS1_PHY_756_DATA
				DDRSS1_PHY_757_DATA
				DDRSS1_PHY_758_DATA
				DDRSS1_PHY_759_DATA
				DDRSS1_PHY_760_DATA
				DDRSS1_PHY_761_DATA
				DDRSS1_PHY_762_DATA
				DDRSS1_PHY_763_DATA
				DDRSS1_PHY_764_DATA
				DDRSS1_PHY_765_DATA
				DDRSS1_PHY_766_DATA
				DDRSS1_PHY_767_DATA
				DDRSS1_PHY_768_DATA
				DDRSS1_PHY_769_DATA
				DDRSS1_PHY_770_DATA
				DDRSS1_PHY_771_DATA
				DDRSS1_PHY_772_DATA
				DDRSS1_PHY_773_DATA
				DDRSS1_PHY_774_DATA
				DDRSS1_PHY_775_DATA
				DDRSS1_PHY_776_DATA
				DDRSS1_PHY_777_DATA
				DDRSS1_PHY_778_DATA
				DDRSS1_PHY_779_DATA
				DDRSS1_PHY_780_DATA
				DDRSS1_PHY_781_DATA
				DDRSS1_PHY_782_DATA
				DDRSS1_PHY_783_DATA
				DDRSS1_PHY_784_DATA
				DDRSS1_PHY_785_DATA
				DDRSS1_PHY_786_DATA
				DDRSS1_PHY_787_DATA
				DDRSS1_PHY_788_DATA
				DDRSS1_PHY_789_DATA
				DDRSS1_PHY_790_DATA
				DDRSS1_PHY_791_DATA
				DDRSS1_PHY_792_DATA
				DDRSS1_PHY_793_DATA
				DDRSS1_PHY_794_DATA
				DDRSS1_PHY_795_DATA
				DDRSS1_PHY_796_DATA
				DDRSS1_PHY_797_DATA
				DDRSS1_PHY_798_DATA
				DDRSS1_PHY_799_DATA
				DDRSS1_PHY_800_DATA
				DDRSS1_PHY_801_DATA
				DDRSS1_PHY_802_DATA
				DDRSS1_PHY_803_DATA
				DDRSS1_PHY_804_DATA
				DDRSS1_PHY_805_DATA
				DDRSS1_PHY_806_DATA
				DDRSS1_PHY_807_DATA
				DDRSS1_PHY_808_DATA
				DDRSS1_PHY_809_DATA
				DDRSS1_PHY_810_DATA
				DDRSS1_PHY_811_DATA
				DDRSS1_PHY_812_DATA
				DDRSS1_PHY_813_DATA
				DDRSS1_PHY_814_DATA
				DDRSS1_PHY_815_DATA
				DDRSS1_PHY_816_DATA
				DDRSS1_PHY_817_DATA
				DDRSS1_PHY_818_DATA
				DDRSS1_PHY_819_DATA
				DDRSS1_PHY_820_DATA
				DDRSS1_PHY_821_DATA
				DDRSS1_PHY_822_DATA
				DDRSS1_PHY_823_DATA
				DDRSS1_PHY_824_DATA
				DDRSS1_PHY_825_DATA
				DDRSS1_PHY_826_DATA
				DDRSS1_PHY_827_DATA
				DDRSS1_PHY_828_DATA
				DDRSS1_PHY_829_DATA
				DDRSS1_PHY_830_DATA
				DDRSS1_PHY_831_DATA
				DDRSS1_PHY_832_DATA
				DDRSS1_PHY_833_DATA
				DDRSS1_PHY_834_DATA
				DDRSS1_PHY_835_DATA
				DDRSS1_PHY_836_DATA
				DDRSS1_PHY_837_DATA
				DDRSS1_PHY_838_DATA
				DDRSS1_PHY_839_DATA
				DDRSS1_PHY_840_DATA
				DDRSS1_PHY_841_DATA
				DDRSS1_PHY_842_DATA
				DDRSS1_PHY_843_DATA
				DDRSS1_PHY_844_DATA
				DDRSS1_PHY_845_DATA
				DDRSS1_PHY_846_DATA
				DDRSS1_PHY_847_DATA
				DDRSS1_PHY_848_DATA
				DDRSS1_PHY_849_DATA
				DDRSS1_PHY_850_DATA
				DDRSS1_PHY_851_DATA
				DDRSS1_PHY_852_DATA
				DDRSS1_PHY_853_DATA
				DDRSS1_PHY_854_DATA
				DDRSS1_PHY_855_DATA
				DDRSS1_PHY_856_DATA
				DDRSS1_PHY_857_DATA
				DDRSS1_PHY_858_DATA
				DDRSS1_PHY_859_DATA
				DDRSS1_PHY_860_DATA
				DDRSS1_PHY_861_DATA
				DDRSS1_PHY_862_DATA
				DDRSS1_PHY_863_DATA
				DDRSS1_PHY_864_DATA
				DDRSS1_PHY_865_DATA
				DDRSS1_PHY_866_DATA
				DDRSS1_PHY_867_DATA
				DDRSS1_PHY_868_DATA
				DDRSS1_PHY_869_DATA
				DDRSS1_PHY_870_DATA
				DDRSS1_PHY_871_DATA
				DDRSS1_PHY_872_DATA
				DDRSS1_PHY_873_DATA
				DDRSS1_PHY_874_DATA
				DDRSS1_PHY_875_DATA
				DDRSS1_PHY_876_DATA
				DDRSS1_PHY_877_DATA
				DDRSS1_PHY_878_DATA
				DDRSS1_PHY_879_DATA
				DDRSS1_PHY_880_DATA
				DDRSS1_PHY_881_DATA
				DDRSS1_PHY_882_DATA
				DDRSS1_PHY_883_DATA
				DDRSS1_PHY_884_DATA
				DDRSS1_PHY_885_DATA
				DDRSS1_PHY_886_DATA
				DDRSS1_PHY_887_DATA
				DDRSS1_PHY_888_DATA
				DDRSS1_PHY_889_DATA
				DDRSS1_PHY_890_DATA
				DDRSS1_PHY_891_DATA
				DDRSS1_PHY_892_DATA
				DDRSS1_PHY_893_DATA
				DDRSS1_PHY_894_DATA
				DDRSS1_PHY_895_DATA
				DDRSS1_PHY_896_DATA
				DDRSS1_PHY_897_DATA
				DDRSS1_PHY_898_DATA
				DDRSS1_PHY_899_DATA
				DDRSS1_PHY_900_DATA
				DDRSS1_PHY_901_DATA
				DDRSS1_PHY_902_DATA
				DDRSS1_PHY_903_DATA
				DDRSS1_PHY_904_DATA
				DDRSS1_PHY_905_DATA
				DDRSS1_PHY_906_DATA
				DDRSS1_PHY_907_DATA
				DDRSS1_PHY_908_DATA
				DDRSS1_PHY_909_DATA
				DDRSS1_PHY_910_DATA
				DDRSS1_PHY_911_DATA
				DDRSS1_PHY_912_DATA
				DDRSS1_PHY_913_DATA
				DDRSS1_PHY_914_DATA
				DDRSS1_PHY_915_DATA
				DDRSS1_PHY_916_DATA
				DDRSS1_PHY_917_DATA
				DDRSS1_PHY_918_DATA
				DDRSS1_PHY_919_DATA
				DDRSS1_PHY_920_DATA
				DDRSS1_PHY_921_DATA
				DDRSS1_PHY_922_DATA
				DDRSS1_PHY_923_DATA
				DDRSS1_PHY_924_DATA
				DDRSS1_PHY_925_DATA
				DDRSS1_PHY_926_DATA
				DDRSS1_PHY_927_DATA
				DDRSS1_PHY_928_DATA
				DDRSS1_PHY_929_DATA
				DDRSS1_PHY_930_DATA
				DDRSS1_PHY_931_DATA
				DDRSS1_PHY_932_DATA
				DDRSS1_PHY_933_DATA
				DDRSS1_PHY_934_DATA
				DDRSS1_PHY_935_DATA
				DDRSS1_PHY_936_DATA
				DDRSS1_PHY_937_DATA
				DDRSS1_PHY_938_DATA
				DDRSS1_PHY_939_DATA
				DDRSS1_PHY_940_DATA
				DDRSS1_PHY_941_DATA
				DDRSS1_PHY_942_DATA
				DDRSS1_PHY_943_DATA
				DDRSS1_PHY_944_DATA
				DDRSS1_PHY_945_DATA
				DDRSS1_PHY_946_DATA
				DDRSS1_PHY_947_DATA
				DDRSS1_PHY_948_DATA
				DDRSS1_PHY_949_DATA
				DDRSS1_PHY_950_DATA
				DDRSS1_PHY_951_DATA
				DDRSS1_PHY_952_DATA
				DDRSS1_PHY_953_DATA
				DDRSS1_PHY_954_DATA
				DDRSS1_PHY_955_DATA
				DDRSS1_PHY_956_DATA
				DDRSS1_PHY_957_DATA
				DDRSS1_PHY_958_DATA
				DDRSS1_PHY_959_DATA
				DDRSS1_PHY_960_DATA
				DDRSS1_PHY_961_DATA
				DDRSS1_PHY_962_DATA
				DDRSS1_PHY_963_DATA
				DDRSS1_PHY_964_DATA
				DDRSS1_PHY_965_DATA
				DDRSS1_PHY_966_DATA
				DDRSS1_PHY_967_DATA
				DDRSS1_PHY_968_DATA
				DDRSS1_PHY_969_DATA
				DDRSS1_PHY_970_DATA
				DDRSS1_PHY_971_DATA
				DDRSS1_PHY_972_DATA
				DDRSS1_PHY_973_DATA
				DDRSS1_PHY_974_DATA
				DDRSS1_PHY_975_DATA
				DDRSS1_PHY_976_DATA
				DDRSS1_PHY_977_DATA
				DDRSS1_PHY_978_DATA
				DDRSS1_PHY_979_DATA
				DDRSS1_PHY_980_DATA
				DDRSS1_PHY_981_DATA
				DDRSS1_PHY_982_DATA
				DDRSS1_PHY_983_DATA
				DDRSS1_PHY_984_DATA
				DDRSS1_PHY_985_DATA
				DDRSS1_PHY_986_DATA
				DDRSS1_PHY_987_DATA
				DDRSS1_PHY_988_DATA
				DDRSS1_PHY_989_DATA
				DDRSS1_PHY_990_DATA
				DDRSS1_PHY_991_DATA
				DDRSS1_PHY_992_DATA
				DDRSS1_PHY_993_DATA
				DDRSS1_PHY_994_DATA
				DDRSS1_PHY_995_DATA
				DDRSS1_PHY_996_DATA
				DDRSS1_PHY_997_DATA
				DDRSS1_PHY_998_DATA
				DDRSS1_PHY_999_DATA
				DDRSS1_PHY_1000_DATA
				DDRSS1_PHY_1001_DATA
				DDRSS1_PHY_1002_DATA
				DDRSS1_PHY_1003_DATA
				DDRSS1_PHY_1004_DATA
				DDRSS1_PHY_1005_DATA
				DDRSS1_PHY_1006_DATA
				DDRSS1_PHY_1007_DATA
				DDRSS1_PHY_1008_DATA
				DDRSS1_PHY_1009_DATA
				DDRSS1_PHY_1010_DATA
				DDRSS1_PHY_1011_DATA
				DDRSS1_PHY_1012_DATA
				DDRSS1_PHY_1013_DATA
				DDRSS1_PHY_1014_DATA
				DDRSS1_PHY_1015_DATA
				DDRSS1_PHY_1016_DATA
				DDRSS1_PHY_1017_DATA
				DDRSS1_PHY_1018_DATA
				DDRSS1_PHY_1019_DATA
				DDRSS1_PHY_1020_DATA
				DDRSS1_PHY_1021_DATA
				DDRSS1_PHY_1022_DATA
				DDRSS1_PHY_1023_DATA
				DDRSS1_PHY_1024_DATA
				DDRSS1_PHY_1025_DATA
				DDRSS1_PHY_1026_DATA
				DDRSS1_PHY_1027_DATA
				DDRSS1_PHY_1028_DATA
				DDRSS1_PHY_1029_DATA
				DDRSS1_PHY_1030_DATA
				DDRSS1_PHY_1031_DATA
				DDRSS1_PHY_1032_DATA
				DDRSS1_PHY_1033_DATA
				DDRSS1_PHY_1034_DATA
				DDRSS1_PHY_1035_DATA
				DDRSS1_PHY_1036_DATA
				DDRSS1_PHY_1037_DATA
				DDRSS1_PHY_1038_DATA
				DDRSS1_PHY_1039_DATA
				DDRSS1_PHY_1040_DATA
				DDRSS1_PHY_1041_DATA
				DDRSS1_PHY_1042_DATA
				DDRSS1_PHY_1043_DATA
				DDRSS1_PHY_1044_DATA
				DDRSS1_PHY_1045_DATA
				DDRSS1_PHY_1046_DATA
				DDRSS1_PHY_1047_DATA
				DDRSS1_PHY_1048_DATA
				DDRSS1_PHY_1049_DATA
				DDRSS1_PHY_1050_DATA
				DDRSS1_PHY_1051_DATA
				DDRSS1_PHY_1052_DATA
				DDRSS1_PHY_1053_DATA
				DDRSS1_PHY_1054_DATA
				DDRSS1_PHY_1055_DATA
				DDRSS1_PHY_1056_DATA
				DDRSS1_PHY_1057_DATA
				DDRSS1_PHY_1058_DATA
				DDRSS1_PHY_1059_DATA
				DDRSS1_PHY_1060_DATA
				DDRSS1_PHY_1061_DATA
				DDRSS1_PHY_1062_DATA
				DDRSS1_PHY_1063_DATA
				DDRSS1_PHY_1064_DATA
				DDRSS1_PHY_1065_DATA
				DDRSS1_PHY_1066_DATA
				DDRSS1_PHY_1067_DATA
				DDRSS1_PHY_1068_DATA
				DDRSS1_PHY_1069_DATA
				DDRSS1_PHY_1070_DATA
				DDRSS1_PHY_1071_DATA
				DDRSS1_PHY_1072_DATA
				DDRSS1_PHY_1073_DATA
				DDRSS1_PHY_1074_DATA
				DDRSS1_PHY_1075_DATA
				DDRSS1_PHY_1076_DATA
				DDRSS1_PHY_1077_DATA
				DDRSS1_PHY_1078_DATA
				DDRSS1_PHY_1079_DATA
				DDRSS1_PHY_1080_DATA
				DDRSS1_PHY_1081_DATA
				DDRSS1_PHY_1082_DATA
				DDRSS1_PHY_1083_DATA
				DDRSS1_PHY_1084_DATA
				DDRSS1_PHY_1085_DATA
				DDRSS1_PHY_1086_DATA
				DDRSS1_PHY_1087_DATA
				DDRSS1_PHY_1088_DATA
				DDRSS1_PHY_1089_DATA
				DDRSS1_PHY_1090_DATA
				DDRSS1_PHY_1091_DATA
				DDRSS1_PHY_1092_DATA
				DDRSS1_PHY_1093_DATA
				DDRSS1_PHY_1094_DATA
				DDRSS1_PHY_1095_DATA
				DDRSS1_PHY_1096_DATA
				DDRSS1_PHY_1097_DATA
				DDRSS1_PHY_1098_DATA
				DDRSS1_PHY_1099_DATA
				DDRSS1_PHY_1100_DATA
				DDRSS1_PHY_1101_DATA
				DDRSS1_PHY_1102_DATA
				DDRSS1_PHY_1103_DATA
				DDRSS1_PHY_1104_DATA
				DDRSS1_PHY_1105_DATA
				DDRSS1_PHY_1106_DATA
				DDRSS1_PHY_1107_DATA
				DDRSS1_PHY_1108_DATA
				DDRSS1_PHY_1109_DATA
				DDRSS1_PHY_1110_DATA
				DDRSS1_PHY_1111_DATA
				DDRSS1_PHY_1112_DATA
				DDRSS1_PHY_1113_DATA
				DDRSS1_PHY_1114_DATA
				DDRSS1_PHY_1115_DATA
				DDRSS1_PHY_1116_DATA
				DDRSS1_PHY_1117_DATA
				DDRSS1_PHY_1118_DATA
				DDRSS1_PHY_1119_DATA
				DDRSS1_PHY_1120_DATA
				DDRSS1_PHY_1121_DATA
				DDRSS1_PHY_1122_DATA
				DDRSS1_PHY_1123_DATA
				DDRSS1_PHY_1124_DATA
				DDRSS1_PHY_1125_DATA
				DDRSS1_PHY_1126_DATA
				DDRSS1_PHY_1127_DATA
				DDRSS1_PHY_1128_DATA
				DDRSS1_PHY_1129_DATA
				DDRSS1_PHY_1130_DATA
				DDRSS1_PHY_1131_DATA
				DDRSS1_PHY_1132_DATA
				DDRSS1_PHY_1133_DATA
				DDRSS1_PHY_1134_DATA
				DDRSS1_PHY_1135_DATA
				DDRSS1_PHY_1136_DATA
				DDRSS1_PHY_1137_DATA
				DDRSS1_PHY_1138_DATA
				DDRSS1_PHY_1139_DATA
				DDRSS1_PHY_1140_DATA
				DDRSS1_PHY_1141_DATA
				DDRSS1_PHY_1142_DATA
				DDRSS1_PHY_1143_DATA
				DDRSS1_PHY_1144_DATA
				DDRSS1_PHY_1145_DATA
				DDRSS1_PHY_1146_DATA
				DDRSS1_PHY_1147_DATA
				DDRSS1_PHY_1148_DATA
				DDRSS1_PHY_1149_DATA
				DDRSS1_PHY_1150_DATA
				DDRSS1_PHY_1151_DATA
				DDRSS1_PHY_1152_DATA
				DDRSS1_PHY_1153_DATA
				DDRSS1_PHY_1154_DATA
				DDRSS1_PHY_1155_DATA
				DDRSS1_PHY_1156_DATA
				DDRSS1_PHY_1157_DATA
				DDRSS1_PHY_1158_DATA
				DDRSS1_PHY_1159_DATA
				DDRSS1_PHY_1160_DATA
				DDRSS1_PHY_1161_DATA
				DDRSS1_PHY_1162_DATA
				DDRSS1_PHY_1163_DATA
				DDRSS1_PHY_1164_DATA
				DDRSS1_PHY_1165_DATA
				DDRSS1_PHY_1166_DATA
				DDRSS1_PHY_1167_DATA
				DDRSS1_PHY_1168_DATA
				DDRSS1_PHY_1169_DATA
				DDRSS1_PHY_1170_DATA
				DDRSS1_PHY_1171_DATA
				DDRSS1_PHY_1172_DATA
				DDRSS1_PHY_1173_DATA
				DDRSS1_PHY_1174_DATA
				DDRSS1_PHY_1175_DATA
				DDRSS1_PHY_1176_DATA
				DDRSS1_PHY_1177_DATA
				DDRSS1_PHY_1178_DATA
				DDRSS1_PHY_1179_DATA
				DDRSS1_PHY_1180_DATA
				DDRSS1_PHY_1181_DATA
				DDRSS1_PHY_1182_DATA
				DDRSS1_PHY_1183_DATA
				DDRSS1_PHY_1184_DATA
				DDRSS1_PHY_1185_DATA
				DDRSS1_PHY_1186_DATA
				DDRSS1_PHY_1187_DATA
				DDRSS1_PHY_1188_DATA
				DDRSS1_PHY_1189_DATA
				DDRSS1_PHY_1190_DATA
				DDRSS1_PHY_1191_DATA
				DDRSS1_PHY_1192_DATA
				DDRSS1_PHY_1193_DATA
				DDRSS1_PHY_1194_DATA
				DDRSS1_PHY_1195_DATA
				DDRSS1_PHY_1196_DATA
				DDRSS1_PHY_1197_DATA
				DDRSS1_PHY_1198_DATA
				DDRSS1_PHY_1199_DATA
				DDRSS1_PHY_1200_DATA
				DDRSS1_PHY_1201_DATA
				DDRSS1_PHY_1202_DATA
				DDRSS1_PHY_1203_DATA
				DDRSS1_PHY_1204_DATA
				DDRSS1_PHY_1205_DATA
				DDRSS1_PHY_1206_DATA
				DDRSS1_PHY_1207_DATA
				DDRSS1_PHY_1208_DATA
				DDRSS1_PHY_1209_DATA
				DDRSS1_PHY_1210_DATA
				DDRSS1_PHY_1211_DATA
				DDRSS1_PHY_1212_DATA
				DDRSS1_PHY_1213_DATA
				DDRSS1_PHY_1214_DATA
				DDRSS1_PHY_1215_DATA
				DDRSS1_PHY_1216_DATA
				DDRSS1_PHY_1217_DATA
				DDRSS1_PHY_1218_DATA
				DDRSS1_PHY_1219_DATA
				DDRSS1_PHY_1220_DATA
				DDRSS1_PHY_1221_DATA
				DDRSS1_PHY_1222_DATA
				DDRSS1_PHY_1223_DATA
				DDRSS1_PHY_1224_DATA
				DDRSS1_PHY_1225_DATA
				DDRSS1_PHY_1226_DATA
				DDRSS1_PHY_1227_DATA
				DDRSS1_PHY_1228_DATA
				DDRSS1_PHY_1229_DATA
				DDRSS1_PHY_1230_DATA
				DDRSS1_PHY_1231_DATA
				DDRSS1_PHY_1232_DATA
				DDRSS1_PHY_1233_DATA
				DDRSS1_PHY_1234_DATA
				DDRSS1_PHY_1235_DATA
				DDRSS1_PHY_1236_DATA
				DDRSS1_PHY_1237_DATA
				DDRSS1_PHY_1238_DATA
				DDRSS1_PHY_1239_DATA
				DDRSS1_PHY_1240_DATA
				DDRSS1_PHY_1241_DATA
				DDRSS1_PHY_1242_DATA
				DDRSS1_PHY_1243_DATA
				DDRSS1_PHY_1244_DATA
				DDRSS1_PHY_1245_DATA
				DDRSS1_PHY_1246_DATA
				DDRSS1_PHY_1247_DATA
				DDRSS1_PHY_1248_DATA
				DDRSS1_PHY_1249_DATA
				DDRSS1_PHY_1250_DATA
				DDRSS1_PHY_1251_DATA
				DDRSS1_PHY_1252_DATA
				DDRSS1_PHY_1253_DATA
				DDRSS1_PHY_1254_DATA
				DDRSS1_PHY_1255_DATA
				DDRSS1_PHY_1256_DATA
				DDRSS1_PHY_1257_DATA
				DDRSS1_PHY_1258_DATA
				DDRSS1_PHY_1259_DATA
				DDRSS1_PHY_1260_DATA
				DDRSS1_PHY_1261_DATA
				DDRSS1_PHY_1262_DATA
				DDRSS1_PHY_1263_DATA
				DDRSS1_PHY_1264_DATA
				DDRSS1_PHY_1265_DATA
				DDRSS1_PHY_1266_DATA
				DDRSS1_PHY_1267_DATA
				DDRSS1_PHY_1268_DATA
				DDRSS1_PHY_1269_DATA
				DDRSS1_PHY_1270_DATA
				DDRSS1_PHY_1271_DATA
				DDRSS1_PHY_1272_DATA
				DDRSS1_PHY_1273_DATA
				DDRSS1_PHY_1274_DATA
				DDRSS1_PHY_1275_DATA
				DDRSS1_PHY_1276_DATA
				DDRSS1_PHY_1277_DATA
				DDRSS1_PHY_1278_DATA
				DDRSS1_PHY_1279_DATA
				DDRSS1_PHY_1280_DATA
				DDRSS1_PHY_1281_DATA
				DDRSS1_PHY_1282_DATA
				DDRSS1_PHY_1283_DATA
				DDRSS1_PHY_1284_DATA
				DDRSS1_PHY_1285_DATA
				DDRSS1_PHY_1286_DATA
				DDRSS1_PHY_1287_DATA
				DDRSS1_PHY_1288_DATA
				DDRSS1_PHY_1289_DATA
				DDRSS1_PHY_1290_DATA
				DDRSS1_PHY_1291_DATA
				DDRSS1_PHY_1292_DATA
				DDRSS1_PHY_1293_DATA
				DDRSS1_PHY_1294_DATA
				DDRSS1_PHY_1295_DATA
				DDRSS1_PHY_1296_DATA
				DDRSS1_PHY_1297_DATA
				DDRSS1_PHY_1298_DATA
				DDRSS1_PHY_1299_DATA
				DDRSS1_PHY_1300_DATA
				DDRSS1_PHY_1301_DATA
				DDRSS1_PHY_1302_DATA
				DDRSS1_PHY_1303_DATA
				DDRSS1_PHY_1304_DATA
				DDRSS1_PHY_1305_DATA
				DDRSS1_PHY_1306_DATA
				DDRSS1_PHY_1307_DATA
				DDRSS1_PHY_1308_DATA
				DDRSS1_PHY_1309_DATA
				DDRSS1_PHY_1310_DATA
				DDRSS1_PHY_1311_DATA
				DDRSS1_PHY_1312_DATA
				DDRSS1_PHY_1313_DATA
				DDRSS1_PHY_1314_DATA
				DDRSS1_PHY_1315_DATA
				DDRSS1_PHY_1316_DATA
				DDRSS1_PHY_1317_DATA
				DDRSS1_PHY_1318_DATA
				DDRSS1_PHY_1319_DATA
				DDRSS1_PHY_1320_DATA
				DDRSS1_PHY_1321_DATA
				DDRSS1_PHY_1322_DATA
				DDRSS1_PHY_1323_DATA
				DDRSS1_PHY_1324_DATA
				DDRSS1_PHY_1325_DATA
				DDRSS1_PHY_1326_DATA
				DDRSS1_PHY_1327_DATA
				DDRSS1_PHY_1328_DATA
				DDRSS1_PHY_1329_DATA
				DDRSS1_PHY_1330_DATA
				DDRSS1_PHY_1331_DATA
				DDRSS1_PHY_1332_DATA
				DDRSS1_PHY_1333_DATA
				DDRSS1_PHY_1334_DATA
				DDRSS1_PHY_1335_DATA
				DDRSS1_PHY_1336_DATA
				DDRSS1_PHY_1337_DATA
				DDRSS1_PHY_1338_DATA
				DDRSS1_PHY_1339_DATA
				DDRSS1_PHY_1340_DATA
				DDRSS1_PHY_1341_DATA
				DDRSS1_PHY_1342_DATA
				DDRSS1_PHY_1343_DATA
				DDRSS1_PHY_1344_DATA
				DDRSS1_PHY_1345_DATA
				DDRSS1_PHY_1346_DATA
				DDRSS1_PHY_1347_DATA
				DDRSS1_PHY_1348_DATA
				DDRSS1_PHY_1349_DATA
				DDRSS1_PHY_1350_DATA
				DDRSS1_PHY_1351_DATA
				DDRSS1_PHY_1352_DATA
				DDRSS1_PHY_1353_DATA
				DDRSS1_PHY_1354_DATA
				DDRSS1_PHY_1355_DATA
				DDRSS1_PHY_1356_DATA
				DDRSS1_PHY_1357_DATA
				DDRSS1_PHY_1358_DATA
				DDRSS1_PHY_1359_DATA
				DDRSS1_PHY_1360_DATA
				DDRSS1_PHY_1361_DATA
				DDRSS1_PHY_1362_DATA
				DDRSS1_PHY_1363_DATA
				DDRSS1_PHY_1364_DATA
				DDRSS1_PHY_1365_DATA
				DDRSS1_PHY_1366_DATA
				DDRSS1_PHY_1367_DATA
				DDRSS1_PHY_1368_DATA
				DDRSS1_PHY_1369_DATA
				DDRSS1_PHY_1370_DATA
				DDRSS1_PHY_1371_DATA
				DDRSS1_PHY_1372_DATA
				DDRSS1_PHY_1373_DATA
				DDRSS1_PHY_1374_DATA
				DDRSS1_PHY_1375_DATA
				DDRSS1_PHY_1376_DATA
				DDRSS1_PHY_1377_DATA
				DDRSS1_PHY_1378_DATA
				DDRSS1_PHY_1379_DATA
				DDRSS1_PHY_1380_DATA
				DDRSS1_PHY_1381_DATA
				DDRSS1_PHY_1382_DATA
				DDRSS1_PHY_1383_DATA
				DDRSS1_PHY_1384_DATA
				DDRSS1_PHY_1385_DATA
				DDRSS1_PHY_1386_DATA
				DDRSS1_PHY_1387_DATA
				DDRSS1_PHY_1388_DATA
				DDRSS1_PHY_1389_DATA
				DDRSS1_PHY_1390_DATA
				DDRSS1_PHY_1391_DATA
				DDRSS1_PHY_1392_DATA
				DDRSS1_PHY_1393_DATA
				DDRSS1_PHY_1394_DATA
				DDRSS1_PHY_1395_DATA
				DDRSS1_PHY_1396_DATA
				DDRSS1_PHY_1397_DATA
				DDRSS1_PHY_1398_DATA
				DDRSS1_PHY_1399_DATA
				DDRSS1_PHY_1400_DATA
				DDRSS1_PHY_1401_DATA
				DDRSS1_PHY_1402_DATA
				DDRSS1_PHY_1403_DATA
				DDRSS1_PHY_1404_DATA
				DDRSS1_PHY_1405_DATA
				DDRSS1_PHY_1406_DATA
				DDRSS1_PHY_1407_DATA
				DDRSS1_PHY_1408_DATA
				DDRSS1_PHY_1409_DATA
				DDRSS1_PHY_1410_DATA
				DDRSS1_PHY_1411_DATA
				DDRSS1_PHY_1412_DATA
				DDRSS1_PHY_1413_DATA
				DDRSS1_PHY_1414_DATA
				DDRSS1_PHY_1415_DATA
				DDRSS1_PHY_1416_DATA
				DDRSS1_PHY_1417_DATA
				DDRSS1_PHY_1418_DATA
				DDRSS1_PHY_1419_DATA
				DDRSS1_PHY_1420_DATA
				DDRSS1_PHY_1421_DATA
				DDRSS1_PHY_1422_DATA
			>;
		};
	};
};
