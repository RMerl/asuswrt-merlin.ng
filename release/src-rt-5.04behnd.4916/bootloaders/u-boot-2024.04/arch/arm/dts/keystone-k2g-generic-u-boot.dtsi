// SPDX-License-Identifier: GPL-2.0+
/*
 * Copyright (C) 2017 Texas Instruments Incorporated - https://www.ti.com/
 */

/{
	soc {
		bootph-all;
	};
};

&i2c0 {
	bootph-all;
};

&i2c1 {
	bootph-all;
};
