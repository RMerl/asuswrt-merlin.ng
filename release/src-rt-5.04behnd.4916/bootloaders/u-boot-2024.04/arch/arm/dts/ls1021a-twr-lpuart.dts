// SPDX-License-Identifier: GPL-2.0+
/*
 * Freescale ls1021a TWR board device tree source
 *
 * Copyright 2013-2015 Freescale Semiconductor, Inc.
 */

/dts-v1/;
#include "ls1021a-twr.dtsi"

/ {
	chosen {
		stdout-path = &lpuart0;
	};
};
