// SPDX-License-Identifier: (GPL-2.0+ OR MIT)
/*
 * Copyright (c) 2020 BayLibre, SAS
 * Author: Neil Armstrong <narmstrong@baylibre.com>
 */

#include "meson-sm1-u-boot.dtsi"

&ethmac {
	snps,reset-gpio = <&gpio GPIOZ_15 (GPIO_ACTIVE_LOW | GPIO_OPEN_DRAIN)>;
	snps,reset-delays-us = <0 10000 1000000>;
	snps,reset-active-low;
};

/* SARADC is needed for proper board variant detection */
&saradc {
	status = "okay";
	vref-supply = <&vddao_1v8>;
};

&tflash_vdd {
	gpio = <&gpio_ao GPIOAO_3 GPIO_OPEN_DRAIN>;
};
