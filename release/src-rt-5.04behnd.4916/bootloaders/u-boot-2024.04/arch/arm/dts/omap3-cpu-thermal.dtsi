// SPDX-License-Identifier: GPL-2.0-only
/*
 * Device Tree Source for OMAP3 SoC CPU thermal
 *
 * Copyright (C) 2017 Texas Instruments Incorporated - https://www.ti.com/
 */

#include <dt-bindings/thermal/thermal.h>

cpu_thermal: cpu-thermal {
	polling-delay-passive = <250>; /* milliseconds */
	polling-delay = <1000>; /* milliseconds */
	coefficients = <0 20000>;

			/* sensor       ID */
	thermal-sensors = <&bandgap     0>;
};
