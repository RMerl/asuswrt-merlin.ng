// SPDX-License-Identifier: GPL-2.0+
/*
 * U-Boot additions
 *
 * (C) Copyright 2017 Derald D. Woods <woods.technical@gmail.com>
 */

#include "omap3-u-boot.dtsi"

/ {
	chosen {
		stdout-path = &uart1;
	};

	ethernet@2c000000 {
		compatible = "smsc,lan9221","smsc,lan9115";
		reg = <0x2c000000 0xff>;
		bank-width = <2>;
		vddvario-supply = <&vddvario>;
		vdd33a-supply = <&vdd33a>;
		reg-io-width = <4>;
		smsc,save-mac-address;
	};
};
