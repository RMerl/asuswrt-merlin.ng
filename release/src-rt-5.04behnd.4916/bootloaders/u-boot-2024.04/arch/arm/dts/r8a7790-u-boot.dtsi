// SPDX-License-Identifier: GPL-2.0
/*
 * Device Tree Source extras for U-Boot on RCar R8A7790 SoC
 *
 * Copyright (C) 2018 Marek Vasut <marek.vasut@gmail.com>
 */

#include "r8a779x-u-boot.dtsi"

&usb_extal_clk {
	bootph-all;
};

&pfc {
	bootph-all;
};

&rst {
	bootph-all;
};
