// SPDX-License-Identifier: GPL-2.0
/*
 * Device Tree Source extras for U-Boot for the Falcon board
 *
 * Copyright (C) 2020 Renesas Electronics Corp.
 */

#include "r8a779a0-falcon.dts"
#include "r8a779a0-u-boot.dtsi"

/ {
	aliases {
		spi0 = &rpc;
	};
};

&rpc {
	#address-cells = <1>;
	#size-cells = <0>;
	num-cs = <1>;
	spi-max-frequency = <50000000>;
	status = "okay";

	flash@0 {
		reg = <0>;
		compatible = "jedec,spi-nor";
		spi-max-frequency = <50000000>;
		spi-tx-bus-width = <1>;
		spi-rx-bus-width = <1>;
		status = "okay";
	};
};
