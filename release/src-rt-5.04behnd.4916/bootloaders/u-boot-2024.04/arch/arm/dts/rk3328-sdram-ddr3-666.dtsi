/*
 * (C) Copyright 2017 Rockchip Electronics Co., Ltd
 *
 * SPDX-License-Identifier:     GPL-2.0+
 */

&dmc {
	rockchip,sdram-params = <
		0x1
		0xC
		0x3
		0x1
		0x0
		0x0
		0x10
		0x10
		0x10
		0x10
		0

		0x9028b189
		0x00000000
		0x00000021
		0x00000482
		0x00000015
		0x00000222
		0x000000ff

		333
		3
		1
		0
		0

		0x00000000
		0x43041001
		0x00000064
		0x0028003b
		0x000000d0
		0x00020053
		0x000000d4
		0x00020000
		0x000000d8
		0x00000100
		0x000000dc
		0x03200000
		0x000000e0
		0x00000000
		0x000000e4
		0x00090000
		0x000000f4
		0x000f011f
		0x00000100
		0x07090b06
		0x00000104
		0x00050209
		0x00000108
		0x03030407
		0x0000010c
		0x00202006
		0x00000110
		0x03020204
		0x00000114
		0x03030202
		0x00000120
		0x00000903
		0x00000180
		0x00800020
		0x00000184
		0x00000000
		0x00000190
		0x07010001
		0x00000198
		0x05001100
		0x000001a0
		0xc0400003
		0x00000240
		0x06000604
		0x00000244
		0x00000201
		0x00000250
		0x00000f00
		0x00000490
		0x00000001
		0xffffffff
		0xffffffff
		0xffffffff
		0xffffffff
		0xffffffff
		0xffffffff
		0xffffffff
		0xffffffff
		0xffffffff
		0xffffffff
		0xffffffff
		0xffffffff
		0xffffffff
		0xffffffff
		0xffffffff
		0xffffffff
		0xffffffff
		0xffffffff
		0xffffffff
		0xffffffff

		0x00000004
		0x0000000a
		0x00000028
		0x00000006
		0x0000002c
		0x00000000
		0x00000030
		0x00000005
		0xffffffff
		0xffffffff

		0x77
		0x88
		0x79
		0x79
		0x87
		0x97
		0x87
		0x78
		0x77
		0x78
		0x87
		0x88
		0x87
		0x87
		0x77

		0x78
		0x78
		0x78
		0x78
		0x78
		0x78
		0x78
		0x78
		0x78
		0x69
		0x9

		0x77
		0x78
		0x77
		0x78
		0x77
		0x78
		0x77
		0x78
		0x77
		0x79
		0x9

		0x78
		0x78
		0x78
		0x78
		0x78
		0x78
		0x78
		0x78
		0x78
		0x69
		0x9

		0x77
		0x78
		0x77
		0x77
		0x77
		0x77
		0x77
		0x77
		0x77
		0x79
		0x9

		0x78
		0x78
		0x78
		0x78
		0x78
		0x78
		0x78
		0x78
		0x78
		0x69
		0x9

		0x77
		0x78
		0x77
		0x78
		0x77
		0x78
		0x77
		0x78
		0x77
		0x79
		0x9

		0x78
		0x78
		0x78
		0x78
		0x78
		0x78
		0x78
		0x78
		0x78
		0x69
		0x9

		0x77
		0x78
		0x77
		0x77
		0x77
		0x77
		0x77
		0x77
		0x77
		0x79
		0x9
	>;
};
