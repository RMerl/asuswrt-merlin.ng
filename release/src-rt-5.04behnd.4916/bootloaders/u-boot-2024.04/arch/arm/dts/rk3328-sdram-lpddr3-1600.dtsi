/*
 * (C) 2017 Theobroma Systems Design und Consulting GmbH
 *
 * SPDX-License-Identifier:     GPL-2.0+
 */

&dmc {
	rockchip,sdram-params = <
		0x1
		0xC
		0x3
		0x1
		0x0
		0x0
		0x10
		0x10
		0x10
		0x10
		0

		0x98899459
		0x00000000
		0x0000002e
		0x00000544
		0x00000015
		0x00000432
		0x000000ff

		800
		6
		1
		0
		1

		0x00000000
		0x43041008
		0x00000064
		0x00300054
		0x000000d0
		0x00500002
		0x000000d4
		0x00010000
		0x000000d8
		0x00000e03
		0x000000dc
		0x0043001a
		0x000000e0
		0x00010000
		0x000000e4
		0x000e0005
		0x000000f4
		0x000f011f
		0x00000100
		0x0b141b11
		0x00000104
		0x0003031a
		0x00000108
		0x03060809
		0x0000010c
		0x00606000
		0x00000110
		0x08020409
		0x00000114
		0x01010606
		0x00000118
		0x02020004
		0x00000120
		0x00000404
		0x00000138
		0x00000058
		0x00000180
		0x00900024
		0x00000184
		0x01400000
		0x00000190
		0x07050002
		0x00000198
		0x05001100
		0x000001a0
		0xc0400003
		0x00000240
		0x0a020b28
		0x00000244
		0x00000101
		0x00000250
		0x00000f00
		0x00000490
		0x00000001
		0xffffffff
		0xffffffff
		0xffffffff
		0xffffffff
		0xffffffff
		0xffffffff
		0xffffffff
		0xffffffff
		0xffffffff
		0xffffffff
		0xffffffff
		0xffffffff
		0xffffffff
		0xffffffff
		0xffffffff
		0xffffffff

		0x00000004
		0x0000000b
		0x00000028
		0x0000000c
		0x0000002c
		0x00000000
		0x00000030
		0x00000006
		0xffffffff
		0xffffffff

		0x77
		0x88
		0x79
		0x79
		0x87
		0x97
		0x87
		0x78
		0x77
		0x78
		0x87
		0x88
		0x87
		0x87
		0x77

		0x78
		0x78
		0x78
		0x78
		0x78
		0x78
		0x78
		0x78
		0x78
		0x69
		0x9

		0x77
		0x78
		0x77
		0x78
		0x77
		0x78
		0x77
		0x78
		0x77
		0x79
		0x9

		0x78
		0x78
		0x78
		0x78
		0x78
		0x78
		0x78
		0x78
		0x78
		0x69
		0x9

		0x77
		0x78
		0x77
		0x77
		0x77
		0x77
		0x77
		0x77
		0x77
		0x79
		0x9

		0x78
		0x78
		0x78
		0x78
		0x78
		0x78
		0x78
		0x78
		0x78
		0x69
		0x9

		0x77
		0x78
		0x77
		0x78
		0x77
		0x78
		0x77
		0x78
		0x77
		0x79
		0x9

		0x78
		0x78
		0x78
		0x78
		0x78
		0x78
		0x78
		0x78
		0x78
		0x69
		0x9

		0x77
		0x78
		0x77
		0x77
		0x77
		0x77
		0x77
		0x77
		0x77
		0x79
		0x9
	>;
};
