/*
 * (C) Copyright 2017 Rockchip Electronics Co., Ltd
 *
 * SPDX-License-Identifier:     GPL-2.0+
 */

&dmc {
	rockchip,sdram-params = <
		0x1
		0xC
		0x3
		0x1
		0x0
		0x0
		0x10
		0x10
		0x10
		0x10
		0

		0x8c48a18a
		0x00000000
		0x00000021
		0x00000482
		0x00000015
		0x0000021a
		0x000000ff

		333
		6
		1
		0
		0

		0x00000000
		0x43041008
		0x00000064
		0x00140023
		0x000000d0
		0x00220002
		0x000000d4
		0x00010000
		0x000000d8
		0x00000703
		0x000000dc
		0x00830004
		0x000000e0
		0x00010000
		0x000000e4
		0x00070003
		0x000000f4
		0x000f011f
		0x00000100
		0x06090b07
		0x00000104
		0x0002020b
		0x00000108
		0x02030506
		0x0000010c
		0x00505000
		0x00000110
		0x03020204
		0x00000114
		0x01010303
		0x00000118
		0x02020003
		0x00000120
		0x00000303
		0x00000138
		0x00000025
		0x00000180
		0x003c000f
		0x00000184
		0x00900000
		0x00000190
		0x07020000
		0x00000198
		0x05001100
		0x000001a0
		0xc0400003
		0x00000240
		0x0900090c
		0x00000244
		0x00000101
		0x00000250
		0x00000f00
		0x00000490
		0x00000001
		0xffffffff
		0xffffffff
		0xffffffff
		0xffffffff
		0xffffffff
		0xffffffff
		0xffffffff
		0xffffffff
		0xffffffff
		0xffffffff
		0xffffffff
		0xffffffff
		0xffffffff
		0xffffffff
		0xffffffff
		0xffffffff

		0x00000004
		0x0000000b
		0x00000028
		0x00000006
		0x0000002c
		0x00000000
		0x00000030
		0x00000003
		0xffffffff
		0xffffffff

		0x77
		0x88
		0x79
		0x79
		0x87
		0x97
		0x87
		0x78
		0x77
		0x78
		0x87
		0x88
		0x87
		0x87
		0x77

		0x78
		0x78
		0x78
		0x78
		0x78
		0x78
		0x78
		0x78
		0x78
		0x69
		0x9

		0x77
		0x78
		0x77
		0x78
		0x77
		0x78
		0x77
		0x78
		0x77
		0x79
		0x9

		0x78
		0x78
		0x78
		0x78
		0x78
		0x78
		0x78
		0x78
		0x78
		0x69
		0x9

		0x77
		0x78
		0x77
		0x77
		0x77
		0x77
		0x77
		0x77
		0x77
		0x79
		0x9

		0x78
		0x78
		0x78
		0x78
		0x78
		0x78
		0x78
		0x78
		0x78
		0x69
		0x9

		0x77
		0x78
		0x77
		0x78
		0x77
		0x78
		0x77
		0x78
		0x77
		0x79
		0x9

		0x78
		0x78
		0x78
		0x78
		0x78
		0x78
		0x78
		0x78
		0x78
		0x69
		0x9

		0x77
		0x78
		0x77
		0x77
		0x77
		0x77
		0x77
		0x77
		0x77
		0x79
		0x9
	>;
};
