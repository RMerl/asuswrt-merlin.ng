// SPDX-License-Identifier: GPL-2.0+
/*
 * Copyright (c) 2022 Andy Yan <andy.yan@gmail.com>
 */

#include "rk3399-u-boot.dtsi"
#include "rk3399-sdram-lpddr3-4GB-1600.dtsi"

/ {
	chosen {
		stdout-path = "serial2:1500000n8";
		u-boot,spl-boot-order = "same-as-spl", &sdhci, &sdmmc;
	};
};

&vdd_log {
	regulator-init-microvolt = <950000>;
};
