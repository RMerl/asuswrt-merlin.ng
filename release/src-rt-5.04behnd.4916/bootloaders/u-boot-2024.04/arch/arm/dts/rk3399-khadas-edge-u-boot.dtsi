// SPDX-License-Identifier: GPL-2.0+
/*
 * Copyright (C) 2019 Nick Xie <nick@khadas.com>
 */

#include "rk3399-u-boot.dtsi"
#include "rk3399-sdram-lpddr4-100.dtsi"

/ {
	chosen {
		u-boot,spl-boot-order = "same-as-spl", &sdhci, &sdmmc;
	};
};

&vdd_log {
	regulator-init-microvolt = <950000>;
};
