// SPDX-License-Identifier: GPL-2.0+
/*
 * (C) Copyright 2016 Rockchip Electronics Co., Ltd
 * (C) Copyright 2018 Manivannan Sadhasivam <manivannan.sadhasivam@linaro.org>
 */

&dmc {
	rockchip,sdram-params = <
		0x1
		0xa
		0x3
		0x2
		0x2
		0x0
		0xf
		0xf
		0xf
		0xf
		1
		0x1d191519
		0x14040808
		0x00000002
		0x00006226
		0x00000054
		0x00000000
		0x1
		0xa
		0x3
		0x2
		0x2
		0x0
		0xf
		0xf
		0xf
		0xf
		1
		0x1d191519
		0x14040808
		0x00000002
		0x00006226
		0x00000054
		0x00000000
		800
		6
		2
		9
		1
		0x00000700
		0x00000000
		0x00000000
		0x00000000
		0x00000000
		0x00000050
		0x00027100
		0x00000320
		0x00001f40
		0x00000050
		0x00027100
		0x00000320
		0x00001f40
		0x00000050
		0x00027100
		0x00000320
		0x01001f40
		0x00000000
		0x00000101
		0x00020100
		0x000000a0
		0x00000190
		0x00000000
		0x06180000
		0x00061800
		0x04000618
		0x33080004
		0x280f0622
		0x22330800
		0x00280f06
		0x06223308
		0x0600280f
		0x00000a0a
		0x0600dac0
		0x0a0a060c
		0x0600dac0
		0x0a0a060c
		0x0600dac0
		0x0203000c
		0x0f0c0f00
		0x040c0f0c
		0x14000a0a
		0x03030a0a
		0x00010003
		0x031b1b1b
		0x00111111
		0x00000000
		0x03010000
		0x0c2800a8
		0x0c2800a8
		0x0c2800a8
		0x00000000
		0x00060006
		0x00140006
		0x00140014
		0x000f0f0f
		0x00000000
		0x00000000
		0x00000000
		0x00b00000
		0x00b000b0
		0x00b000b0
		0x000000b0
		0x00000000
		0x00000000
		0x00000000
		0x00000000
		0x00000000
		0x00000000
		0x00000301
		0x00000001
		0x00000000
		0x00000000
		0x01000000
		0x80104002
		0x00040003
		0x00040005
		0x00030000
		0x00050004
		0x00000004
		0x00040003
		0x00040005
		0x30a00000
		0x00001850
		0x185030a0
		0x30a00000
		0x00001850
		0x00000000
		0x00000000
		0x00000000
		0x00000000
		0x00000000
		0x02020200
		0x00020202
		0x00030200
		0x00040700
		0x00000302
		0x02000407
		0x00000003
		0x00030f04
		0x00070004
		0x00000000
		0x00000000
		0x00000000
		0x00000000
		0x00000000
		0x00000000
		0x00000000
		0x00010000
		0x20040020
		0x00200400
		0x01000400
		0x00000b80
		0x00000000
		0x00000001
		0x00000002
		0x0000000e
		0x00000000
		0x00000000
		0x00000000
		0x00000000
		0x00000000
		0x00a00000
		0x00c80050
		0x00c80000
		0x005000a0
		0x000000c8
		0x00a000c8
		0x00c80050
		0x00c80000
		0x00000000
		0x00000000
		0x00000000
		0x00430000
		0x0000001a
		0x001a0043
		0x00430000
		0x0000001a
		0x00010001
		0x07000001
		0x00000707
		0x00000000
		0x00000000
		0x00000000
		0x00000000
		0x00000000
		0x00000000
		0x00430000
		0x0000001a
		0x001a0043
		0x00430000
		0x0000001a
		0x00010001
		0x07000001
		0x00000707
		0x00000000
		0x00000000
		0x00000000
		0x00000000
		0x00000000
		0x00000000
		0x01000000
		0x00000000
		0x00000000
		0x18151100
		0x0000000c
		0x00000000
		0x00000000
		0x00000000
		0x00000000
		0x00000000
		0x00000000
		0x00000000
		0x00000000
		0x00000000
		0x00000000
		0x00000000
		0x00000000
		0x00000000
		0x00032003
		0x00480120
		0x00000000
		0x01200320
		0x00000048
		0x00032000
		0x00480120
		0x00000000
		0x00280000
		0x00280028
		0x01010100
		0x01000202
		0x0a000002
		0x01000f0f
		0x00000000
		0x00000000
		0x00010003
		0x00000c03
		0x00000100
		0x00010000
		0x01000000
		0x00010000
		0x00000001
		0x00000000
		0x00000000
		0x00000000
		0x00000000
		0x00000000
		0x00000000
		0x00000000
		0x00000000
		0x00000000
		0x00010000
		0x03030301
		0x01010808
		0x03030001
		0x0a0a0a03
		0x02080808
		0x02050103
		0x02050103
		0x00050103
		0x00020202
		0x05020500
		0x00020502
		0x00000000
		0x00000000
		0x0d000001
		0x00010028
		0x00010000
		0x00000003
		0x00000000
		0x00000000
		0x00000000
		0x00000000
		0x00000000
		0x00000000
		0x00000000
		0x00000000
		0x00010100
		0x01000000
		0x00000001
		0x00000303
		0x00000000
		0x00000000
		0x00000000
		0x00000000
		0x00000000
		0x00000000
		0x00000000
		0x00000000
		0x00000000
		0x00000000
		0x00000000
		0x00000000
		0x00000000
		0x00000000
		0x00000000
		0x000556aa
		0x000aaaaa
		0x000aa955
		0x00055555
		0x000b3133
		0x0004cd33
		0x0004cecc
		0x000b32cc
		0x00010300
		0x03000100
		0x00000000
		0x00000000
		0x00000000
		0x00000000
		0x00000000
		0x00000000
		0x00000000
		0x00000000
		0x00ffff00
		0x1e1e0000
		0x0800001e
		0x00001850
		0x00000200
		0x00000200
		0x00000200
		0x00000200
		0x00001850
		0x0000f320
		0x1850050a
		0x00000200
		0x00000200
		0x00000200
		0x00000200
		0x00001850
		0x0000f320
		0x1850050a
		0x00000200
		0x00000200
		0x00000200
		0x00000200
		0x00001850
		0x0000f320
		0x0202050a
		0x03030202
		0x00000018
		0x00000000
		0x00000000
		0x00001403
		0x00000000
		0x00000000
		0x00000000
		0x00030000
		0x000e0020
		0x000e0020
		0x000e0020
		0x00000000
		0x00000000
		0x01000000
		0x00070007
		0x00050007
		0x00000000
		0x00000000
		0x00000000
		0x00000000
		0x00000000
		0x00000000
		0x00000000
		0x00000000
		0x01000101
		0x01010101
		0x01000101
		0x01000100
		0x00010001
		0x00010002
		0x00020100
		0x00000002
		0x00000700
		0x00000000
		0x000030a0
		0x00001850
		0x000030a0
		0x00001850
		0x000030a0
		0x18501850
		0x00000200
		0x00000200
		0x00000200
		0x00000200
		0x00001850
		0x00000200
		0x00000200
		0x00000200
		0x00000200
		0x00001850
		0x00000200
		0x00000200
		0x00000200
		0x00000200
		0x00010000
		0x00000007
		0x81000001
		0x0f0003f0
		0x3fffffff
		0x0f0000a0
		0x377ff000
		0x0f000020
		0x377ff000
		0x0f000030
		0x377ff000
		0x0f0000b0
		0x377ff000
		0x0f000100
		0x377ff000
		0x0f000110
		0x377ff000
		0x0f000010
		0x377ff000
		0x03000101
		0x042e2e2e
		0x06180006
		0x00061800
		0x00000018
		0x0c2800a8
		0x0c2800a8
		0x0c2800a8
		0x00000500
		0x00000000
		0x00000000
		0x00000000
		0x00000000
		0x00000000
		0x00000000
		0x00000000
		0x00000000
		0x04040000
		0x0d000004
		0x00000128
		0x00000000
		0x00030003
		0x00000018
		0x00000000
		0x00000000
		0x03060002
		0x03010301
		0x01080801
		0x04020201
		0x01080804
		0x00000000
		0x03030000
		0x0a0a0a03
		0x00000000
		0x00000000
		0x00000000
		0x00030300
		0x00000014
		0x00000000
		0x01010300
		0x00000000
		0x00000000
		0x01000000
		0x00000101
		0x55555a5a
		0x55555a5a
		0x55555a5a
		0x55555a5a
		0x0a0a0001
		0x0505000a
		0x00000005
		0x00000100
		0x00030000
		0x17030000
		0x000e0020
		0x000e0020
		0x000e0020
		0x00000000
		0x00000000
		0x00000100
		0x140a0000
		0x000a030a
		0x03000a03
		0x010a000a
		0x00000100
		0x01000000
		0x00000000
		0x00000100
		0x1e1a0000
		0x10010204
		0x07070705
		0x20000202
		0x00201000
		0x00201000
		0x04041000
		0x10100100
		0x00010110
		0x004b004a
		0x1a030000
		0x0102041e
		0x34000000
		0x00000000
		0x00000000
		0x00000000
		0x00004300
		0x0001001a
		0x004d4d07
		0x001a0043
		0x4d070001
		0x0000434d
		0x0001001a
		0x004d4d07
		0x001a0043
		0x4d070001
		0x0000434d
		0x0001001a
		0x004d4d07
		0x001a0043
		0x4d070001
		0x0043004d
		0x0001001a
		0x004d4d07
		0x001a0043
		0x4d070001
		0x0000434d
		0x0001001a
		0x004d4d07
		0x001a0043
		0x4d070001
		0x0000434d
		0x0001001a
		0x004d4d07
		0x001a0043
		0x4d070001
		0x0100004d
		0x00c800c8
		0x060400c8
		0x0c060f11
		0x2200d890
		0x0a0c2005
		0x0f11060a
		0x00000c06
		0x2200d890
		0x0a0c2005
		0x0f11060a
		0x00000c06
		0x2200d890
		0x0a0c2005
		0x0200020a
		0x02000200
		0x02000200
		0x02000200
		0x02000200
		0x00000000
		0x00000000
		0x00000000
		0x00000000
		0x00000000
		0x00000000
		0x00000000
		0x00000000
		0x00000000
		0x00000000
		0x00000000
		0x00000000
		0x01000300
		0x00185000
		0x0000f320
		0x00001850
		0x0000f320
		0x00001850
		0x0000f320
		0x08000000
		0x00000100
		0x00000000
		0x00000000
		0x00000000
		0x00000000
		0x00000002
		0x76543210
		0x0004c008
		0x000000b3
		0x00000000
		0x00000000
		0x00010000
		0x01665555
		0x00665555
		0x00010f00
		0x05010200
		0x00000003
		0x001700c0
		0x00cc0101
		0x00030066
		0x00000000
		0x00000000
		0x00000000
		0x00000000
		0x00000000
		0x00000000
		0x00000000
		0x00000000
		0x04080000
		0x04080400
		0x08000000
		0x0c00c007
		0x00000100
		0x00000100
		0x55555555
		0xaaaaaaaa
		0x55555555
		0xaaaaaaaa
		0x00005555
		0x00000000
		0x00000000
		0x00000000
		0x00000000
		0x00000000
		0x00000000
		0x00000000
		0x00000000
		0x00000000
		0x00000000
		0x00000000
		0x00000000
		0x00000000
		0x00000000
		0x00000000
		0x00000000
		0x00000000
		0x00000000
		0x00000000
		0x00200000
		0x00000000
		0x00000000
		0x00000000
		0x00000000
		0x00000000
		0x00000000
		0x02700270
		0x02700270
		0x02700270
		0x02700270
		0x00000270
		0x00000000
		0x00000000
		0x00000000
		0x00000000
		0x00800000
		0x00800080
		0x00800080
		0x00800080
		0x00800080
		0x00800080
		0x00800080
		0x00800080
		0x00800080
		0x00b30080
		0x00000003
		0x00000000
		0x00020000
		0x00000200
		0x00000000
		0x51315152
		0xc0013150
		0x020000c0
		0x00100001
		0x07054208
		0x000f0c18
		0x01000140
		0x00000c20
		0x00000000
		0x00000000
		0x00000000
		0x00000000
		0x00000000
		0x00000000
		0x00000000
		0x00000000
		0x00000000
		0x00000000
		0x00000000
		0x00000000
		0x00000000
		0x00000000
		0x00000000
		0x00000000
		0x00000000
		0x00000000
		0x00000000
		0x00000000
		0x00000000
		0x00000000
		0x00000000
		0x00000000
		0x00000000
		0x00000000
		0x00000000
		0x00000000
		0x00000000
		0x00000000
		0x00000000
		0x00000000
		0x00000000
		0x00000000
		0x00000000
		0x00000000
		0x00000000
		0x76543210
		0x0004c008
		0x000000b3
		0x00000000
		0x00000000
		0x00010000
		0x01665555
		0x00665555
		0x00010f00
		0x05010200
		0x00000003
		0x001700c0
		0x00cc0101
		0x00030066
		0x00000000
		0x00000000
		0x00000000
		0x00000000
		0x00000000
		0x00000000
		0x00000000
		0x00000000
		0x04080000
		0x04080400
		0x08000000
		0x0c00c007
		0x00000100
		0x00000100
		0x55555555
		0xaaaaaaaa
		0x55555555
		0xaaaaaaaa
		0x00005555
		0x00000000
		0x00000000
		0x00000000
		0x00000000
		0x00000000
		0x00000000
		0x00000000
		0x00000000
		0x00000000
		0x00000000
		0x00000000
		0x00000000
		0x00000000
		0x00000000
		0x00000000
		0x00000000
		0x00000000
		0x00000000
		0x00000000
		0x00200000
		0x00000000
		0x00000000
		0x00000000
		0x00000000
		0x00000000
		0x00000000
		0x02700270
		0x02700270
		0x02700270
		0x02700270
		0x00000270
		0x00000000
		0x00000000
		0x00000000
		0x00000000
		0x00800000
		0x00800080
		0x00800080
		0x00800080
		0x00800080
		0x00800080
		0x00800080
		0x00800080
		0x00800080
		0x00b30080
		0x00000003
		0x00000000
		0x00020000
		0x00000200
		0x00000000
		0x51315152
		0xc0013150
		0x020000c0
		0x00100001
		0x07054208
		0x000f0c18
		0x01000140
		0x00000c20
		0x00000000
		0x00000000
		0x00000000
		0x00000000
		0x00000000
		0x00000000
		0x00000000
		0x00000000
		0x00000000
		0x00000000
		0x00000000
		0x00000000
		0x00000000
		0x00000000
		0x00000000
		0x00000000
		0x00000000
		0x00000000
		0x00000000
		0x00000000
		0x00000000
		0x00000000
		0x00000000
		0x00000000
		0x00000000
		0x00000000
		0x00000000
		0x00000000
		0x00000000
		0x00000000
		0x00000000
		0x00000000
		0x00000000
		0x00000000
		0x00000000
		0x00000000
		0x00000000
		0x76543210
		0x0004c008
		0x000000b3
		0x00000000
		0x00000000
		0x00010000
		0x01665555
		0x00665555
		0x00010f00
		0x05010200
		0x00000003
		0x001700c0
		0x00cc0101
		0x00030066
		0x00000000
		0x00000000
		0x00000000
		0x00000000
		0x00000000
		0x00000000
		0x00000000
		0x00000000
		0x04080000
		0x04080400
		0x08000000
		0x0c00c007
		0x00000100
		0x00000100
		0x55555555
		0xaaaaaaaa
		0x55555555
		0xaaaaaaaa
		0x00005555
		0x00000000
		0x00000000
		0x00000000
		0x00000000
		0x00000000
		0x00000000
		0x00000000
		0x00000000
		0x00000000
		0x00000000
		0x00000000
		0x00000000
		0x00000000
		0x00000000
		0x00000000
		0x00000000
		0x00000000
		0x00000000
		0x00000000
		0x00200000
		0x00000000
		0x00000000
		0x00000000
		0x00000000
		0x00000000
		0x00000000
		0x02700270
		0x02700270
		0x02700270
		0x02700270
		0x00000270
		0x00000000
		0x00000000
		0x00000000
		0x00000000
		0x00800000
		0x00800080
		0x00800080
		0x00800080
		0x00800080
		0x00800080
		0x00800080
		0x00800080
		0x00800080
		0x00b30080
		0x00000003
		0x00000000
		0x00020000
		0x00000200
		0x00000000
		0x51315152
		0xc0013150
		0x020000c0
		0x00100001
		0x07054208
		0x000f0c18
		0x01000140
		0x00000c20
		0x00000000
		0x00000000
		0x00000000
		0x00000000
		0x00000000
		0x00000000
		0x00000000
		0x00000000
		0x00000000
		0x00000000
		0x00000000
		0x00000000
		0x00000000
		0x00000000
		0x00000000
		0x00000000
		0x00000000
		0x00000000
		0x00000000
		0x00000000
		0x00000000
		0x00000000
		0x00000000
		0x00000000
		0x00000000
		0x00000000
		0x00000000
		0x00000000
		0x00000000
		0x00000000
		0x00000000
		0x00000000
		0x00000000
		0x00000000
		0x00000000
		0x00000000
		0x00000000
		0x76543210
		0x0004c008
		0x000000b3
		0x00000000
		0x00000000
		0x00010000
		0x01665555
		0x00665555
		0x00010f00
		0x05010200
		0x00000003
		0x001700c0
		0x00cc0101
		0x00030066
		0x00000000
		0x00000000
		0x00000000
		0x00000000
		0x00000000
		0x00000000
		0x00000000
		0x00000000
		0x04080000
		0x04080400
		0x08000000
		0x0c00c007
		0x00000100
		0x00000100
		0x55555555
		0xaaaaaaaa
		0x55555555
		0xaaaaaaaa
		0x00005555
		0x00000000
		0x00000000
		0x00000000
		0x00000000
		0x00000000
		0x00000000
		0x00000000
		0x00000000
		0x00000000
		0x00000000
		0x00000000
		0x00000000
		0x00000000
		0x00000000
		0x00000000
		0x00000000
		0x00000000
		0x00000000
		0x00000000
		0x00200000
		0x00000000
		0x00000000
		0x00000000
		0x00000000
		0x00000000
		0x00000000
		0x02700270
		0x02700270
		0x02700270
		0x02700270
		0x00000270
		0x00000000
		0x00000000
		0x00000000
		0x00000000
		0x00800000
		0x00800080
		0x00800080
		0x00800080
		0x00800080
		0x00800080
		0x00800080
		0x00800080
		0x00800080
		0x00b30080
		0x00000003
		0x00000000
		0x00020000
		0x00000200
		0x00000000
		0x51315152
		0xc0013150
		0x020000c0
		0x00100001
		0x07054208
		0x000f0c18
		0x01000140
		0x00000c20
		0x00000000
		0x00000000
		0x00000000
		0x00000000
		0x00000000
		0x00000000
		0x00000000
		0x00000000
		0x00000000
		0x00000000
		0x00000000
		0x00000000
		0x00000000
		0x00000000
		0x00000000
		0x00000000
		0x00000000
		0x00000000
		0x00000000
		0x00000000
		0x00000000
		0x00000000
		0x00000000
		0x00000000
		0x00000000
		0x00000000
		0x00000000
		0x00000000
		0x00000000
		0x00000000
		0x00000000
		0x00000000
		0x00000000
		0x00000000
		0x00000000
		0x00000000
		0x00000000
		0x00000000
		0x00800000
		0x00000000
		0x00000000
		0x00000000
		0x00000000
		0x00000000
		0x00000001
		0x00000000
		0x00000000
		0x00000000
		0x00400320
		0x00000040
		0x00806420
		0x00917531
		0x00806420
		0x01917531
		0x00020003
		0x00000000
		0x00000000
		0x00000000
		0x000556aa
		0x000aaaaa
		0x000aa955
		0x00055555
		0x000b3133
		0x0004cd33
		0x0004cecc
		0x000b32cc
		0x0a418820
		0x103f0000
		0x0000003f
		0x00038055
		0x03800380
		0x03800380
		0x00000380
		0x42080010
		0x00000003
		0x00000000
		0x00000000
		0x00000000
		0x00000000
		0x00000000
		0x00000000
		0x00000000
		0x00000000
		0x00000000
		0x00000000
		0x00000000
		0x00000000
		0x00000000
		0x00000000
		0x00000000
		0x00000000
		0x00000000
		0x00000000
		0x00000000
		0x00000000
		0x00000000
		0x00000000
		0x00000000
		0x00000000
		0x00000000
		0x00000000
		0x00000000
		0x00000000
		0x00000000
		0x00000000
		0x00000000
		0x00000000
		0x00000000
		0x00000000
		0x00000000
		0x00000000
		0x00000000
		0x00000000
		0x00000000
		0x00000000
		0x00000000
		0x00000000
		0x00000000
		0x00000000
		0x00000000
		0x00000000
		0x00000000
		0x00000000
		0x00000000
		0x00000000
		0x00000000
		0x00000000
		0x00000000
		0x00000000
		0x00000000
		0x00000000
		0x00000000
		0x00000000
		0x00000000
		0x00000000
		0x00000000
		0x00000000
		0x00000000
		0x00000000
		0x00000000
		0x00000000
		0x00000000
		0x00000000
		0x00000000
		0x00000000
		0x00000000
		0x00000000
		0x00000000
		0x00000000
		0x00000000
		0x00000000
		0x00000000
		0x00000000
		0x00000000
		0x00000000
		0x00000000
		0x00000000
		0x00000000
		0x00000000
		0x00000000
		0x00000000
		0x00000000
		0x00000000
		0x00000000
		0x00000000
		0x00000000
		0x00800000
		0x00000000
		0x00000000
		0x00000000
		0x00000000
		0x00000000
		0x00000001
		0x00000000
		0x00000000
		0x00000000
		0x00400320
		0x00000040
		0x00008eca
		0x00009fdb
		0x00008eca
		0x01009fdb
		0x00020003
		0x00000000
		0x00000000
		0x00000000
		0x000556aa
		0x000aaaaa
		0x000aa955
		0x00055555
		0x000b3133
		0x0004cd33
		0x0004cecc
		0x000b32cc
		0x0004a0e6
		0x080f0000
		0x0000000f
		0x00038055
		0x03800380
		0x03800380
		0x00000380
		0x42080010
		0x00000003
		0x00000000
		0x00000000
		0x00000000
		0x00000000
		0x00000000
		0x00000000
		0x00000000
		0x00000000
		0x00000000
		0x00000000
		0x00000000
		0x00000000
		0x00000000
		0x00000000
		0x00000000
		0x00000000
		0x00000000
		0x00000000
		0x00000000
		0x00000000
		0x00000000
		0x00000000
		0x00000000
		0x00000000
		0x00000000
		0x00000000
		0x00000000
		0x00000000
		0x00000000
		0x00000000
		0x00000000
		0x00000000
		0x00000000
		0x00000000
		0x00000000
		0x00000000
		0x00000000
		0x00000000
		0x00000000
		0x00000000
		0x00000000
		0x00000000
		0x00000000
		0x00000000
		0x00000000
		0x00000000
		0x00000000
		0x00000000
		0x00000000
		0x00000000
		0x00000000
		0x00000000
		0x00000000
		0x00000000
		0x00000000
		0x00000000
		0x00000000
		0x00000000
		0x00000000
		0x00000000
		0x00000000
		0x00000000
		0x00000000
		0x00000000
		0x00000000
		0x00000000
		0x00000000
		0x00000000
		0x00000000
		0x00000000
		0x00000000
		0x00000000
		0x00000000
		0x00000000
		0x00000000
		0x00000000
		0x00000000
		0x00000000
		0x00000000
		0x00000000
		0x00000000
		0x00000000
		0x00000000
		0x00000000
		0x00000000
		0x00000000
		0x00000000
		0x00000000
		0x00000000
		0x00000000
		0x00000000
		0x00800000
		0x00000000
		0x00000000
		0x00000000
		0x00000000
		0x00000000
		0x00000001
		0x00000000
		0x00000000
		0x00000000
		0x00400320
		0x00000040
		0x00008eca
		0x00009fdb
		0x00008eca
		0x01009fdb
		0x00020003
		0x00000000
		0x00000000
		0x00000000
		0x000556aa
		0x000aaaaa
		0x000aa955
		0x00055555
		0x000b3133
		0x0004cd33
		0x0004cecc
		0x000b32cc
		0x1ee6b16a
		0x10000000
		0x00000000
		0x00038055
		0x03800380
		0x03800380
		0x00000380
		0x42080010
		0x00000003
		0x00000000
		0x00000000
		0x00000000
		0x00000000
		0x00000000
		0x00000000
		0x00000000
		0x00000000
		0x00000000
		0x00000000
		0x00000000
		0x00000000
		0x00000000
		0x00000000
		0x00000000
		0x00000000
		0x00000000
		0x00000000
		0x00000000
		0x00000000
		0x00000000
		0x00000000
		0x00000000
		0x00000000
		0x00000000
		0x00000000
		0x00000000
		0x00000000
		0x00000000
		0x00000000
		0x00000000
		0x00000000
		0x00000000
		0x00000000
		0x00000000
		0x00000000
		0x00000000
		0x00000000
		0x00000000
		0x00000000
		0x00000000
		0x00000000
		0x00000000
		0x00000000
		0x00000000
		0x00000000
		0x00000000
		0x00000000
		0x00000000
		0x00000000
		0x00000000
		0x00000000
		0x00000000
		0x00000000
		0x00000000
		0x00000000
		0x00000000
		0x00000000
		0x00000000
		0x00000000
		0x00000000
		0x00000000
		0x00000000
		0x00000000
		0x00000000
		0x00000000
		0x00000000
		0x00000000
		0x00000000
		0x00000000
		0x00000000
		0x00000000
		0x00000000
		0x00000000
		0x00000000
		0x00000000
		0x00000000
		0x00000000
		0x00000000
		0x00000000
		0x00000000
		0x00000000
		0x00000000
		0x00000000
		0x00000000
		0x00000000
		0x00000000
		0x00000000
		0x00000000
		0x00000000
		0x00000001
		0x00000000
		0x01000005
		0x04000f00
		0x00020040
		0x00020055
		0x00000000
		0x00000000
		0x00000000
		0x00000050
		0x00000000
		0x00010100
		0x00000601
		0x00000000
		0x00006400
		0x01221102
		0x00000000
		0x00051f00
		0x051f051f
		0x051f051f
		0x00030003
		0x03000300
		0x00000300
		0x01221102
		0x00000000
		0x00000000
		0x03020000
		0x00000001
		0x00000011
		0x00000011
		0x00000400
		0x00000000
		0x00000011
		0x00000011
		0x00004410
		0x00004410
		0x00004410
		0x00004410
		0x00004410
		0x00000011
		0x00004410
		0x00000011
		0x00004410
		0x00000011
		0x00004410
		0x00000000
		0x00000000
		0x00000000
		0x04000000
		0x00000000
		0x00000000
		0x00000508
		0x00000000
		0x00000000
		0x00000000
		0x00000000
		0x00000000
		0x00000000
		0xe4000000
		0x00000000
		0x00000000
		0x01010000
		0x00000000
	>;
};
