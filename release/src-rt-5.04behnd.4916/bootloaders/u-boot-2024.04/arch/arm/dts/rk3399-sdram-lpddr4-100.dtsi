// SPDX-License-Identifier: (GPL-2.0+ OR MIT)
/*
 * (C) Copyright 2019 Rockchip Electronics Co., Ltd
 * (C) Copyright 2019 Amarula Solutions.
 * Author: Jagan Teki <jagan@amarulasolutions.com>
 */

&dmc {
	rockchip,sdram-params = <
		0x2
		0xa
		0x3
		0x2
		0x1
		0x0
		0xf
		0xf
		0xf
		0xf
		1
		0x80241d22
		0x15050f08
		0x00000602
		0x00002122
		0x0000004c
		0x00000000
		0x2
		0xa
		0x3
		0x2
		0x1
		0x0
		0xf
		0xf
		0xf
		0xf
		1
		0x80241d22
		0x15050f08
		0x00000602
		0x00002122
		0x0000004c
		0x00000000
		50
		7
		2
		13
		1
		0x00000b00
		0x00000000
		0x00000000
		0x00000000
		0x00000000
		0x00013880
		0x000c3500
		0x00000005
		0x00000320
		0x00027100
		0x00186a00
		0x00000005
		0x00000640
		0x00002710
		0x000186a0
		0x00000005
		0x01000064
		0x00000000
		0x02020101
		0x00000102
		0x00000050
		0x000000c8
		0x00000000
		0x06140000
		0x00081c00
		0x0400040c
		0x19042008
		0x10080a11
		0x22310800
		0x00200f0a
		0x0a030704
		0x08000204
		0x00000a0a
		0x04006db0
		0x0a0a0804
		0x0600db60
		0x0a0a0806
		0x04000db6
		0x02030404
		0x0f0a0800
		0x08040411
		0x1400640a
		0x02010a0a
		0x00010001
		0x04082012
		0x00041109
		0x00000000
		0x03010000
		0x06100048
		0x0c280090
		0x00bb0009
		0x00000000
		0x00060005
		0x000a0005
		0x000a0014
		0x01000000
		0x030a0000
		0x0c000002
		0x00000103
		0x0005030a
		0x00060037
		0x0005006e
		0x05050007
		0x03030605
		0x06050301
		0x06030c05
		0x05050302
		0x03030305
		0x00000301
		0x00000301
		0x00000001
		0x00000000
		0x00000000
		0x01000000
		0x80104002
		0x00040003
		0x00040005
		0x00030000
		0x00050004
		0x00000004
		0x00040003
		0x00040005
		0x18400000
		0x00000c20
		0x185030a0
		0x02ec0000
		0x00000176
		0x00000000
		0x00000000
		0x00000000
		0x00000000
		0x00000000
		0x06030300
		0x00030303
		0x02030200
		0x00040703
		0x03020302
		0x02000407
		0x07030203
		0x00030f04
		0x00070004
		0x00000000
		0x00000000
		0x00000000
		0x00000000
		0x00000000
		0x00000000
		0x00000000
		0x00010000
		0x20040020
		0x00200400
		0x01000400
		0x00000b80
		0x00000000
		0x00000001
		0x00000002
		0x0000000e
		0x00000000
		0x00000000
		0x00000000
		0x00000000
		0x00000000
		0x00500000
		0x00640028
		0x00640404
		0x005000a0
		0x060600c8
		0x000a00c8
		0x000d0005
		0x000d0404
		0x00000000
		0x00000000
		0x00000000
		0x001400a3
		0x00e30009
		0x00120024
		0x00040063
		0x00000000
		0x00310031
		0x00000031
		0x004d0000
		0x004d004d
		0x004d0000
		0x004d004d
		0x00010101
		0x00000000
		0x00000000
		0x001400a3
		0x00e30009
		0x00120024
		0x00040063
		0x00000000
		0x00310031
		0x00000031
		0x004d0000
		0x004d004d
		0x004d0000
		0x004d004d
		0x00010101
		0x00000000
		0x00000000
		0x00000000
		0x00000001
		0x00000000
		0x18151100
		0x0000000c
		0x00000000
		0x00000000
		0x00000000
		0x00000000
		0x00000000
		0x00000000
		0x00000000
		0x00000000
		0x00000000
		0x00000000
		0x00000000
		0x00000000
		0x00000000
		0x00020003
		0x00400100
		0x000c0190
		0x01000200
		0x03200040
		0x00020018
		0x00400100
		0x00080032
		0x00140000
		0x00030028
		0x01010100
		0x02000202
		0x0b000002
		0x01000f0f
		0x00000000
		0x00000000
		0x00010003
		0x00000c03
		0x00040101
		0x04010100
		0x01000000
		0x02010000
		0x00000001
		0x00000000
		0x00000000
		0x00000000
		0x00000000
		0x00000000
		0x00000000
		0x00000000
		0x00000000
		0x00000000
		0x00010000
		0x00000001
		0x01010001
		0x05040001
		0x040a0703
		0x02080808
		0x020e000a
		0x020f010b
		0x000d0008
		0x00080b0a
		0x03000200
		0x00000100
		0x00000000
		0x00000000
		0x0d000001
		0x00000028
		0x00010000
		0x00000003
		0x00000000
		0x00000000
		0x00000000
		0x00000000
		0x00000000
		0x00000000
		0x00000000
		0x00000000
		0x00010100
		0x01000000
		0x00000001
		0x00000303
		0x00000000
		0x00000000
		0x00000000
		0x00000000
		0x00000000
		0x00000000
		0x00000000
		0x00000000
		0x00000000
		0x00000000
		0x00000000
		0x00000000
		0x00000000
		0x00000000
		0x00000000
		0x000556aa
		0x000aaaaa
		0x000aa955
		0x00055555
		0x000b3133
		0x0004cd33
		0x0004cecc
		0x000b32cc
		0x00010300
		0x03000100
		0x00000000
		0x00000000
		0x00000000
		0x00000000
		0x00000000
		0x00000000
		0x00000000
		0x00000000
		0x00ffff00
		0x1a160000
		0x08000012
		0x00000c20
		0x00000200
		0x00000200
		0x00000200
		0x00000200
		0x00000c20
		0x00007940
		0x18500409
		0x00000200
		0x00000200
		0x00000200
		0x00000200
		0x00001850
		0x0000f320
		0x0176060c
		0x00000200
		0x00000200
		0x00000200
		0x00000200
		0x00000176
		0x00000e9c
		0x02020205
		0x03030202
		0x00000018
		0x00000000
		0x00000000
		0x00001403
		0x00000000
		0x00000000
		0x00000000
		0x00030000
		0x000a001c
		0x000e0020
		0x00060018
		0x00000000
		0x00000000
		0x02000000
		0x00090305
		0x00050101
		0x00000000
		0x00000000
		0x00000000
		0x00000000
		0x00000000
		0x00000000
		0x00000000
		0x00000000
		0x01000001
		0x01010101
		0x01000101
		0x01000100
		0x00010001
		0x00010002
		0x00020100
		0x00000002
		0x00000b00
		0x00000000
		0x000002ec
		0x00000176
		0x000030a0
		0x00001850
		0x00001840
		0x01760c20
		0x00000200
		0x00000200
		0x00000200
		0x00000200
		0x00001850
		0x00000200
		0x00000200
		0x00000200
		0x00000200
		0x00000c20
		0x00000200
		0x00000200
		0x00000200
		0x00000200
		0x00010000
		0x00000007
		0x01000001
		0x00000000
		0x3fffffff
		0x00000000
		0x00000000
		0x00000000
		0x00000000
		0x00000000
		0x00000000
		0x00000000
		0x00000000
		0x00000000
		0x00000000
		0x00000000
		0x00000000
		0x00000000
		0x00000000
		0x0f000101
		0x082b3223
		0x080c0004
		0x00061c00
		0x00000214
		0x00bb0009
		0x0c280090
		0x06100048
		0x00000500
		0x00000000
		0x00000000
		0x00000000
		0x00000000
		0x00000000
		0x00000000
		0x00000000
		0x00000000
		0x04040100
		0x0a000004
		0x00000128
		0x00000000
		0x0003000f
		0x00000018
		0x00000000
		0x00000000
		0x00060002
		0x00010001
		0x00000101
		0x00020001
		0x00080004
		0x00000000
		0x05030000
		0x070a0404
		0x00000000
		0x00000000
		0x00000000
		0x000f0f00
		0x0000001e
		0x00000000
		0x01010300
		0x00000000
		0x00000000
		0x01000000
		0x00000101
		0x55555a5a
		0x55555a5a
		0x55555a5a
		0x55555a5a
		0x0c050001
		0x06020009
		0x00010004
		0x00000203
		0x00030000
		0x170f0000
		0x00060018
		0x000e0020
		0x000a001c
		0x00000000
		0x00000000
		0x00000100
		0x140a0000
		0x000d010a
		0x0100c802
		0x010a0064
		0x000e0100
		0x0100000e
		0x00c900c9
		0x00650100
		0x1e1a0065
		0x10010204
		0x06070605
		0x20000202
		0x00201000
		0x00201000
		0x04041000
		0x10020100
		0x0003010c
		0x004b004a
		0x1a0f0000
		0x0102041e
		0x34000000
		0x00000000
		0x00000000
		0x00010000
		0x00000400
		0x00310000
		0x004d4d00
		0x00120024
		0x4d000031
		0x0000144d
		0x00310009
		0x004d4d00
		0x00000004
		0x4d000031
		0x0000244d
		0x00310012
		0x004d4d00
		0x00090014
		0x4d000031
		0x0004004d
		0x00310000
		0x004d4d00
		0x00120024
		0x4d000031
		0x0000144d
		0x00310009
		0x004d4d00
		0x00000004
		0x4d000031
		0x0000244d
		0x00310012
		0x004d4d00
		0x00090014
		0x4d000031
		0x0200004d
		0x00c8000d
		0x08080064
		0x040a0404
		0x03000d92
		0x010a2001
		0x0f11080a
		0x0000110a
		0x2200d92e
		0x080c2003
		0x0809080a
		0x00000a0a
		0x11006c97
		0x040a2002
		0x0200020a
		0x02000200
		0x02000200
		0x02000200
		0x02000200
		0x00000000
		0x00000000
		0x00000000
		0x00000000
		0x00000000
		0x00000000
		0x00000000
		0x00000000
		0x00000000
		0x00000000
		0x00000000
		0x00000000
		0x01000400
		0x00017600
		0x00000e9c
		0x00001850
		0x0000f320
		0x00000c20
		0x00007940
		0x08000000
		0x00000100
		0x00000000
		0x00000000
		0x00000000
		0x00000000
		0x00000002
		0x76543210
		0x0004f008
		0x00020159
		0x00000000
		0x00000000
		0x00010000
		0x01665555
		0x03665555
		0x00010f00
		0x04000100
		0x00000000
		0x00170180
		0x00cc0201
		0x00030066
		0x00000000
		0x00000000
		0x00000000
		0x00000000
		0x00000000
		0x00000000
		0x00000000
		0x00000000
		0x04080000
		0x04080400
		0x30000000
		0x0c00c007
		0x00000100
		0x00000000
		0xfd02fe01
		0xf708fb04
		0xdf20ef10
		0x7f80bf40
		0x0001aaaa
		0x00000000
		0x00000000
		0x00000000
		0x00000000
		0x00000000
		0x00000000
		0x00000000
		0x00000000
		0x00000000
		0x00000000
		0x00000000
		0x00000000
		0x00000000
		0x00000000
		0x00000000
		0x00000000
		0x00000000
		0x00000000
		0x00000000
		0x00200000
		0x00000000
		0x00000000
		0x00000000
		0x00000000
		0x00000000
		0x00000000
		0x02800280
		0x02800280
		0x02800280
		0x02800280
		0x00000280
		0x00000000
		0x00000000
		0x00000000
		0x00000000
		0x00800000
		0x00800080
		0x00800080
		0x00800080
		0x00800080
		0x00800080
		0x00800080
		0x00800080
		0x00800080
		0x01590080
		0x00000000
		0x00000000
		0x00000000
		0x00000200
		0x00000000
		0x51315152
		0xc0003150
		0x010000c0
		0x00100c00
		0x07044204
		0x000f0c18
		0x01000140
		0x00000c10
		0x00000000
		0x00000000
		0x00000000
		0x00000000
		0x00000000
		0x00000000
		0x00000000
		0x00000000
		0x00000000
		0x00000000
		0x00000000
		0x00000000
		0x00000000
		0x00000000
		0x00000000
		0x00000000
		0x00000000
		0x00000000
		0x00000000
		0x00000000
		0x00000000
		0x00000000
		0x00000000
		0x00000000
		0x00000000
		0x00000000
		0x00000000
		0x00000000
		0x00000000
		0x00000000
		0x00000000
		0x00000000
		0x00000000
		0x00000000
		0x00000000
		0x00000000
		0x00000000
		0x76543210
		0x0004f008
		0x00020159
		0x00000000
		0x00000000
		0x00010000
		0x01665555
		0x03665555
		0x00010f00
		0x04000100
		0x00000000
		0x00170180
		0x00cc0201
		0x00030066
		0x00000000
		0x00000000
		0x00000000
		0x00000000
		0x00000000
		0x00000000
		0x00000000
		0x00000000
		0x04080000
		0x04080400
		0x30000000
		0x0c00c007
		0x00000100
		0x00000000
		0xfd02fe01
		0xf708fb04
		0xdf20ef10
		0x7f80bf40
		0x0000aaaa
		0x00000000
		0x00000000
		0x00000000
		0x00000000
		0x00000000
		0x00000000
		0x00000000
		0x00000000
		0x00000000
		0x00000000
		0x00000000
		0x00000000
		0x00000000
		0x00000000
		0x00000000
		0x00000000
		0x00000000
		0x00000000
		0x00000000
		0x00200000
		0x00000000
		0x00000000
		0x00000000
		0x00000000
		0x00000000
		0x00000000
		0x02800280
		0x02800280
		0x02800280
		0x02800280
		0x00000280
		0x00000000
		0x00000000
		0x00000000
		0x00000000
		0x00800000
		0x00800080
		0x00800080
		0x00800080
		0x00800080
		0x00800080
		0x00800080
		0x00800080
		0x00800080
		0x01590080
		0x00000000
		0x00000000
		0x00000000
		0x00000200
		0x00000000
		0x51315152
		0xc0003150
		0x010000c0
		0x00100c00
		0x07044204
		0x000f0c18
		0x01000140
		0x00000c10
		0x00000000
		0x00000000
		0x00000000
		0x00000000
		0x00000000
		0x00000000
		0x00000000
		0x00000000
		0x00000000
		0x00000000
		0x00000000
		0x00000000
		0x00000000
		0x00000000
		0x00000000
		0x00000000
		0x00000000
		0x00000000
		0x00000000
		0x00000000
		0x00000000
		0x00000000
		0x00000000
		0x00000000
		0x00000000
		0x00000000
		0x00000000
		0x00000000
		0x00000000
		0x00000000
		0x00000000
		0x00000000
		0x00000000
		0x00000000
		0x00000000
		0x00000000
		0x00000000
		0x76543210
		0x0004f008
		0x00020159
		0x00000000
		0x00000000
		0x00010000
		0x01665555
		0x03665555
		0x00010f00
		0x04000100
		0x00000000
		0x00170180
		0x00cc0201
		0x00030066
		0x00000000
		0x00000000
		0x00000000
		0x00000000
		0x00000000
		0x00000000
		0x00000000
		0x00000000
		0x04080000
		0x04080400
		0x30000000
		0x0c00c007
		0x00000100
		0x00000000
		0xfd02fe01
		0xf708fb04
		0xdf20ef10
		0x7f80bf40
		0x0001aaaa
		0x00000000
		0x00000000
		0x00000000
		0x00000000
		0x00000000
		0x00000000
		0x00000000
		0x00000000
		0x00000000
		0x00000000
		0x00000000
		0x00000000
		0x00000000
		0x00000000
		0x00000000
		0x00000000
		0x00000000
		0x00000000
		0x00000000
		0x00200000
		0x00000000
		0x00000000
		0x00000000
		0x00000000
		0x00000000
		0x00000000
		0x02800280
		0x02800280
		0x02800280
		0x02800280
		0x00000280
		0x00000000
		0x00000000
		0x00000000
		0x00000000
		0x00800000
		0x00800080
		0x00800080
		0x00800080
		0x00800080
		0x00800080
		0x00800080
		0x00800080
		0x00800080
		0x01590080
		0x00000000
		0x00000000
		0x00000000
		0x00000200
		0x00000000
		0x51315152
		0xc0003150
		0x010000c0
		0x00100c00
		0x07044204
		0x000f0c18
		0x01000140
		0x00000c10
		0x00000000
		0x00000000
		0x00000000
		0x00000000
		0x00000000
		0x00000000
		0x00000000
		0x00000000
		0x00000000
		0x00000000
		0x00000000
		0x00000000
		0x00000000
		0x00000000
		0x00000000
		0x00000000
		0x00000000
		0x00000000
		0x00000000
		0x00000000
		0x00000000
		0x00000000
		0x00000000
		0x00000000
		0x00000000
		0x00000000
		0x00000000
		0x00000000
		0x00000000
		0x00000000
		0x00000000
		0x00000000
		0x00000000
		0x00000000
		0x00000000
		0x00000000
		0x00000000
		0x76543210
		0x0004f008
		0x00020159
		0x00000000
		0x00000000
		0x00010000
		0x01665555
		0x03665555
		0x00010f00
		0x04000100
		0x00000000
		0x00170180
		0x00cc0201
		0x00030066
		0x00000000
		0x00000000
		0x00000000
		0x00000000
		0x00000000
		0x00000000
		0x00000000
		0x00000000
		0x04080000
		0x04080400
		0x30000000
		0x0c00c007
		0x00000100
		0x00000000
		0xfd02fe01
		0xf708fb04
		0xdf20ef10
		0x7f80bf40
		0x0000aaaa
		0x00000000
		0x00000000
		0x00000000
		0x00000000
		0x00000000
		0x00000000
		0x00000000
		0x00000000
		0x00000000
		0x00000000
		0x00000000
		0x00000000
		0x00000000
		0x00000000
		0x00000000
		0x00000000
		0x00000000
		0x00000000
		0x00000000
		0x00200000
		0x00000000
		0x00000000
		0x00000000
		0x00000000
		0x00000000
		0x00000000
		0x02800280
		0x02800280
		0x02800280
		0x02800280
		0x00000280
		0x00000000
		0x00000000
		0x00000000
		0x00000000
		0x00800000
		0x00800080
		0x00800080
		0x00800080
		0x00800080
		0x00800080
		0x00800080
		0x00800080
		0x00800080
		0x01590080
		0x00000000
		0x00000000
		0x00000000
		0x00000200
		0x00000000
		0x51315152
		0xc0003150
		0x010000c0
		0x00100c00
		0x07044204
		0x000f0c18
		0x01000140
		0x00000c10
		0x00000000
		0x00000000
		0x00000000
		0x00000000
		0x00000000
		0x00000000
		0x00000000
		0x00000000
		0x00000000
		0x00000000
		0x00000000
		0x00000000
		0x00000000
		0x00000000
		0x00000000
		0x00000000
		0x00000000
		0x00000000
		0x00000000
		0x00000000
		0x00000000
		0x00000000
		0x00000000
		0x00000000
		0x00000000
		0x00000000
		0x00000000
		0x00000000
		0x00000000
		0x00000000
		0x00000000
		0x00000000
		0x00000000
		0x00000000
		0x00000000
		0x00000000
		0x00000000
		0x00000000
		0x00000000
		0x00000000
		0x00000000
		0x00000000
		0x00000000
		0x00000000
		0x00000002
		0x00000000
		0x00000000
		0x00000000
		0x00400320
		0x00000040
		0x00dcba98
		0x00000000
		0x00dcba98
		0x01000000
		0x00020003
		0x00000000
		0x00000000
		0x00000000
		0x0000002a
		0x00000015
		0x00000015
		0x0000002a
		0x00000033
		0x0000000c
		0x0000000c
		0x00000033
		0x0a418820
		0x003f0000
		0x0000003f
		0x00030055
		0x03000300
		0x03000300
		0x000c0300
		0x42080010
		0x00000003
		0x00000000
		0x00000000
		0x00000000
		0x00000000
		0x00000000
		0x00000000
		0x00000000
		0x00000000
		0x00000000
		0x00000000
		0x00000000
		0x00000000
		0x00000000
		0x00000000
		0x00000000
		0x00000000
		0x00000000
		0x00000000
		0x00000000
		0x00000000
		0x00000000
		0x00000000
		0x00000000
		0x00000000
		0x00000000
		0x00000000
		0x00000000
		0x00000000
		0x00000000
		0x00000000
		0x00000000
		0x00000000
		0x00000000
		0x00000000
		0x00000000
		0x00000000
		0x00000000
		0x00000000
		0x00000000
		0x00000000
		0x00000000
		0x00000000
		0x00000000
		0x00000000
		0x00000000
		0x00000000
		0x00000000
		0x00000000
		0x00000000
		0x00000000
		0x00000000
		0x00000000
		0x00000000
		0x00000000
		0x00000000
		0x00000000
		0x00000000
		0x00000000
		0x00000000
		0x00000000
		0x00000000
		0x00000000
		0x00000000
		0x00000000
		0x00000000
		0x00000000
		0x00000000
		0x00000000
		0x00000000
		0x00000000
		0x00000000
		0x00000000
		0x00000000
		0x00000000
		0x00000000
		0x00000000
		0x00000000
		0x00000000
		0x00000000
		0x00000000
		0x00000000
		0x00000000
		0x00000000
		0x00000000
		0x00000000
		0x00000000
		0x00000000
		0x00000000
		0x00000000
		0x00000000
		0x00000000
		0x00000000
		0x00000000
		0x00000000
		0x00000000
		0x00000000
		0x00000000
		0x00000002
		0x00000000
		0x00000000
		0x00000000
		0x00400320
		0x00000040
		0x00000000
		0x00000000
		0x00000000
		0x01000000
		0x00020003
		0x00000000
		0x00000000
		0x00000000
		0x0000002a
		0x00000015
		0x00000015
		0x0000002a
		0x00000033
		0x0000000c
		0x0000000c
		0x00000033
		0x00000000
		0x00000000
		0x00000000
		0x00030055
		0x03000300
		0x03000300
		0x000c0300
		0x42080010
		0x00000003
		0x00000000
		0x00000000
		0x00000000
		0x00000000
		0x00000000
		0x00000000
		0x00000000
		0x00000000
		0x00000000
		0x00000000
		0x00000000
		0x00000000
		0x00000000
		0x00000000
		0x00000000
		0x00000000
		0x00000000
		0x00000000
		0x00000000
		0x00000000
		0x00000000
		0x00000000
		0x00000000
		0x00000000
		0x00000000
		0x00000000
		0x00000000
		0x00000000
		0x00000000
		0x00000000
		0x00000000
		0x00000000
		0x00000000
		0x00000000
		0x00000000
		0x00000000
		0x00000000
		0x00000000
		0x00000000
		0x00000000
		0x00000000
		0x00000000
		0x00000000
		0x00000000
		0x00000000
		0x00000000
		0x00000000
		0x00000000
		0x00000000
		0x00000000
		0x00000000
		0x00000000
		0x00000000
		0x00000000
		0x00000000
		0x00000000
		0x00000000
		0x00000000
		0x00000000
		0x00000000
		0x00000000
		0x00000000
		0x00000000
		0x00000000
		0x00000000
		0x00000000
		0x00000000
		0x00000000
		0x00000000
		0x00000000
		0x00000000
		0x00000000
		0x00000000
		0x00000000
		0x00000000
		0x00000000
		0x00000000
		0x00000000
		0x00000000
		0x00000000
		0x00000000
		0x00000000
		0x00000000
		0x00000000
		0x00000000
		0x00000000
		0x00000000
		0x00000000
		0x00000000
		0x00000000
		0x00000000
		0x00000000
		0x00000000
		0x00000000
		0x00000000
		0x00000000
		0x00000000
		0x00000002
		0x00000000
		0x00000000
		0x00000000
		0x00400320
		0x00000040
		0x00000000
		0x00000000
		0x00000000
		0x01000000
		0x00020003
		0x00000000
		0x00000000
		0x00000000
		0x0000002a
		0x00000015
		0x00000015
		0x0000002a
		0x00000033
		0x0000000c
		0x0000000c
		0x00000033
		0x1ee6b16a
		0x10000000
		0x00000000
		0x00030055
		0x03000300
		0x03000300
		0x000c0300
		0x42080010
		0x00000003
		0x00000000
		0x00000000
		0x00000000
		0x00000000
		0x00000000
		0x00000000
		0x00000000
		0x00000000
		0x00000000
		0x00000000
		0x00000000
		0x00000000
		0x00000000
		0x00000000
		0x00000000
		0x00000000
		0x00000000
		0x00000000
		0x00000000
		0x00000000
		0x00000000
		0x00000000
		0x00000000
		0x00000000
		0x00000000
		0x00000000
		0x00000000
		0x00000000
		0x00000000
		0x00000000
		0x00000000
		0x00000000
		0x00000000
		0x00000000
		0x00000000
		0x00000000
		0x00000000
		0x00000000
		0x00000000
		0x00000000
		0x00000000
		0x00000000
		0x00000000
		0x00000000
		0x00000000
		0x00000000
		0x00000000
		0x00000000
		0x00000000
		0x00000000
		0x00000000
		0x00000000
		0x00000000
		0x00000000
		0x00000000
		0x00000000
		0x00000000
		0x00000000
		0x00000000
		0x00000000
		0x00000000
		0x00000000
		0x00000000
		0x00000000
		0x00000000
		0x00000000
		0x00000000
		0x00000000
		0x00000000
		0x00000000
		0x00000000
		0x00000000
		0x00000000
		0x00000000
		0x00000000
		0x00000000
		0x00000000
		0x00000000
		0x00000000
		0x00000000
		0x00000000
		0x00000000
		0x00000000
		0x00000000
		0x00000000
		0x00000000
		0x00000000
		0x00000000
		0x00000000
		0x00000000
		0x00000000
		0x00000000
		0x00000005
		0x04000f01
		0x00020040
		0x00020055
		0x00000000
		0x00000000
		0x00000000
		0x00000050
		0x00000000
		0x01010100
		0x00000600
		0x00000000
		0x00006400
		0x09221902
		0x00000000
		0x000d1f01
		0x0d1f0d1f
		0x0d1f0d1f
		0x00030003
		0x03000300
		0x00000300
		0x09221902
		0x00000000
		0x00000000
		0x01020000
		0x00000001
		0x00000411
		0x00000411
		0x00000040
		0x00000040
		0x00000411
		0x00000411
		0x00004410
		0x00004410
		0x00004410
		0x00004410
		0x00004410
		0x00000411
		0x00004410
		0x00000411
		0x00004410
		0x00000411
		0x00004410
		0x00000000
		0x00000000
		0x00000000
		0x64000000
		0x00000000
		0x00000000
		0x00000108
		0x00000000
		0x00000000
		0x00000000
		0x00000000
		0x00000000
		0x00000000
		0xe4000000
		0x00000000
		0x00000000
		0x01010000
		0x00000000
	>;
};
