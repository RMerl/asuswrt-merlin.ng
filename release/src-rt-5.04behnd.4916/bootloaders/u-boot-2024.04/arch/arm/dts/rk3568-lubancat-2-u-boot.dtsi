// SPDX-License-Identifier: GPL-2.0+
/*
 * (C) Copyright 2023 Rockchip Electronics Co., Ltd
 * (C) Copyright 2023 Andy Yan <andyshrk@163.com>
 */

#include "rk356x-u-boot.dtsi"

&sdhci {
	cap-mmc-highspeed;
	mmc-hs400-1_8v;
	mmc-hs400-enhanced-strobe;
	pinctrl-0 = <&emmc_bus8 &emmc_clk &emmc_cmd &emmc_datastrobe>;
};
