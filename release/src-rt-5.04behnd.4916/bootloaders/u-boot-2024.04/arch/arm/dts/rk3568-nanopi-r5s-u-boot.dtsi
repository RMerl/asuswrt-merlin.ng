// SPDX-License-Identifier: GPL-2.0-or-later OR MIT
/*
 * Copyright (c) 2022 FriendlyElec Computer Tech. Co., Ltd.
 * (http://www.friendlyelec.com)
 *
 * Copyright (c) 2023 Tianling Shen <cnsztl@gmail.com>
 */

#include "rk356x-u-boot.dtsi"

&pcie3x1 {
	/delete-property/ vpcie3v3-supply;
};

&sdhci {
	cap-mmc-highspeed;
	mmc-hs200-1_8v;
	mmc-hs400-1_8v;
	mmc-hs400-enhanced-strobe;
	pinctrl-0 = <&emmc_bus8 &emmc_clk &emmc_cmd &emmc_datastrobe>;
};

&vcc5v0_usb_host {
	/delete-property/ regulator-always-on;
	/delete-property/ regulator-boot-on;
};
