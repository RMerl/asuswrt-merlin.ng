// SPDX-License-Identifier: (GPL-2.0+ OR MIT)
/*
 * Copyright (c) 2022 Edgeble AI Technologies Pvt. Ltd.
 */

#include "rk3588j-u-boot.dtsi"

/ {
	aliases {
		mmc0 = &sdmmc;
	};

	chosen {
		u-boot,spl-boot-order = &sdmmc;
	};
};
