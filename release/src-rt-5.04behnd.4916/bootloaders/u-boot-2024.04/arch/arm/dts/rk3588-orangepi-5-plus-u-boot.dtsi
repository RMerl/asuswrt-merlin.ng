// SPDX-License-Identifier: (GPL-2.0+ OR MIT)

#include "rk3588-u-boot.dtsi"

&fspim1_pins {
	bootph-all;
};

&sdhci {
	cap-mmc-highspeed;
	mmc-hs200-1_8v;
};

&sfc {
	bootph-pre-ram;
	u-boot,spl-sfc-no-dma;

	flash@0 {
		bootph-pre-ram;
	};
};
