// SPDX-License-Identifier: (GPL-2.0+ OR MIT)
/*
 * Copyright (c) 2023 Joshua Riek <jjriek@verizon.net>
 *
 */

#include "rk3588-u-boot.dtsi"

&sdhci {
	cap-mmc-highspeed;
	mmc-hs200-1_8v;
};

&uart9 {
	bootph-pre-ram;
	clock-frequency = <24000000>;
};
