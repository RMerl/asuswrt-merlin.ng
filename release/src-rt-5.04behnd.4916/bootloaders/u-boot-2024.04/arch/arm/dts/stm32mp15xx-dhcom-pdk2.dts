// SPDX-License-Identifier: GPL-2.0+ OR BSD-3-Clause
/*
 * Copyright (C) 2019 Marek Vasut <marex@denx.de>
 */
/dts-v1/;

#include "stm32mp151.dtsi"
#include "stm32mp15xc.dtsi"
#include "stm32mp15xx-dhcom-som.dtsi"
#include "stm32mp15xx-dhcom-pdk2.dtsi"

/ {
	model = "STMicroelectronics STM32MP15xx DHCOM Premium Developer Kit (2)";
	compatible = "dh,stm32mp15xx-dhcom-pdk2", "st,stm32mp15x";
};
