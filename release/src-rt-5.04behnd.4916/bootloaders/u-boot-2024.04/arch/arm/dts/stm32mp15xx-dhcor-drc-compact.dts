// SPDX-License-Identifier: (GPL-2.0 OR BSD-3-Clause)
/*
 * Copyright (C) 2022 Marek Vasut <marex@denx.de>
 */

/dts-v1/;

#include "stm32mp151.dtsi"
#include "stm32mp15xc.dtsi"
#include "stm32mp15xx-dhcor-som.dtsi"
#include "stm32mp15xx-dhcor-drc-compact.dtsi"

/ {
	model = "DH electronics STM32MP15xx DHCOR DRC Compact";
	compatible = "dh,stm32mp15xx-dhcor-drc-compact", "st,stm32mp1xx";
};
