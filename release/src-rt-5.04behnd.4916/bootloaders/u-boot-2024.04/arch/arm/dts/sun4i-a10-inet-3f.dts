// SPDX-License-Identifier: GPL-2.0+ OR X11
/*
 * Copyright 2015 Hans de Goede <hdegoede@redhat.com>
 *
 * Minimal dts file for the iNet 3F for u-boot only
 */

/dts-v1/;
#include "sun4i-a10.dtsi"

/ {
	model = "iNet 3F";
	compatible = "inet,3f", "allwinner,sun4i-a10";

	aliases {
		serial0 = &uart0;
	};

	chosen {
		stdout-path = "serial0:115200n8";
	};
};

&uart0 {
	pinctrl-names = "default";
	pinctrl-0 = <&uart0_pb_pins>;
	status = "okay";
};
