// SPDX-License-Identifier: GPL-2.0
/*
 * Xilinx Versal QSPI single DTS
 *
 * Copyright (C) 2018-2019 Xilinx, Inc.
 */

#include "versal-mini-qspi.dtsi"

/ {
	model = "Xilinx Versal MINI QSPI SINGLE";
};

&flash0 {
	spi-rx-bus-width = <4>;
};
