// SPDX-License-Identifier: GPL-2.0
/*
 * Xilinx Versal QSPI x2 Single DTS
 *
 * Copyright (C) 2018-2019 Xilinx, Inc.
 */

#include "versal-mini-qspi.dtsi"

/ {
	model = "Xilinx Versal MINI QSPI X2 SINGLE";
};

&flash0 {
	spi-tx-bus-width = <2>;
	spi-rx-bus-width = <2>;
};
