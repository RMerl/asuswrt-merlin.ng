// SPDX-License-Identifier: GPL-2.0
/*
 * Xilinx Versal QSPI x2 Stacked DTS
 *
 * Copyright (C) 2018-2019 Xilinx, Inc.
 */

#include "versal-mini-qspi.dtsi"

/ {
	model = "Xilinx Versal MINI QSPI X2 STACKED";
};

&qspi {
	num-cs = <2>;
};

&flash0 {
	reg = <0>, <1>;
	stacked-memories = /bits/ 64 <0x8000000 0x8000000>; /* 128MB */
	spi-tx-bus-width = <2>;
	spi-rx-bus-width = <2>;
};
