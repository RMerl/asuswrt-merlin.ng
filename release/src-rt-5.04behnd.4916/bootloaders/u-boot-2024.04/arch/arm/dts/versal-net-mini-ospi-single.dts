// SPDX-License-Identifier: GPL-2.0
/*
 * Xilinx Versal NET OSPI single DTS
 *
 * (C) Copyright 2023, Advanced Micro Devices, Inc.
 *
 * Michal Simek <michal.simek@amd.com>
 * Ashok Reddy Soma <ashok.reddy.soma@amd.com>
 */

#include "versal-net-mini-ospi.dtsi"

/ {
	model = "Xilinx Versal NET MINI OSPI SINGLE";
};

&flash0 {
	spi-rx-bus-width = <8>;
};
