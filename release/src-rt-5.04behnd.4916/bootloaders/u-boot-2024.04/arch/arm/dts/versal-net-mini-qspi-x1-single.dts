// SPDX-License-Identifier: GPL-2.0
/*
 * Xilinx Versal NET QSPI x1 Single DTS
 *
 * (C) Copyright 2023, Advanced Micro Devices, Inc.
 */

#include "versal-net-mini-qspi.dtsi"

/ {
	model = "Xilinx Versal NET MINI QSPI X1 SINGLE";
};

&flash0 {
	spi-tx-bus-width = <1>;
	spi-rx-bus-width = <1>;
};
