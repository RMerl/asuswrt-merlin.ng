// SPDX-License-Identifier: GPL-2.0
/*
 * Xilinx Versal NET QSPI x2 Single DTS
 *
 * (C) Copyright 2023, Advanced Micro Devices, Inc.
 */

#include "versal-net-mini-qspi.dtsi"

/ {
	model = "Xilinx Versal NET MINI QSPI X2 SINGLE";
};

&flash0 {
	spi-tx-bus-width = <2>;
	spi-rx-bus-width = <2>;
};
