// SPDX-License-Identifier: GPL-2.0+ OR MIT
/*
 * Empty device tree for versal-virt board
 *
 * Copyright 2021 Google LLC
 */

/dts-v1/;

/ {
	options {
		u-boot {
			compatible = "u-boot,config";
			bootscr-address = /bits/ 64 <0x20000000>;
		};
	};
};
