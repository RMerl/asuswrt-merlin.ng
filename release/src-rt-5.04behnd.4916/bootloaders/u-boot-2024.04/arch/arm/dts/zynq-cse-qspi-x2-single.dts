// SPDX-License-Identifier: GPL-2.0+
/*
 * Xilinx CSE QSPI x2 Single DTS
 *
 * Copyright (C) 2015 - 2017 Xilinx, Inc.
 */

#include "zynq-cse-qspi.dtsi"

/ {
	model = "Zynq CSE QSPI X2 SINGLE Board";
};

&flash0 {
	spi-rx-bus-width = <2>;
};
