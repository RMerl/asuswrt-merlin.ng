// SPDX-License-Identifier: GPL-2.0+
/*
 * Xilinx ZynqMP QSPI Quad Stacked DTS
 *
 * Copyright (C) 2015 - 2017 Xilinx, Inc.
 */

#include "zynqmp-mini-qspi.dts"

/ {
	model = "ZynqMP MINI QSPI STACKED";
};

&qspi {
	num-cs = <2>;
};

&flash0 {
	reg = <0>, <1>;
	stacked-memories = /bits/ 64 <0x10000000 0x10000000>; /* 256MB */
};
