// SPDX-License-Identifier: GPL-2.0+
/*
 * Xilinx ZynqMP QSPI x1 Single DTS
 *
 * Copyright (C) 2015 - 2017 Xilinx, Inc.
 */

#include "zynqmp-mini-qspi.dts"

/ {
	model = "ZynqMP MINI QSPI X1 SINGLE";
};

&flash0 {
	spi-tx-bus-width = <1>;
	spi-rx-bus-width = <1>;
};
