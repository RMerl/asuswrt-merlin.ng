// SPDX-License-Identifier: GPL-2.0
/*
 * dts file for Xilinx ZynqMP VEK280 revB
 *
 * (C) Copyright 2022 - 2023, Advanced Micro Devices, Inc
 *
 * Michal Simek <michal.simek@amd.com>
 */

#include "zynqmp-sc-vek280-revA.dtso"

&{/} {
	compatible = "xlnx,zynqmp-sc-vek280-revB", "xlnx,zynqmp-vek280-revB",
		     "xlnx,zynqmp-vek280", "xlnx,zynqmp";
};
