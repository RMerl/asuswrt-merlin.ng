## release/src-rt-5.04behnd.4916/bootloaders/u-boot-2024.04/arch/arm/mach-imx/mx7ulp/Kconfig
```kconfig
if ARCH_MX7ULP

config SYS_SOC
	default "mx7ulp"

config LDO_ENABLED_MODE
	bool "i.MX7ULP LDO Enabled Mode"
	help
	  Select this option to enable the PMC1 LDO.

config MX7ULP
	select ARCH_SUPPORT_PSCI
	select CPU_V7_HAS_NONSEC
	select CPU_V7_HAS_VIRT
	select HAS_CAAM
	bool

choice
	prompt "MX7ULP board select"
	optional

config TARGET_MX7ULP_COM
	bool "Support MX7ULP COM board"
	select MX7ULP
	select SYS_ARCH_TIMER
	select SPL_DM if SPL
	select SPL_GPIO if SPL
	select SPL_LIBCOMMON_SUPPORT if SPL
	select SPL_LIBDISK_SUPPORT if SPL
	select SPL_LIBGENERIC_SUPPORT if SPL
	select SPL_MMC if SPL
	select SPL_OF_CONTROL if SPL
	select SPL_OF_LIBFDT if SPL
	select SPL_PINCTRL if SPL
	select SPL_SEPARATE_BSS if SPL
	select SPL_SERIAL if SPL
	select SUPPORT_SPL

config TARGET_MX7ULP_EVK
	bool "Support mx7ulp EVK board"
	select MX7ULP
	select SYS_ARCH_TIMER
	select FSL_CAAM
	select ARCH_MISC_INIT

endchoice

source "board/ea/mx7ulp_com/Kconfig"
source "board/freescale/mx7ulp_evk/Kconfig"

endif
```

## release/src-rt-5.04behnd.4916/bootloaders/u-boot-2024.04/arch/arm/mach-imx/mxs/Kconfig
```kconfig
if ARCH_MX23

config MX23
	bool
	default y

choice
	prompt "MX23 board select"
	optional

config TARGET_MX23_OLINUXINO
	bool "Support mx23_olinuxino"
	select PL01X_SERIAL
	select BOARD_EARLY_INIT_F

config TARGET_MX23EVK
	bool "Support mx23evk"
	select PL01X_SERIAL
	select BOARD_EARLY_INIT_F

endchoice

config SYS_SOC
	default "mxs"

source "board/olimex/mx23_olinuxino/Kconfig"
source "board/freescale/mx23evk/Kconfig"

endif

if ARCH_MX28

config MX28
	bool
	default y

choice
	prompt "MX28 board select"
	optional

config TARGET_MX28EVK
	bool "Support mx28evk"
	select PL01X_SERIAL
	select BOARD_EARLY_INIT_F

config TARGET_XEA
	bool "Support XEA"
	select PL01X_SERIAL

endchoice

config SYS_SOC
	default "mxs"

config SPL_MXS_PMU_MINIMAL_VDD5V_CURRENT
	bool "Force minimal current draw from VDD5V by MX28 PMU"
	help
	  After setting this option, the current drawn from VDD5V
	  by the PMU is reduced to zero - the DCDC_BATT is used as
	  the main power source for PMU.

config SPL_MXS_PMU_DISABLE_BATT_CHARGE
	bool "Disable Battery Charging in MX28 PMU"

config SPL_MXS_PMU_ENABLE_4P2_LINEAR_REGULATOR
	bool "Enable the 4P2 linear regulator in MX28 PMU"
	default y
	help
	  This option enables the 4P2 linear regulator (derived
	  from VDD5V) - so the VDD4P2 power source is operational.

source "board/freescale/mx28evk/Kconfig"
source "board/liebherr/xea/Kconfig"

endif
```

## release/src-rt-5.04behnd.4916/bootloaders/u-boot-2024.04/arch/arm/mach-integrator/Kconfig
```kconfig
menu "Integrator Options"
	depends on ARCH_INTEGRATOR

choice
	prompt "Integrator platform select"
	optional

config ARCH_INTEGRATOR_AP
	bool "Support Integrator/AP platform"

config ARCH_INTEGRATOR_CP
	bool "Support Integrator/CP platform"
	select ARCH_CINTEGRATOR

endchoice

config ARCH_CINTEGRATOR
	bool

choice
	prompt "Integrator core module select"
	optional

config CM720T
	bool "Core Module for ARM720T"
	select CPU_ARM720T

config CM920T
	bool "Core Module for ARM920T"
	select CPU_ARM920T

config CM926EJ_S
	bool "Core Module for ARM926EJ-STM"
	select CPU_ARM926EJS
	select CM_TCRAM

config CM946ES
	bool "Core Module for ARM946E-STM"
	select CPU_ARM946ES
	select CM_MULTIPLE_SSRAM
	select CM_TCRAM

config CM1136
	bool "Core Module for ARM1136JF-STM"
	select CPU_ARM1136
	select CM_TCRAM

endchoice

config SYS_BOARD
	default "integrator"

config SYS_VENDOR
	default "armltd"

config SYS_CONFIG_NAME
	default "integratorap" if ARCH_INTEGRATOR_AP
	default "integratorcp" if ARCH_INTEGRATOR_CP

config SYS_MALLOC_F_LEN
	default 0x2000

config CM_INIT
	def_bool y

config CM_REMAP
	def_bool y

config CM_SPD_DETECT
	def_bool y

config CM_MULTIPLE_SSRAM
	bool

config CM_TCRAM
	bool

endmenu
```

## release/src-rt-5.04behnd.4916/bootloaders/u-boot-2024.04/arch/arm/mach-ipq40xx/Kconfig
```kconfig
if ARCH_IPQ40XX

config SYS_SOC
	default "ipq40xx"

config SYS_MALLOC_F_LEN
	default 0x2000

config TEXT_BASE
	default 0x87300000

config NR_DRAM_BANKS
	default 1

endif
```

## release/src-rt-5.04behnd.4916/bootloaders/u-boot-2024.04/arch/arm/mach-k3/Kconfig
```kconfig
if ARCH_K3

choice
	prompt "Texas Instruments' K3 based SoC select"
	optional

config SOC_K3_AM654
	bool "TI's K3 based AM654 SoC Family Support"

config SOC_K3_J721E
	bool "TI's K3 based J721E SoC Family Support"

config SOC_K3_J721S2
	bool "TI's K3 based J721S2 SoC Family Support"

config SOC_K3_AM642
	bool "TI's K3 based AM642 SoC Family Support"

config SOC_K3_AM625
	bool "TI's K3 based AM625 SoC Family Support"

config SOC_K3_AM62A7
	bool "TI's K3 based AM62A7 SoC Family Support"

endchoice

if SOC_K3_J721E
config SOC_K3_J721E_J7200
	bool "TI's K3 based J7200 SoC variant Family Support"
endif

config SYS_SOC
	default "k3"

config SYS_K3_NON_SECURE_MSRAM_SIZE
	hex
	default 0x80000 if SOC_K3_AM654
	default 0x100000 if SOC_K3_J721E || SOC_K3_J721S2
	default 0x1c0000 if SOC_K3_AM642
	default 0x3c000 if SOC_K3_AM625 || SOC_K3_AM62A7
	help
	  Describes the total size of the MCU or OCMC MSRAM present on
	  the SoC in use. This doesn't specify the total size of SPL as
	  ROM can use some part of this RAM. Once ROM gives control to
	  SPL then this complete size can be usable.

config SYS_K3_MAX_DOWNLODABLE_IMAGE_SIZE
	hex
	default 0x58000 if SOC_K3_AM654
	default 0xc0000 if SOC_K3_J721E || SOC_K3_J721S2
	default 0x180000 if SOC_K3_AM642
	default 0x38000 if SOC_K3_AM625 || SOC_K3_AM62A7
	help
	  Describes the maximum size of the image that ROM can download
	  from any boot media.

config SYS_K3_MCU_SCRATCHPAD_BASE
	hex
	default 0x40280000 if SOC_K3_AM654
	default 0x41cff9fc if SOC_K3_J721S2
	default 0x41cff9fc if SOC_K3_J721E
	help
	  Describes the base address of MCU Scratchpad RAM.

config SYS_K3_MCU_SCRATCHPAD_SIZE
	hex
	default 0x200 if SOC_K3_AM654
	default 0x200 if SOC_K3_J721E || SOC_K3_J721S2
	help
	  Describes the size of MCU Scratchpad RAM.

config SYS_K3_BOOT_PARAM_TABLE_INDEX
	hex
	default 0x41c7fbfc if SOC_K3_AM654
	default 0x41cffbfc if SOC_K3_J721E
	default 0x41cfdbfc if SOC_K3_J721S2
	default 0x701bebfc if SOC_K3_AM642
	default 0x43c3f290 if SOC_K3_AM625
	default 0x43c3f290 if SOC_K3_AM62A7 && CPU_V7R
	default 0x7000f290 if SOC_K3_AM62A7 && ARM64
	help
	  Address at which ROM stores the value which determines if SPL
	  is booted up by primary boot media or secondary boot media.

config SYS_K3_KEY
	string "Key used to generate x509 certificate"
	help
	  This option enables to provide a custom key that can be used for
	  generating x509 certificate for spl binary. If not needed leave
	  it blank so that a random key is generated and used.

config SYS_K3_BOOT_CORE_ID
	int
	default 16

config K3_EARLY_CONS
	bool "Activate to allow for an early console during SPL"
	depends on SPL
	help
	  Turn this option on to enable an early console functionality in SPL
	  before the main console is being brought up. This can be useful in
	  situations where the main console is dependent on System Firmware
	  (SYSFW) being up and running, which is usually not the case during
	  the very early stages of boot. Using this early console functionality
	  will allow for an alternate serial port to be used to support things
	  like UART-based boot and early diagnostic messages until the main
	  console is ready to get activated.

config K3_EARLY_CONS_IDX
	depends on K3_EARLY_CONS
	int "Index of serial device to use for SPL early console"
	default 1
	help
	  Use this option to set the index of the serial device to be used
	  for the early console during SPL execution.

config SYS_K3_SPL_ATF
	bool "Start Cortex-A from SPL"
	depends on CPU_V7R
	help
	  Enabling this will try to start Cortex-A (typically with ATF)
	  after SPL from R5.

config K3_ATF_LOAD_ADDR
	hex "Load address of ATF image"
	default 0x70000000
	help
	  The load address for the ATF image. This value defaults to 0x70000000
	  if not provided in the board defconfig file.

config K3_DM_FW
	bool "Separate DM firmware image"
	depends on CPU_V7R && (SOC_K3_J721E || SOC_K3_J721S2 || SOC_K3_AM625 || SOC_K3_AM62A7) && !CLK_TI_SCI && !TI_SCI_POWER_DOMAIN
	default y
	help
	  Enabling this will indicate that the system has separate DM
	  and TIFS firmware images in place, instead of a single SYSFW
	  firmware. Due to DM being executed on the same core as R5 SPL
	  bootloader, it makes RM and PM services not being available
	  during R5 SPL execution time.

config K3_X509_SWRV
	int "SWRV for X509 certificate used for boot images"
	default 1
	help
	  SWRV for X509 certificate used for boot images

if CPU_V7R
source "arch/arm/mach-k3/r5/Kconfig"
endif

source "arch/arm/mach-k3/am65x/Kconfig"
source "arch/arm/mach-k3/am64x/Kconfig"
source "arch/arm/mach-k3/am62x/Kconfig"
source "arch/arm/mach-k3/am62ax/Kconfig"
source "arch/arm/mach-k3/j721e/Kconfig"
source "arch/arm/mach-k3/j721s2/Kconfig"

endif
```

## release/src-rt-5.04behnd.4916/bootloaders/u-boot-2024.04/arch/arm/mach-k3/am62ax/Kconfig
```kconfig
# SPDX-License-Identifier: GPL-2.0+
#
# Copyright (C) 2023 Texas Instruments Incorporated - https://www.ti.com/
#	Andrew Davis <afd@ti.com>

if SOC_K3_AM62A7

choice
	prompt "K3 AM62Ax based boards"
	optional

config TARGET_AM62A7_A53_EVM
	bool "TI K3 based AM62A7 EVM running on A53"
	select ARM64
	select BINMAN
	imply BOARD
	imply SPL_BOARD
	imply TI_I2C_BOARD_DETECT

config TARGET_AM62A7_R5_EVM
	bool "TI K3 based AM62A7 EVM running on R5"
	select CPU_V7R
	select SYS_THUMB_BUILD
	select K3_LOAD_SYSFW
	select RAM
	select SPL_RAM
	select K3_DDRSS
	select BINMAN
	imply SYS_K3_SPL_ATF
	imply TI_I2C_BOARD_DETECT

endchoice

source "board/ti/am62ax/Kconfig"

endif
```

## release/src-rt-5.04behnd.4916/bootloaders/u-boot-2024.04/arch/arm/mach-k3/am62x/Kconfig
```kconfig
# SPDX-License-Identifier: GPL-2.0+
#
# Copyright (C) 2023 Texas Instruments Incorporated - https://www.ti.com/
#	Andrew Davis <afd@ti.com>

if SOC_K3_AM625

choice
	prompt "K3 AM62x based boards"
	optional

config TARGET_AM625_A53_EVM
	bool "TI K3 based AM625 EVM running on A53"
	select ARM64
	select BINMAN

config TARGET_AM625_R5_EVM
	bool "TI K3 based AM625 EVM running on R5"
	select CPU_V7R
	select SYS_THUMB_BUILD
	select K3_LOAD_SYSFW
	select RAM
	select SPL_RAM
	select K3_DDRSS
	select BINMAN
	imply SYS_K3_SPL_ATF

config TARGET_PHYCORE_AM62X_A53
	bool "PHYTEC phyCORE-AM62x running on A53"
	select ARM64
	select BINMAN

config TARGET_PHYCORE_AM62X_R5
	bool "PHYTEC phyCORE-AM62x running on R5"
	select CPU_V7R
	select SYS_THUMB_BUILD
	select K3_LOAD_SYSFW
	select RAM
	select SPL_RAM
	select K3_DDRSS
	select BINMAN
	imply SYS_K3_SPL_ATF

config TARGET_VERDIN_AM62_A53
	bool "Toradex Verdin AM62 running on A53"
	select ARM64
	select BINMAN

config TARGET_VERDIN_AM62_R5
	bool "Toradex Verdin AM62 running on R5"
	select CPU_V7R
	select SYS_THUMB_BUILD
	select K3_LOAD_SYSFW
	select RAM
	select SPL_RAM
	select K3_DDRSS
	select BINMAN
	imply SYS_K3_SPL_ATF

endchoice

source "board/beagle/beagleplay/Kconfig"
source "board/phytec/phycore_am62x/Kconfig"
source "board/ti/am62x/Kconfig"
source "board/toradex/verdin-am62/Kconfig"

endif
```

## release/src-rt-5.04behnd.4916/bootloaders/u-boot-2024.04/arch/arm/mach-k3/am65x/Kconfig
```kconfig
# SPDX-License-Identifier: GPL-2.0+
#
# Copyright (C) 2023 Texas Instruments Incorporated - https://www.ti.com/
#	Andrew Davis <afd@ti.com>

if SOC_K3_AM654

choice
	prompt "K3 AM65 based boards"
	optional

config TARGET_AM654_A53_EVM
	bool "TI K3 based AM654 EVM running on A53"
	select ARM64
	select SYS_DISABLE_DCACHE_OPS
	select BOARD_LATE_INIT
	select BINMAN
	imply TI_I2C_BOARD_DETECT

config TARGET_AM654_R5_EVM
	bool "TI K3 based AM654 EVM running on R5"
	select CPU_V7R
	select SYS_THUMB_BUILD
	select K3_LOAD_SYSFW
	select K3_AM654_DDRSS
	select BINMAN
	imply SYS_K3_SPL_ATF
	imply TI_I2C_BOARD_DETECT

config TARGET_IOT2050_A53
	bool "IOT2050 running on A53"
	depends on SOC_K3_AM654
	select ARM64
	select BOARD_LATE_INIT
	select SYS_DISABLE_DCACHE_OPS
	select BINMAN
	help
	  This builds U-Boot for the IOT2050 devices.

endchoice

source "board/ti/am65x/Kconfig"
source "board/siemens/iot2050/Kconfig"

endif
```

## release/src-rt-5.04behnd.4916/bootloaders/u-boot-2024.04/arch/arm/mach-k3/j721e/Kconfig
```kconfig
# SPDX-License-Identifier: GPL-2.0+
#
# Copyright (C) 2023 Texas Instruments Incorporated - https://www.ti.com/
#	Andrew Davis <afd@ti.com>

if SOC_K3_J721E

choice
	prompt "K3 J721E based boards"
	optional

config TARGET_J721E_A72_EVM
	bool "TI K3 based J721E EVM running on A72"
	select ARM64
	select BOARD_LATE_INIT
	imply TI_I2C_BOARD_DETECT
	select SYS_DISABLE_DCACHE_OPS
	select BINMAN

config TARGET_J721E_R5_EVM
	bool "TI K3 based J721E EVM running on R5"
	select CPU_V7R
	select SYS_THUMB_BUILD
	select K3_LOAD_SYSFW
	select RAM
	select SPL_RAM
	select K3_DDRSS
	select BINMAN
	imply SYS_K3_SPL_ATF
	imply TI_I2C_BOARD_DETECT

config TARGET_J7200_A72_EVM
	bool "TI K3 based J7200 EVM running on A72"
	select ARM64
	select SOC_K3_J721E_J7200
	select BOARD_LATE_INIT
	imply TI_I2C_BOARD_DETECT
	select SYS_DISABLE_DCACHE_OPS
	select BINMAN

config TARGET_J7200_R5_EVM
	bool "TI K3 based J7200 EVM running on R5"
	select CPU_V7R
	select SYS_THUMB_BUILD
	select K3_LOAD_SYSFW
	select RAM
	select SPL_RAM
	select K3_DDRSS
	select BINMAN
	imply SYS_K3_SPL_ATF
	imply TI_I2C_BOARD_DETECT

endchoice

source "board/beagle/beagleboneai64/Kconfig"
source "board/ti/j721e/Kconfig"

endif
```

## release/src-rt-5.04behnd.4916/bootloaders/u-boot-2024.04/arch/arm/mach-k3/j721s2/Kconfig
```kconfig
# SPDX-License-Identifier: GPL-2.0+
#
# Copyright (C) 2023 Texas Instruments Incorporated - https://www.ti.com/
#	Andrew Davis <afd@ti.com>

if SOC_K3_J721S2

choice
	prompt "K3 J721S2 based boards"
	optional

config TARGET_J721S2_A72_EVM
	bool "TI K3 based J721S2 EVM running on A72"
	select ARM64
	select BOARD_LATE_INIT
	imply TI_I2C_BOARD_DETECT
	select SYS_DISABLE_DCACHE_OPS
	select BINMAN

config TARGET_J721S2_R5_EVM
	bool "TI K3 based J721S2 EVM running on R5"
	select CPU_V7R
	select SYS_THUMB_BUILD
	select K3_LOAD_SYSFW
	select RAM
	select SPL_RAM
	select K3_DDRSS
	select BINMAN
	imply SYS_K3_SPL_ATF
	imply TI_I2C_BOARD_DETECT

endchoice

source "board/ti/j721s2/Kconfig"

endif
```
