## release/src-rt-5.04behnd.4916/bootloaders/u-boot-2024.04/arch/arm/mach-k3/r5/Kconfig
```kconfig
config K3_LOAD_SYSFW
	bool

config K3_QOS
	bool "Enable Quality of Service (QoS) Settings for TI K3 SoCs"
	default y if SOC_K3_AM62A7
	help
	  This option enables the R5 SPL to apply QoS settings for various
	  HW controllers inside the TI K3 SoCs. The files for QoS settings are
	  generated from Sysconfig and k3-resource-partitioning tools.

config K3_SYSFW_IMAGE_NAME
	string "File name of SYSFW firmware and configuration blob"
	depends on K3_LOAD_SYSFW
	default	"sysfw.itb"
	help
	  Filename of the combined System Firmware and configuration image tree
	  blob to be loaded when booting from a filesystem.

config K3_SYSFW_IMAGE_MMCSD_RAW_MODE_SECT
	hex "MMC sector to load SYSFW firmware and configuration blob from"
	depends on K3_LOAD_SYSFW && SYS_MMCSD_RAW_MODE_U_BOOT_USE_SECTOR
	default 0x3600
	help
	  Address on the MMC to load the combined System Firmware and
	  configuration image tree blob from, when the MMC is being used
	  in raw mode. Units: MMC sectors (1 sector = 512 bytes).

config K3_SYSFW_IMAGE_MMCSD_RAW_MODE_PART
	hex "MMC partition to load SYSFW firmware and configuration blob from"
	depends on K3_LOAD_SYSFW && SYS_MMCSD_RAW_MODE_U_BOOT_USE_PARTITION
	default 2
	help
	  Partition on the MMC to the combined System Firmware and configuration
	  image tree blob from, when the MMC is being used in raw mode.

config K3_SYSFW_IMAGE_SIZE_MAX
	int "Amount of memory dynamically allocated for loading SYSFW blob"
	depends on K3_LOAD_SYSFW
	default	280000
	help
	  Amount of memory (in bytes) reserved through dynamic allocation at
	  runtime for loading the combined System Firmware and configuration image
	  tree blob. Keep it as tight as possible, as this directly affects the
	  overall SPL memory footprint.

config K3_SYSFW_IMAGE_SPI_OFFS
	hex "SPI offset of SYSFW firmware and configuration blob"
	depends on K3_LOAD_SYSFW
	default	0x6C0000
	help
	  Offset of the combined System Firmware and configuration image tree
	  blob to be loaded when booting from a SPI flash memory.
```

## release/src-rt-5.04behnd.4916/bootloaders/u-boot-2024.04/arch/arm/mach-keystone/Kconfig
```kconfig
if ARCH_KEYSTONE

choice
	prompt "TI Keystone board select"
	optional

config TARGET_K2HK_EVM
	bool "TI Keystone 2 Kepler/Hawking EVM"
	select SOC_K2HK

config TARGET_K2E_EVM
	bool "TI Keystone 2 Edison EVM"
	select SOC_K2E

config TARGET_K2L_EVM
	bool "TI Keystone 2 Lamar EVM"
	select SOC_K2L

config TARGET_K2G_EVM
	bool "TI Keystone 2 Galileo EVM"
        select BOARD_LATE_INIT
	select SOC_K2G
        select TI_I2C_BOARD_DETECT

endchoice

config SOC_K2E
	bool

config SOC_K2G
	bool

config SOC_K2HK
	bool

config SOC_K2L
	bool

config SYS_SOC
	default "keystone"

source "board/ti/ks2_evm/Kconfig"

endif
```

## release/src-rt-5.04behnd.4916/bootloaders/u-boot-2024.04/arch/arm/mach-kirkwood/Kconfig
```kconfig
if ARCH_KIRKWOOD

config FEROCEON_88FR131
	bool

config KW88F6192
	bool
	select ARCH_VERY_EARLY_INIT

config KW88F6281
	bool
	select ARCH_VERY_EARLY_INIT

config SHEEVA_88SV131
	bool

config KIRKWOOD_COMMON
	bool
	select DM_SERIAL
	select SYS_NS16550

config HAS_CUSTOM_SYS_INIT_SP_ADDR
        bool "Use a custom location for the initial stack pointer address"
        default y

config CUSTOM_SYS_INIT_SP_ADDR
        hex "Static location for the initial stack pointer"
        depends on HAS_CUSTOM_SYS_INIT_SP_ADDR
        default 0x5ff000

choice
	prompt "Marvell Kirkwood board select"
	optional

config TARGET_OPENRD
	bool "Marvell OpenRD Board"
	select KW88F6281
	select SHEEVA_88SV131

config TARGET_DREAMPLUG
	bool "DreamPlug Board"
	select KW88F6281
	select SHEEVA_88SV131
	select KIRKWOOD_COMMON

config TARGET_DS109
	bool "Synology DS109"
	select KW88F6281
	select SHEEVA_88SV131

config TARGET_GURUPLUG
	bool "GuruPlug Board"
	select KW88F6281
	select SHEEVA_88SV131

config TARGET_SHEEVAPLUG
	bool "SheevaPlug Board"
	select FEROCEON_88FR131
	select KW88F6281
	select KIRKWOOD_COMMON

config TARGET_LSXL
	bool "lsxl Board"
	select FEROCEON_88FR131
	select KW88F6281
	select BOARD_EARLY_INIT_R
	select MISC_INIT_R
	select KIRKWOOD_COMMON

config TARGET_POGO_E02
	bool "pogo_e02 Board"
	select FEROCEON_88FR131
	select KW88F6281
	select KIRKWOOD_COMMON

config TARGET_POGO_V4
	bool "Pogoplug V4 Board"
	select FEROCEON_88FR131
	select KW88F6192
	select KIRKWOOD_COMMON

config TARGET_DNS325
	bool "dns325 Board"
	select FEROCEON_88FR131
	select KW88F6281

config TARGET_ICONNECT
	bool "iconnect Board"
	select FEROCEON_88FR131
	select KW88F6281
	select KIRKWOOD_COMMON

config TARGET_KM_KIRKWOOD
	bool "KM Kirkwood Board"
	select FEROCEON_88FR131
	select KW88F6281
	select VENDOR_KM

config TARGET_NET2BIG_V2
	bool "LaCie 2Big Network v2 NAS Board"
	select FEROCEON_88FR131
	select KW88F6281

config TARGET_NETSPACE_V2
	bool "LaCie netspace_v2 Board"
	select FEROCEON_88FR131

config TARGET_IB62X0
	bool "ib62x0 Board"
	select FEROCEON_88FR131
	select KW88F6281

config TARGET_DOCKSTAR
	bool "Dockstar Board"
	select FEROCEON_88FR131
	select KW88F6281
	select KIRKWOOD_COMMON

config TARGET_GOFLEXHOME
	bool "GoFlex Home Board"
	select FEROCEON_88FR131
	select KW88F6281
	select KIRKWOOD_COMMON

config TARGET_NAS220
	bool "BlackArmor NAS220"
	select FEROCEON_88FR131
	select KW88F6192

config TARGET_NSA310S
	bool "Zyxel NSA310S"
	select FEROCEON_88FR131
	select KW88F6192
	select KIRKWOOD_COMMON

config TARGET_NSA325
	bool "ZyXEL NSA325"
	select FEROCEON_88FR131
	select KW88F6281
	select KIRKWOOD_COMMON

config TARGET_SBx81LIFKW
	bool "Allied Telesis SBx81GS24/SBx81GT40/SBx81XS6/SBx81XS16"
	select FEROCEON_88FR131
	select KW88F6281

config TARGET_SBx81LIFXCAT
	bool "Allied Telesis SBx81GP24/SBx81GT24"
	select FEROCEON_88FR131
	select KW88F6281

endchoice

config SYS_SOC
	default "kirkwood"

config KIRKWOOD_RGMII_PAD_1V8
	bool "Configures the I/O voltage of the pads connected gigabit interface to 1.8V"
	default y

config KIRKWOOD_EGIGA_INIT
	bool "Enable GbePort0/1 for kernel"
	default y

config KIRKWOOD_PCIE_INIT
	bool "Enable PCIe Port0 for kernel"
	default y

source "board/Marvell/openrd/Kconfig"
source "board/Marvell/dreamplug/Kconfig"
source "board/Synology/ds109/Kconfig"
source "board/Marvell/guruplug/Kconfig"
source "board/Marvell/sheevaplug/Kconfig"
source "board/buffalo/lsxl/Kconfig"
source "board/cloudengines/pogo_e02/Kconfig"
source "board/cloudengines/pogo_v4/Kconfig"
source "board/d-link/dns325/Kconfig"
source "board/iomega/iconnect/Kconfig"
source "board/LaCie/net2big_v2/Kconfig"
source "board/LaCie/netspace_v2/Kconfig"
source "board/raidsonic/ib62x0/Kconfig"
source "board/Seagate/dockstar/Kconfig"
source "board/Seagate/goflexhome/Kconfig"
source "board/Seagate/nas220/Kconfig"
source "board/zyxel/nsa310s/Kconfig"
source "board/zyxel/nsa325/Kconfig"
source "board/alliedtelesis/SBx81LIFKW/Kconfig"
source "board/alliedtelesis/SBx81LIFXCAT/Kconfig"

endif
```

## release/src-rt-5.04behnd.4916/bootloaders/u-boot-2024.04/arch/arm/mach-lpc32xx/Kconfig
```kconfig
if ARCH_LPC32XX

config SYS_SOC
	default "lpc32xx"

choice
	prompt "NXP LPC32xx board select"

config TARGET_DEVKIT3250
	bool "Timll DevKit3250"

config TARGET_WORK_92105
	bool "Work Microwave Work_92105"

config TARGET_EA_LPC3250DEVKITV2
	bool "Embedded Artists LPC3250 Developer's Kit v2"

endchoice

source "board/timll/devkit3250/Kconfig"
source "board/work-microwave/work_92105/Kconfig"
source "board/ea/ea-lpc3250devkitv2/Kconfig"

endif
```

## release/src-rt-5.04behnd.4916/bootloaders/u-boot-2024.04/arch/arm/mach-mediatek/Kconfig
```kconfig
if ARCH_MEDIATEK

config SYS_SOC
	default "mediatek"

config SYS_VENDOR
	default "mediatek"

config MT8512
	bool "MediaTek MT8512 SoC"

choice
	prompt "MediaTek board select"

config TARGET_MT7622
	bool "MediaTek MT7622 SoC"
	select ARM64
	help
	  The MediaTek MT7622 is a ARM64-based SoC with a dual-core Cortex-A53.
	  including UART, SPI, USB3.0, SD and MMC cards, NAND, SNFI, PWM, PCIe,
	  Gigabit Ethernet, I2C, built-in Wi-Fi, and PCIe.

config TARGET_MT7623
	bool "MediaTek MT7623 SoC"
	select CPU_V7A
	help
	  The MediaTek MT7623 is a ARM-based SoC with a quad-core Cortex-A7
	  including NEON and GPU, Mali-450 graphics, several DDR3 options,
	  crypto engine, built-in Wi-Fi / Bluetooth combo chip, JPEG decoder,
	  video interfaces supporting HDMI and MIPI, and video codec support.
	  Peripherals include Gigabit Ethernet, switch, USB3.0 and OTG, PCIe,
	  I2S, PCM, S/PDIF, UART, SPI, I2C, IR TX/RX, and PWM.

config TARGET_MT7629
	bool "MediaTek MT7629 SoC"
	select CPU_V7A
	select SPL
	help
	  The MediaTek MT7629 is a ARM-based SoC with a dual-core Cortex-A7
	  including DDR3, crypto engine, 3x3 11n/ac Wi-Fi, Gigabit Ethernet,
	  switch, USB3.0, PCIe, UART, SPI, I2C and PWM.

config TARGET_MT7981
	bool "MediaTek MT7981 SoC"
	select ARM64
	select CPU
	help
	  The MediaTek MT7981 is a ARM64-based SoC with a dual-core Cortex-A53.
	  including UART, SPI, USB, NAND, SNFI, PWM, Gigabit Ethernet, I2C,
          built-in Wi-Fi, and PCIe.

config TARGET_MT7986
	bool "MediaTek MT7986 SoC"
	select ARM64
	select CPU
	help
	  The MediaTek MT7986 is a ARM64-based SoC with a quad-core Cortex-A53.
	  including UART, SPI, SPI flash, USB3.0, MMC, NAND, SNFI, PWM, PCIe,
	  Gigabit Ethernet, I2C, built-in 4x4 Wi-Fi, and PCIe.

config TARGET_MT7988
	bool "MediaTek MT7988 SoC"
	select ARM64
	select CPU
	help
	  The MediaTek MT7988 is a ARM64-based SoC with a quad-core Cortex-A73.
	  including UART, SPI, SPI flash, USB3.0, MMC, NAND, SNFI, PWM, PCIe,
	  10 Gigabit Ethernet , I2C, and PCIe.

config TARGET_MT8183
	bool "MediaTek MT8183 SoC"
	select ARM64
	help
	  The MediaTek MT8183 is a ARM64-based SoC with a quad-core Cortex-A73 and
	  a quad-core Cortex-A53. It is including UART, SPI, USB3.0 dual role,
	  SD and MMC cards, UFS, PWM, I2C, I2S, S/PDIF, and several LPDDR3
	  and LPDDR4 options.

config TARGET_MT8365
	bool "MediaTek MT8365 SoC"
	select ARM64
	help
	  The MediaTek MT8365 is a ARM64-based SoC with a quad-core Cortex-A53.
	  It is including UART, SPI, USB2.0 dual role, SD and MMC cards, NAND, PWM,
	  I2C, I2S, S/PDIF, and several LPDDR3 and LPDDR4 options.

config TARGET_MT8512
        bool "MediaTek MT8512 M1 Board"
        select ARM64
	select MT8512
        help
          The MediaTek MT8512 is a ARM64-based SoC with a dual-core Cortex-A53.
          including UART, SPI, USB2.0 and OTG, SD and MMC cards, NAND, PWM,
          IR RX, I2C, I2S, S/PDIF, and built-in Wi-Fi / Bluetooth digital
          and several LPDDR3 and LPDDR4 options.

config TARGET_MT8516
	bool "MediaTek MT8516 SoC"
	select ARM64
	help
	  The MediaTek MT8516 is a ARM64-based SoC with a quad-core Cortex-A35.
	  including UART, SPI, USB2.0 and OTG, SD and MMC cards, NAND, PWM,
	  Ethernet, IR TX/RX, I2C, I2S, S/PDIF, and built-in Wi-Fi / Bluetooth combo
	  chip and several DDR3 and DDR4 options.

config TARGET_MT8518
	bool "MediaTek MT8518 SoC"
	select ARM64
	help
	  The MediaTek MT8518 is a ARM64-based SoC with a quad-core Cortex-A53.
	  including UART, SPI, USB2.0 and OTG, SD and MMC cards, NAND, PWM,
	  Ethernet, IR TX/RX, I2C, I2S, S/PDIF, and built-in Wi-Fi / Bluetooth combo
	  chip and several DDR3 and DDR4 options.

endchoice

config SYS_BOARD
	string "Board name"
	default "mt7622" if TARGET_MT7622
	default "mt7623" if TARGET_MT7623
	default "mt7629" if TARGET_MT7629
	default "mt7981" if TARGET_MT7981
	default "mt7986" if TARGET_MT7986
	default "mt7988" if TARGET_MT7988
	default "mt8183" if TARGET_MT8183
	default "mt8512" if TARGET_MT8512
	default "mt8516" if TARGET_MT8516
	default "mt8518" if TARGET_MT8518
	default ""
	help
	  This option contains information about board name.
	  Based on this option board/<CONFIG_SYS_VENDOR>/<CONFIG_SYS_BOARD> will
	  be used.

config SYS_CONFIG_NAME
	string "Board configuration name"
	default "mt7622" if TARGET_MT7622
	default "mt7623" if TARGET_MT7623
	default "mt7629" if TARGET_MT7629
	default "mt7981" if TARGET_MT7981
	default "mt7986" if TARGET_MT7986
	default "mt7988" if TARGET_MT7988
	default "mt8183" if TARGET_MT8183
	default "mt8365" if TARGET_MT8365
	default "mt8512" if TARGET_MT8512
	default "mt8516" if TARGET_MT8516
	default "mt8518" if TARGET_MT8518
	default ""
	help
	  This option contains information about board configuration name.
	  Based on this option include/configs/<CONFIG_SYS_CONFIG_NAME>.h header
	  will be used for board configuration.

config MTK_BROM_HEADER_INFO
	string
	default "media=nor" if TARGET_MT8518 || TARGET_MT8512 || TARGET_MT7629 || TARGET_MT7622
	default "media=emmc" if TARGET_MT8516 || TARGET_MT8365 || TARGET_MT8183
	default "media=snand;nandinfo=2k+64" if TARGET_MT7981 || TARGET_MT7986 || TARGET_MT7988
	default "lk=1" if TARGET_MT7623

endif
```
