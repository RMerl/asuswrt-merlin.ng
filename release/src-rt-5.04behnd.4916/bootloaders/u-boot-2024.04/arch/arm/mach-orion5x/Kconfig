## release/src-rt-5.04behnd.4916/bootloaders/u-boot-2024.04/arch/arm/mach-rockchip/px30/Kconfig
```kconfig
if ROCKCHIP_PX30

config TARGET_EVB_PX30
	bool "EVB_PX30"
	help
	  This target config option used for below listed px30 boards.

	  EVB_PX30:
	  * EVB_PX30 is an evaluation board for Rockchip PX30.

config TARGET_ODROID_GO2
	bool "ODROID_GO2"

config TARGET_PX30_CORE
	bool "Engicam PX30.Core"
	help
	  PX30.Core EDIMM2.2:
	  * PX30.Core is an EDIMM SOM based on Rockchip PX30 from Engicam.
	  * EDIMM2.2 is a Form Factor Capacitive Evaluation Board from Engicam.
	  * PX30.Core needs to mount on top of EDIMM2.2 for creating complete
	    PX30.Core EDIMM2.2 Starter Kit.

	  PX30.Core CTOUCH2:
	  * PX30.Core is an EDIMM SOM based on Rockchip PX30 from Engicam.
	  * CTOUCH2.0 is a general purpose Carrier board with capacitive
	    touch interface support.
	  * PX30.Core needs to mount on top of CTOUCH2.0 for creating complete
	    PX30.Core C.TOUCH Carrier board.

	  PX30.Core CTOUCH2-OF10:
	  * PX30.Core is an EDIMM SOM based on Rockchip PX30 from Engicam.
	  * CTOUCH2.0 is a general purpose Carrier board with capacitive
	    touch interface support.
	  * 10.1" OF is a capacitive touch 10.1" Open Frame panel solutions.
	  * PX30.Core needs to mount on top of C.TOUCH 2.0 carrier with pluged
            10.1" OF for creating complete PX30.Core C.TOUCH 2.0 10.1" Open Frame.

config TARGET_RINGNECK_PX30
	bool "Theobroma Systems PX30-µQ7 (Ringneck)"
	help
	  The PX30-uQ7 (Ringneck) SoM is a µQseven-compatible (40mmx70mm,
          MXM-230 connector) system-on-module from Theobroma Systems[1],
	  featuring the Rockchip PX30.

	  It provides the following feature set:
	    * up to 4GB DDR4
	    * up to 128GB on-module eMMC (with 8-bit 1.8V interface)
	    * SD card (on a baseboard) via edge connector
	    * Fast Ethernet with on-module TI DP83825I PHY
	    * MIPI-DSI/LVDS
	    * MIPI-CSI
	    * USB
	      - 1x USB 2.0 dual-role
	      - 3x USB 2.0 host
	    * on-module companion controller (STM32 Cortex-M0 or ATtiny), implementing:
	      - low-power RTC functionality (ISL1208 emulation)
	      - fan controller (AMC6821 emulation)
	      - USB<->CAN bridge controller (STM32 only)
	    * on-module Espressif ESP32 for Bluetooth + 2.4GHz WiFi
	    * on-module NXP SE05x Secure Element

config ROCKCHIP_BOOT_MODE_REG
	default 0xff010200

config ROCKCHIP_STIMER_BASE
	default 0xff220020

config SYS_SOC
	default "px30"

config SYS_MALLOC_F_LEN
	default 0x400

config SPL_SERIAL
	default y

config TPL_LDSCRIPT
	default "arch/arm/mach-rockchip/u-boot-tpl-v8.lds"

config TPL_TEXT_BASE
	default 0xff0e1000

config TPL_STACK
	default 0xff0e4fff

config DEBUG_UART_CHANNEL
	int "Mux channel to use for debug UART2/UART3"
	depends on DEBUG_UART_BOARD_INIT
	default 0
	help
	  UART2 and UART3 can use two different set of pins to route the output.
	  For using the UART for early debugging the route to use needs
	  to be declared (0 or 1).

source "board/engicam/px30_core/Kconfig"
source "board/hardkernel/odroid_go2/Kconfig"
source "board/rockchip/evb_px30/Kconfig"
source "board/theobroma-systems/ringneck_px30/Kconfig"

endif
```

## release/src-rt-5.04behnd.4916/bootloaders/u-boot-2024.04/arch/arm/mach-rockchip/rk3036/Kconfig
```kconfig
if ROCKCHIP_RK3036

choice
	prompt "RK3036 board select"

config TARGET_EVB_RK3036
	bool "EVB_RK3036"
	select BOARD_LATE_INIT

config TARGET_KYLIN_RK3036
	bool "KYLIN_RK3036"
	select BOARD_LATE_INIT

endchoice

config ROCKCHIP_BOOT_MODE_REG
	default 0x200081c8

config ROCKCHIP_STIMER_BASE
	default 0x200440a0

config SYS_SOC
	default "rk3036"

config SYS_MALLOC_F_LEN
	default 0x400

config SPL_SERIAL
	default y

source "board/rockchip/evb_rk3036/Kconfig"
source "board/rockchip/kylin_rk3036/Kconfig"

endif
```

## release/src-rt-5.04behnd.4916/bootloaders/u-boot-2024.04/arch/arm/mach-rockchip/rk3066/Kconfig
```kconfig
if ROCKCHIP_RK3066

config TARGET_MK808
	bool "MK808"
	help
	  MK808 is a RK3066-based board with 1 USB host and 1 USB OTG port,
	  HDMI and a micro-SD card slot. It also includes on-board NAND
	  and 1GB of SDRAM.

config ROCKCHIP_BOOT_MODE_REG
	default 0x20004040

config ROCKCHIP_BOOT_LR_REG
	hex
	default 0x00001058

config ROCKCHIP_BOOT_RETURN_REG
	hex
	default 0x00001100

config SYS_SOC
	default "rk3066"

config SYS_MALLOC_F_LEN
	default 0x0800

config SPL_LIBCOMMON_SUPPORT
	default y

config SPL_LIBGENERIC_SUPPORT
	default y

config SPL_SERIAL
	default y

config TPL_LIBCOMMON_SUPPORT
	default y

config TPL_LIBGENERIC_SUPPORT
	default y

config TPL_SERIAL
	default y

source "board/rikomagic/mk808/Kconfig"

endif
```

## release/src-rt-5.04behnd.4916/bootloaders/u-boot-2024.04/arch/arm/mach-rockchip/rk3128/Kconfig
```kconfig
if ROCKCHIP_RK3128

choice
	prompt "RK3128 board select"

config TARGET_EVB_RK3128
	bool "RK3128 evaluation board"
	select BOARD_LATE_INIT
	help
	  RK3128evb is a evaluation board for Rockchip rk3128,
	  with full function and phisical connectors support like
	  usb2.0 host ports, LVDS, JTAG, MAC, SDcard, HDMI, USB-2-serial...

endchoice

config ROCKCHIP_BOOT_MODE_REG
	default 0x100a0038

config ROCKCHIP_STIMER_BASE
	default 0x200440a0

config SYS_SOC
	default "rk3128"

config SYS_MALLOC_F_LEN
	default 0x0800

source "board/rockchip/evb_rk3128/Kconfig"

endif
```

## release/src-rt-5.04behnd.4916/bootloaders/u-boot-2024.04/arch/arm/mach-rockchip/rk322x/Kconfig
```kconfig
if ROCKCHIP_RK322X


config TARGET_EVB_RK3229
	bool "EVB_RK3229"
	select BOARD_LATE_INIT

config ROCKCHIP_BOOT_MODE_REG
	default 0x110005c8

config ROCKCHIP_STIMER_BASE
	default 0x110d0020

config SYS_SOC
	default "rk322x"

config SYS_MALLOC_F_LEN
	default 0x800

config SPL_LIBCOMMON_SUPPORT
	default y

config SPL_LIBGENERIC_SUPPORT
	default y

config SPL_SERIAL
	default y

config TPL_STACK
        default 0x10088000

config TPL_TEXT_BASE
        default 0x10081000

source "board/rockchip/evb_rk3229/Kconfig"

endif
```

## release/src-rt-5.04behnd.4916/bootloaders/u-boot-2024.04/arch/arm/mach-rockchip/rk3308/Kconfig
```kconfig
if ROCKCHIP_RK3308

config TARGET_EVB_RK3308
	bool "EVB_RK3308"
	select BOARD_LATE_INIT

config TARGET_ROC_RK3308_CC
       bool "Firefly roc-rk3308-cc"
	select BOARD_LATE_INIT

config ROCKCHIP_BOOT_MODE_REG
	default 0xff000500

config ROCKCHIP_STIMER_BASE
	default 0xff1b00a0

config SYS_SOC
	default "rk3308"

config SYS_MALLOC_F_LEN
	default 0x400

config SPL_SERIAL
	default y

source "board/rockchip/evb_rk3308/Kconfig"
source "board/firefly/firefly-rk3308/Kconfig"

endif
```

## release/src-rt-5.04behnd.4916/bootloaders/u-boot-2024.04/arch/arm/mach-rockchip/rk3328/Kconfig
```kconfig
if ROCKCHIP_RK3328

choice
	prompt "RK3328 board select"

config TARGET_EVB_RK3328
	bool "RK3328 evaluation board"
	help
	  RK3328evb is a evaluation board for Rockchip rk3328,
	  with full function and phisical connectors support like
	  usb2.0 host ports, LVDS, JTAG, MAC, SDcard, HDMI, USB-2-serial...

endchoice

config ROCKCHIP_BOOT_MODE_REG
	default 0xff1005c8

config ROCKCHIP_STIMER_BASE
	default 0xff1d0020

config SYS_SOC
	default "rk3328"

config SYS_MALLOC_F_LEN
	default 0x2000

config SPL_LIBCOMMON_SUPPORT
	default y

config SPL_LIBGENERIC_SUPPORT
	default y

config TPL_LDSCRIPT
	default "arch/arm/mach-rockchip/u-boot-tpl-v8.lds"

config TPL_TEXT_BASE
	default 0xff091000

config TPL_STACK
	default 0xff098000

source "board/rockchip/evb_rk3328/Kconfig"

endif
```

## release/src-rt-5.04behnd.4916/bootloaders/u-boot-2024.04/arch/arm/mach-rockchip/rk3368/Kconfig
```kconfig
if ROCKCHIP_RK3368

choice
	prompt "RK3368 board"

config TARGET_LION_RK3368
        bool "Theobroma Systems RK3368-uQ7 (Lion) module"
	select ARCH_EARLY_INIT_R
	help
	  The RK3368-uQ7 is a micro-Qseven form-factor (40mm x 70mm,
	  MXM-230 connector) system-on-module designed by Theobroma
	  Systems for industrial applications.

	  It provides the following features:
	   - 8x Cortex-A53 (in 2 clusters of 4 cores each)
	   - (on-module) up to 4GB of DDR3 memory
	   - (on-module) SPI-NOR flash
	   - (on-module) eMMC
	   - Gigabit Ethernet (with an on-module KSZ9031 PHY)
	   - USB
	   - HDMI
	   - MIPI-DSI/single-channel LVDS (muxed on the 'LVDS-A' pin-group)
	   - various 'slow' interfaces (e.g. UART, SPI, I2C, I2S, ...)
	   - on-module STM32 providing CAN, RTC and fan-control
	   - (optional on-module) EAL4+-certified security module

config TARGET_SHEEP
	bool "Sheep board"
	help
	  Sheep board is designed by Rockchip as a EVB board
	  for rk3368.

config TARGET_GEEKBOX
	bool "GeekBox"

config TARGET_EVB_PX5
        bool "Evb-PX5"
	select ARCH_EARLY_INIT_R
        help
	 PX5 EVB is designed by Rockchip for automotive field
         with integrated CVBS (TP2825) / MIPI DSI / CSI / LVDS
         HDMI video input/output interface, audio codec ES8396,
         WIFI/BT (on RTL8723BS), Gsensor BMA250E and light&proximity
         sensor STK3410.
endchoice

config ROCKCHIP_BOOT_MODE_REG
	default 0xff738200

config ROCKCHIP_STIMER_BASE
	default 0xff830020

config SYS_SOC
	default "rk3368"

config SYS_MALLOC_F_LEN
	default 0x4000

config SPL_LIBCOMMON_SUPPORT
	default y

config SPL_LIBGENERIC_SUPPORT
	default y

source "board/theobroma-systems/lion_rk3368/Kconfig"
source "board/rockchip/sheep_rk3368/Kconfig"
source "board/geekbuying/geekbox/Kconfig"
source "board/rockchip/evb_px5/Kconfig"

config SPL_STACK_R_ADDR
	default 0x04000000

config TPL_STACK
        default 0xff8cffff

config TPL_TEXT_BASE
        default 0xff8c1000

endif
```

## release/src-rt-5.04behnd.4916/bootloaders/u-boot-2024.04/arch/arm/mach-rockchip/rk3399/Kconfig
```kconfig
if ROCKCHIP_RK3399

choice
	prompt "RK3399 board select"

config TARGET_CHROMEBOOK_BOB
	bool "Asus Flip C101PA Chromebook (RK3399)"
	select HAS_ROM
	select ROCKCHIP_SPI_IMAGE
	help
	  Bob is a small RK3299-based device similar in apperance to Minnie.
	  It has two USB 3.0 type-C ports, 4GB of SDRAM, WiFi and a 10.1",
	  1280x800 display. It uses its USB ports for both power and external
	  display. It includes a Chrome OS EC (Cortex-M3) to provide access to
	  the keyboard and battery functions.

config TARGET_CHROMEBOOK_KEVIN
	bool "Samsung Chromebook Plus (RK3399)"
	select HAS_ROM
	select ROCKCHIP_SPI_IMAGE
	help
	  Kevin is a RK3399-based convertible chromebook. It has two USB 3.0
	  Type-C ports, 4GB of SDRAM, WiFi and a 12.3" 2400x1600 display. It
	  uses its USB ports for both power and external display. It includes
	  a Chromium OS EC (Cortex-M3) to provide access to the keyboard and
	  battery functions.

config TARGET_EVB_RK3399
	bool "RK3399 evaluation board"
	help
	  RK3399evb is a evaluation board for Rockchip RK3399,
	  with full function and physical connectors support like Type-C ports,
	  USB.0 host ports, LVDS, JTAG, MAC, SD card, HDMI, USB-to-serial...

config TARGET_PINEBOOK_PRO_RK3399
	bool "Pinebook Pro"
	help
	  Pinebook Pro is a laptop based on the Rockchip rk3399 SoC
	  with 4Gb RAM, onboard eMMC, USB-C, a USB3 and USB2 port,
	  1920*1080 screen and all the usual laptop features.

config TARGET_PINEPHONE_PRO_RK3399
	bool "PinePhone Pro"
	help
	  PinePhone Pro is a phone based on a variant of the Rockchip
	  rk3399 SoC with 4Gb RAM, onboard eMMC, USB-C, headphone jack,
	  720x1440 screen and a Quectel 4G/LTE modem.

config TARGET_PUMA_RK3399
	bool "Theobroma Systems RK3399-Q7 (Puma)"
	help
	  The RK3399-Q7 (Puma) is a system-on-module (designed and
	  marketed by Theobroma Systems) featuring the Rockchip RK3399
	  in a Qseven-compatible form-factor (running of a single 5V
	  supply and exposing its external interfaces on a MXM-230
	  connector).

	  Key features of the RK3399-Q7 include:
	   * on-module USB 3.0 hub (2x USB 3.0 host + 1x USB 2.0 host)
	   * USB 3.0 dual-role
	   * on-module Micrel KSZ9031 GbE PHY
	   * on-module eMMC (up to 256GB configurations available)
	   * on-module DDR3 (1GB, 2GB and 4GB configurations available)
	   * HDMI, eDP, MIPI-DSI, MIPI-DSI/CSI and MIPI-CSI
	   * SPI, I2C, I2S, UART, GPIO, ...

config TARGET_ROCK960_RK3399
	bool "Vamrs Limited Rock960 board family"
	help
	  Support for Rock960 board family by Vamrs Limited. This board
	  family consists of Rock960 (Consumer Edition) and Ficus
	  (Enterprise Edition) 96Boards.

	  Common features implemented on both boards:
	   * Rockchip RK3399 SoC (2xCortex A72, 4xCortex A53, ARM Mali T860MP4)
	   * 16/32GB eMMC, uSD slot
	   * HDMI/DP/MIPI
	   * 20-pin low speed and 40-pin high speed expanders, 6 LED, 3 buttons

	  Additional features of Rock960:
	   * 2GiB/4GiB LPDDR3 RAM
	   * 1x USB 3.0 type A, 1x USB 2.0 type A (host mode only),
	     1x USB 3.0 type C OTG

	  Additional features of Ficus:
	   * 2GiB/4GiB DDR3 RAM
	   * Ethernet
	   * Dual SATA
	   * 2x USB 3.0 type A, 2x USB 2.0 type A (host mode only),
	     1x USB 3.0 type C OTG

config TARGET_ROCKPRO64_RK3399
	bool "Pine64 Rockpro64 board"
	help
	  Rockro64 is SBC produced by Pine64. Key features:

	   * Rockchip RK3399
	   * 2/4GB Dual-Channel LPDDR3
	   * SD card slot
	   * eMMC socket
	   * 128Mb SPI Flash
	   * Gigabit ethernet
	   * PCIe 4X slot
	   * WiFI/BT module socket
	   * HDMI In/Out, DP, MIPI DSI/CSI, eDP
	   * USB 3.0, 2.0
	   * USB Type C power and data
	   * GPIO expansion ports
	   * DC 12V/2A

config TARGET_ROC_PC_RK3399
	bool "Firefly ROC-RK3399-PC board"
	help
	  ROC-RK3399-PC is SBC produced by Firefly. Key features:

	   * Rockchip RK3399
	   * 4GB Dual-Channel LPDDR4 64-bit
	   * SD card slot
	   * eMMC socket
	   * 16MB SPI Flash
	   * Gigabit ethernet
	   * PCIe
	   * HDMI In/Out, DP, MIPI DSI/CSI, eDP
	   * USB 3.0, 2.0
	   * USB Type C power and data
	   * GPIO expansion ports
	   * wide voltage input(5V-15V), dual cell battery
	   * Wifi/BT accessible via expansion board M.2

endchoice

config ROCKCHIP_BOOT_MODE_REG
	default 0xff320300

config ROCKCHIP_STIMER_BASE
	default 0xff8680a0

config SYS_SOC
	default "rk3399"

config SYS_MALLOC_F_LEN
	default 0x4000

config SPL_LIBCOMMON_SUPPORT
	default y

config SPL_LIBGENERIC_SUPPORT
	default y

config TPL_LDSCRIPT
	default "arch/arm/mach-rockchip/u-boot-tpl-v8.lds"

config TPL_STACK
        default 0xff8effff

config TPL_TEXT_BASE
        default 0xff8c2000

config SPL_STACK_R_ADDR
	default 0x04000000

if BOOTCOUNT_LIMIT

config BOOTCOUNT_BOOTLIMIT
	default 3

config SYS_BOOTCOUNT_ADDR
	default 0xff3100f0	# PMU_SYS_REG0

endif # BOOTCOUNT_LIMIT

source "board/firefly/roc-pc-rk3399/Kconfig"
source "board/google/gru/Kconfig"
source "board/pine64/pinebook-pro-rk3399/Kconfig"
source "board/pine64/pinephone-pro-rk3399/Kconfig"
source "board/pine64/rockpro64_rk3399/Kconfig"
source "board/rockchip/evb_rk3399/Kconfig"
source "board/theobroma-systems/puma_rk3399/Kconfig"
source "board/vamrs/rock960_rk3399/Kconfig"

endif
```

## release/src-rt-5.04behnd.4916/bootloaders/u-boot-2024.04/arch/arm/mach-rockchip/rk3568/Kconfig
```kconfig
if ROCKCHIP_RK3568

choice
	prompt "RK3568/RK3566 board select"

config TARGET_EVB_RK3568
	bool "RK3568 evaluation board"
	select BOARD_LATE_INIT
	help
	  RK3568 EVB is a evaluation board for Rockchp RK3568.

config TARGET_ANBERNIC_RGXX3_RK3566
	bool "Anbernic RGXX3"
	help
	  Anbernic RGXX3 gaming device with Rockchip RK3566. This
	  config can be used with the RG353M, RG353P, RG353V, RG353VS,
	  and RG503. The correct device tree name will automatically
	  be selected by the bootloader.

config TARGET_ODROID_M1_RK3568
	bool "ODROID-M1"
	help
	  Hardkernel ODROID-M1 single board computer with a RK3568B2 SoC.

config TARGET_QUARTZ64_RK3566
	bool "Pine64 Quartz64"
	help
	  Pine64 Quartz64 single board computer with a RK3566 SoC.

endchoice

config ROCKCHIP_BOOT_MODE_REG
	default 0xfdc20200

config ROCKCHIP_STIMER_BASE
	default 0xfdd1c020

config SYS_SOC
	default "rk3568"

config SYS_MALLOC_F_LEN
	default 0x20000

source "board/rockchip/evb_rk3568/Kconfig"
source "board/anbernic/rgxx3_rk3566/Kconfig"
source "board/hardkernel/odroid_m1/Kconfig"
source "board/pine64/quartz64_rk3566/Kconfig"

endif
```
