## release/src-rt-5.04behnd.4916/bootloaders/u-boot-2024.04/arch/arm/mach-orion5x/Kconfig
```kconfig
if ARCH_ORION5X

config 88F5182
	bool

config FEROCEON
	bool

config SYS_SOC
	default "orion5x"


endif
```

## release/src-rt-5.04behnd.4916/bootloaders/u-boot-2024.04/arch/arm/mach-owl/Kconfig
```kconfig
if ARCH_OWL

choice
        prompt "Actions Semi Owl SoC Variant"
        optional

config MACH_S900
        bool "Actions Semi S900 SoC"
        select ARM64

config MACH_S700
        bool "Actions Semi S700 SoC"
        select ARM64

endchoice

config TEXT_BASE
        default 0x11000000

config SYS_CONFIG_NAME
        default "owl-common"

config SYS_SOC
        default "s900" if MACH_S900
        default "s700" if MACH_S700

endif
```

## release/src-rt-5.04behnd.4916/bootloaders/u-boot-2024.04/arch/arm/mach-qemu/Kconfig
```kconfig
if ARCH_QEMU

config SYS_VENDOR
	default "emulation"

config SYS_BOARD
	default "qemu-arm"

config SYS_CONFIG_NAME
	default "qemu-arm"

choice
	prompt "QEMU ARM architecture"
	default TARGET_QEMU_ARM_64BIT

config TARGET_QEMU_ARM_32BIT
	bool "ARMv7-A, 32bit"
	select ARCH_SUPPORT_PSCI
	select BOARD_LATE_INIT
	select CPU_V7A
	select SYS_ARCH_TIMER

config TARGET_QEMU_ARM_64BIT
	bool "ARMv8, 64bit"
	select ARM64
	select BOARD_LATE_INIT

endchoice

endif
```

## release/src-rt-5.04behnd.4916/bootloaders/u-boot-2024.04/arch/arm/mach-renesas/Kconfig
```kconfig
if ARCH_RENESAS

# Renesas ARM SoCs R-Car Gen3/Gen4 (64bit)
config RCAR_64
	bool
	select ARM64
	select CMD_CACHE
	select OF_BOARD_SETUP
	select PHY
	select PINCONF
	select PINCTRL
	select POSITION_INDEPENDENT
	imply CMD_FS_UUID
	imply CMD_GPT
	imply CMD_MMC_SWRITE if MMC
	imply CMD_UUID
	imply SUPPORT_EMMC_RPMB if MMC

choice
	prompt "Target Renesas SoC select"
	default RCAR_32

config RCAR_32
	bool "Renesas ARM SoCs R-Car Gen1/Gen2 (32bit)"
	select CPU_V7A

config RCAR_GEN3
	bool "Renesas ARM SoCs R-Car Gen3 (64bit)"
	select RCAR_64
	select SUPPORT_SPL
	select PINCTRL_PFC
	imply SPL
	imply SPL_BOARD_INIT
	imply SPL_GZIP
	imply SPL_LIBCOMMON_SUPPORT
	imply SPL_LIBGENERIC_SUPPORT
	imply SPL_SERIAL
	imply SPL_SYS_MALLOC_SIMPLE
	imply SPL_TINY_MEMSET
	imply SPL_USE_TINY_PRINTF
	imply SPL_YMODEM_SUPPORT

config RCAR_GEN4
	bool "Renesas ARM SoCs R-Car Gen4 (64bit)"
	select RCAR_64
	select PINCTRL_PFC

config RZA1
	prompt "Renesas ARM SoCs RZ/A1 (32bit)"
	select CPU_V7A

config RZN1
	prompt "Renesas ARM SoCs RZ/N1 (32bit)"
	select CPU_V7A
	select ARMV7_SET_CORTEX_SMPEN if !SPL
	select SPL_ARMV7_SET_CORTEX_SMPEN if SPL
	select CLK
	select CLK_RENESAS
	select CLK_R9A06G032
	select DM
	select DM_ETH
	select DM_SERIAL
	select PINCTRL
	select PINCONF
	select REGMAP
	select SYSRESET
	select SYSRESET_SYSCON
	imply CMD_DM

config RZG2L
	prompt "Renesas RZ/G2L Family ARM SoCs"
	select GICV3
	select RCAR_64
	imply CLK_RZG2L
	imply MULTI_DTB_FIT
	imply MULTI_DTB_FIT_USER_DEFINED_AREA
	imply PINCTRL_RZG2L
	imply RENESAS_SDHI
	imply RZG2L_GPIO
	imply SCIF_CONSOLE
	imply SYS_I2C_RZ_RIIC
	imply SYS_MALLOC_F
	help
	  Enable support for the Renesas RZ/G2L family of SoCs. Currently
	  support is only included for the RZ/G2L itself (based on the R9A07G044
	  SoC). Support for additional SoCs in this family (RZ/G2LC, RZ/G2UL,
	  RZ/V2L & RZ/Five) is not yet available.

endchoice

config SYS_SOC
	default "renesas" if ARCH_RENESAS

source "arch/arm/mach-renesas/Kconfig.32"
source "arch/arm/mach-renesas/Kconfig.64"
source "arch/arm/mach-renesas/Kconfig.rza1"
source "arch/arm/mach-renesas/Kconfig.rzn1"
source "arch/arm/mach-renesas/Kconfig.rzg2l"

endif
```

## release/src-rt-5.04behnd.4916/bootloaders/u-boot-2024.04/arch/arm/mach-renesas/Kconfig.32
```kconfig
if RCAR_32

config ARCH_RENESAS_BOARD_STRING
	string "Renesas RCar Gen2 board name"
	default "Board"

config RCAR_GEN2
	bool "Renesas RCar Gen2"
	select PHY
	select PHY_RCAR_GEN2
	select TMU_TIMER

config R8A7790
	bool "Renesas SoC R8A7790"
	select RCAR_GEN2
	select ARM_CORTEX_A15_CVE_2017_5715
	imply CLK_R8A7790
	imply PINCTRL_PFC_R8A7790

config R8A7791
	bool "Renesas SoC R8A7791"
	select RCAR_GEN2
	select ARM_CORTEX_A15_CVE_2017_5715
	imply CLK_R8A7791
	imply PINCTRL_PFC_R8A7791

config R8A7792
	bool "Renesas SoC R8A7792"
	select RCAR_GEN2
	select ARM_CORTEX_A15_CVE_2017_5715
	imply CLK_R8A7792
	imply PINCTRL_PFC_R8A7792

config R8A7793
	bool "Renesas SoC R8A7793"
	select RCAR_GEN2
	select ARM_CORTEX_A15_CVE_2017_5715
	imply CLK_R8A7793
	imply PINCTRL_PFC_R8A7793

config R8A7794
	bool "Renesas SoC R8A7794"
	select RCAR_GEN2
	imply CLK_R8A7794
	imply PINCTRL_PFC_R8A7794

choice
	prompt "Renesas ARM SoCs board select"
	optional

config TARGET_BLANCHE
	bool "Blanche board"
	select DM
	select DM_SERIAL
	imply CMD_DM

config TARGET_GOSE
	bool "Gose board"
	select DM
	select DM_SERIAL
	select SPL_TINY_MEMSET
	select SUPPORT_SPL
	select SPL_USE_TINY_PRINTF
	imply CMD_DM

config TARGET_KOELSCH
	bool "Koelsch board"
	select DM
	select DM_SERIAL
	select SPL_TINY_MEMSET
	select SUPPORT_SPL
	select SPL_USE_TINY_PRINTF
	imply CMD_DM

config TARGET_LAGER
	bool "Lager board"
	select DM
	select DM_SERIAL
	select SPL_TINY_MEMSET
	select SUPPORT_SPL
	select SPL_USE_TINY_PRINTF
	imply CMD_DM

config TARGET_ALT
	bool "Alt board"
	select DM
	select DM_SERIAL
	select SPL_TINY_MEMSET
	select SUPPORT_SPL
	select SPL_USE_TINY_PRINTF
	imply CMD_DM

config TARGET_SILK
	bool "Silk board"
	select DM
	select DM_SERIAL
	select SPL_TINY_MEMSET
	select SUPPORT_SPL
	select SPL_USE_TINY_PRINTF
	imply CMD_DM

config TARGET_PORTER
	bool "Porter board"
	select DM
	select DM_SERIAL
	select SPL_TINY_MEMSET
	select SUPPORT_SPL
	select SPL_USE_TINY_PRINTF
	imply CMD_DM

config TARGET_STOUT
	bool "Stout board"
	select DM
	select DM_SERIAL
	select SPL_TINY_MEMSET
	select SUPPORT_SPL
	select SPL_USE_TINY_PRINTF
	imply CMD_DM

endchoice

config TMU_TIMER
	bool

config RENESAS_EXTRAM_BOOT
	bool "Enable boot from RAM"
	depends on TARGET_ALT || TARGET_BLANCHE || TARGET_KOELSCH || TARGET_LAGER || TARGET_PORTER || TARGET_SILK || TARGET_STOUT

choice
	prompt "Qos setting primary"
	depends on TARGET_ALT || TARGET_BLANCHE || TARGET_GOSE || TARGET_KOELSCH || TARGET_LAGER
	default QOS_PRI_NORMAL

config QOS_PRI_NORMAL
	bool "Non primary"
	help
	   Select normal mode for QoS setting.

config QOS_PRI_MEDIA
	bool "Media primary"
	help
	   Select multimedia primary mode for QoS setting.

config QOS_PRI_GFX
	bool "GFX primary"
	help
	   Select GFX(graphics) primary mode for QoS setting.

endchoice

source "board/renesas/blanche/Kconfig"
source "board/renesas/gose/Kconfig"
source "board/renesas/koelsch/Kconfig"
source "board/renesas/lager/Kconfig"
source "board/renesas/alt/Kconfig"
source "board/renesas/silk/Kconfig"
source "board/renesas/porter/Kconfig"
source "board/renesas/stout/Kconfig"

endif
```

## release/src-rt-5.04behnd.4916/bootloaders/u-boot-2024.04/arch/arm/mach-renesas/Kconfig.64
```kconfig
if RCAR_64

config SYS_MALLOC_F_LEN
	default 0x8000 if RCAR_64

config OF_LIBFDT_OVERLAY
	default y if RCAR_64

source "arch/arm/mach-renesas/Kconfig.rcar3"
source "arch/arm/mach-renesas/Kconfig.rcar4"

endif
```

## release/src-rt-5.04behnd.4916/bootloaders/u-boot-2024.04/arch/arm/mach-renesas/Kconfig.rcar3
```kconfig
if RCAR_GEN3

menu "Select Target SoC"

config R8A774A1
	bool "Renesas SoC R8A774A1"
	select GICV2
	imply CLK_R8A774A1
	imply PINCTRL_PFC_R8A774A1

config R8A774B1
	bool "Renesas SoC R8A774B1"
	select GICV2
	imply CLK_R8A774B1
	imply PINCTRL_PFC_R8A774B1

config R8A774C0
	bool "Renesas SoC R8A774C0"
	select GICV2
	imply CLK_R8A774C0
	imply PINCTRL_PFC_R8A774C0

config R8A774E1
	bool "Renesas SoC R8A774E1"
	select GICV2
	imply CLK_R8A774E1
	imply PINCTRL_PFC_R8A774E1

config R8A7795
	bool "Renesas SoC R8A7795"
	select GICV2
	imply CLK_R8A7795
	imply PINCTRL_PFC_R8A77951

config R8A7796
	bool "Renesas SoC R8A7796"
	select GICV2
	imply CLK_R8A77960
	imply CLK_R8A77961
	imply PINCTRL_PFC_R8A77960
	imply PINCTRL_PFC_R8A77961

config R8A77965
	bool "Renesas SoC R8A77965"
	select GICV2
	imply CLK_R8A77965
	imply PINCTRL_PFC_R8A77965

config R8A77970
	bool "Renesas SoC R8A77970"
	select GICV2
	imply CLK_R8A77970
	imply PINCTRL_PFC_R8A77970

config R8A77980
	bool "Renesas SoC R8A77980"
	select GICV2
	imply CLK_R8A77980
	imply PINCTRL_PFC_R8A77980

config R8A77990
	bool "Renesas SoC R8A77990"
	select GICV2
	imply CLK_R8A77990
	imply PINCTRL_PFC_R8A77990

config R8A77995
	bool "Renesas SoC R8A77995"
	select GICV2
	imply CLK_R8A77995
	imply PINCTRL_PFC_R8A77995

config RZ_G2
	bool "Renesas ARM SoCs RZ/G2 (64bit)"

endmenu

choice
	prompt "Renesas ARM64 SoCs board select"
	optional

config TARGET_BEACON_RZG2M
	bool "Beacon EmbeddedWorks RZ/G2 Dev Kit"
	select PINCTRL_PFC_R8A774A1
	select PINCTRL_PFC_R8A774B1
	select PINCTRL_PFC_R8A774E1
	select R8A774A1
	select R8A774B1
	select R8A774E1
	select RZ_G2
	imply CLK_CCF
	imply CLK_VERSACLOCK
	imply MULTI_DTB_FIT
	imply MULTI_DTB_FIT_USER_DEFINED_AREA

config TARGET_CONDOR
	bool "Condor board"
	imply R8A77980
	help
          Support for Renesas R-Car Gen3 Condor platform

config TARGET_V3HSK
	bool "V3HSK board"
	help
          Support for Renesas R-Car Gen3 V3HSK platform

config TARGET_DRAAK
	bool "Draak board"
	imply R8A77995
	help
          Support for Renesas R-Car Gen3 Draak platform

config TARGET_EAGLE
	bool "Eagle board"
	imply R8A77970
	help
          Support for Renesas R-Car Gen3 Eagle platform

config TARGET_V3MSK
	bool "V3MSK board"
	help
          Support for Renesas R-Car Gen3 V3MSK platform

config TARGET_EBISU
	bool "Ebisu board"
	imply R8A77990
	help
          Support for Renesas R-Car Gen3 Ebisu platform

config TARGET_HIHOPE_RZG2
	bool "HiHope RZ/G2 board"
	imply MULTI_DTB_FIT
	imply MULTI_DTB_FIT_USER_DEFINED_AREA
	imply R8A774A1
	imply R8A774B1
	imply R8A774E1
	imply RZ_G2
	imply SYS_MALLOC_F
	help
          Support for RZG2 HiHope platform

config TARGET_SILINUX_EK874
	bool "Silicon Linux EK874 board"
	imply R8A774C0
	imply RZ_G2
	help
          Support for Silicon Linux EK874 platform

config TARGET_SALVATOR_X
	bool "Salvator-X board"
	imply MULTI_DTB_FIT
	imply MULTI_DTB_FIT_USER_DEFINED_AREA
	imply R8A7795
	imply R8A7796
	imply R8A77965
	imply SYS_MALLOC_F
	help
          Support for Renesas R-Car Gen3 platform

config TARGET_ULCB
	bool "ULCB board"
	imply MULTI_DTB_FIT
	imply MULTI_DTB_FIT_USER_DEFINED_AREA
	imply R8A7795
	imply R8A7796
	imply R8A77965
	imply SYS_MALLOC_F
	help
          Support for Renesas R-Car Gen3 ULCB platform

endchoice

source "board/renesas/condor/Kconfig"
source "board/renesas/draak/Kconfig"
source "board/renesas/eagle/Kconfig"
source "board/renesas/ebisu/Kconfig"
source "board/renesas/salvator-x/Kconfig"
source "board/renesas/ulcb/Kconfig"
source "board/renesas/v3hsk/Kconfig"
source "board/renesas/v3msk/Kconfig"
source "board/beacon/beacon-rzg2m/Kconfig"
source "board/hoperun/hihope-rzg2/Kconfig"
source "board/silinux/ek874/Kconfig"

config MULTI_DTB_FIT_UNCOMPRESS_SZ
	default 0x80000 if TARGET_BEACON_RZG2M
	default 0x80000 if TARGET_HIHOPE_RZG2
	default 0x80000 if TARGET_SALVATOR_X
	default 0x80000 if TARGET_ULCB

config MULTI_DTB_FIT_USER_DEF_ADDR
	default 0x49000000 if TARGET_BEACON_RZG2M
	default 0x49000000 if TARGET_HIHOPE_RZG2
	default 0x49000000 if TARGET_SALVATOR_X
	default 0x49000000 if TARGET_ULCB

config DM_RESET
	default y if RCAR_GEN3

endif
```

## release/src-rt-5.04behnd.4916/bootloaders/u-boot-2024.04/arch/arm/mach-renesas/Kconfig.rcar4
```kconfig
if RCAR_GEN4

menu "Select Target SoC"

config R8A779A0
	bool "Renesas SoC R8A779A0"
	select GICV3
	imply CLK_R8A779A0
	imply PINCTRL_PFC_R8A779A0

config R8A779F0
	bool "Renesas SoC R8A779F0"
	select GICV3
	imply CLK_R8A779F0
	imply PINCTRL_PFC_R8A779F0

config R8A779G0
	bool "Renesas SoC R8A779G0"
	select GICV3
	imply CLK_R8A779G0
	imply PINCTRL_PFC_R8A779G0

config R8A779H0
	bool "Renesas SoC R8A779H0"
	select GICV3
	imply CLK_R8A779H0
	imply PINCTRL_PFC_R8A779H0

endmenu

choice
	prompt "Renesas ARM64 SoCs board select"
	optional

config TARGET_FALCON
	bool "Falcon board"
	imply R8A779A0
	help
          Support for Renesas R-Car Gen3 Falcon platform

config TARGET_SPIDER
	bool "Spider board"
	imply R8A779F0
	help
	  Support for Renesas R-Car Gen4 Spider platform

config TARGET_WHITEHAWK
	bool "White Hawk board"
	imply R8A779G0
	help
	  Support for Renesas R-Car Gen4 White Hawk platform

config TARGET_GRAYHAWK
	bool "Gray Hawk board"
	imply R8A779H0
	help
	  Support for Renesas R-Car Gen4 Gray Hawk platform

endchoice

source "board/renesas/falcon/Kconfig"
source "board/renesas/spider/Kconfig"
source "board/renesas/whitehawk/Kconfig"
source "board/renesas/grayhawk/Kconfig"

endif
```

## release/src-rt-5.04behnd.4916/bootloaders/u-boot-2024.04/arch/arm/mach-renesas/Kconfig.rzg2l
```kconfig
# Copyright (C) 2023 Renesas Electronics Corporation
# SPDX-License-Identifier: GPL-2.0+

if RZG2L

config R9A07G044L
	bool "Renesas R9A07G044L SoC"
	imply CLK_R9A07G044
	help
	  Enable support for the Renesas R9A07G044L (RZ/G2L) SoC.

choice
	prompt "Renesas RZ/G2L Family Board selection"
	default TARGET_RZG2L_SMARC_EVK

config TARGET_RZG2L_SMARC_EVK
	bool "Renesas RZ/G2L SMARC EVK"
	imply R9A07G044L
	help
	  Enable support for the RZ/G2L SMARC evaluation board.

source "board/renesas/rzg2l/Kconfig"

endchoice

config MULTI_DTB_FIT_UNCOMPRESS_SZ
	default 0x80000 if TARGET_RZG2L_SMARC_EVK

config MULTI_DTB_FIT_USER_DEF_ADDR
	default 0x49000000 if TARGET_RZG2L_SMARC_EVK

endif
```

## release/src-rt-5.04behnd.4916/bootloaders/u-boot-2024.04/arch/arm/mach-renesas/Kconfig.rzn1
```kconfig
if RZN1

choice
	prompt "Renesas RZ/N1 Board select"
	default TARGET_SCHNEIDER_RZN1

config TARGET_SCHNEIDER_RZN1
	bool "Schneider RZN1 board"
	help
	  Support the Schneider RZN1D and RZN1S boards, which are based
	  on the Renesas RZ/N1 SoC.

endchoice

config SYS_SOC
	default "rzn1"

source "board/schneider/rzn1-snarc/Kconfig"

endif
```
