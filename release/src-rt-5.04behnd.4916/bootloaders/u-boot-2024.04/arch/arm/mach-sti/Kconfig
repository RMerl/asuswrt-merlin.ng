## release/src-rt-5.04behnd.4916/bootloaders/u-boot-2024.04/arch/arm/mach-zynq/Kconfig
```kconfig
if ARCH_ZYNQ

config SPL_FS_FAT
	default y

config SPL_LIBCOMMON_SUPPORT
	default y

config SPL_LIBDISK_SUPPORT
	default y

config SPL_LIBGENERIC_SUPPORT
	default y

config SPL_MMC
	default y if MMC_SDHCI_ZYNQ

config SPL_SERIAL
	default y

config SPL_SPI_FLASH_SUPPORT
	default y if ZYNQ_QSPI

config SPL_SPI
	default y if ZYNQ_QSPI

config ZYNQ_DDRC_INIT
	bool "Zynq DDRC initialization"
	default y
	help
	  This option used to perform DDR specific initialization
	  if required. There might be cases like ddr less where we
	  want to skip ddr init and this option is useful for it.

config SYS_BOARD
	string "Board name"
	default "zynq"

config SYS_VENDOR
	string "Vendor name"
	default "xilinx"

config SYS_SOC
	default "zynq"

config SYS_CONFIG_NAME
	string "Board configuration name"
	default "zynq-common"
	help
	  This option contains information about board configuration name.
	  Based on this option include/configs/<CONFIG_SYS_CONFIG_NAME>.h header
	  will be used for board configuration.

config SYS_MALLOC_F_LEN
	default 0x800

config SYS_MALLOC_LEN
	default 0x1400000

config BOOT_INIT_FILE
	string "boot.bin init register filename"
	default ""
	help
	  Add register writes to boot.bin format (max 256 pairs).
	  Expect a table of register-value pairs, e.g. "0x12345678 0x4321"

config ZYNQ_SDHCI_MAX_FREQ
	default 52000000

source "board/xilinx/Kconfig"
source "board/xilinx/zynq/Kconfig"

endif
```

## release/src-rt-5.04behnd.4916/bootloaders/u-boot-2024.04/arch/arm/mach-zynqmp-r5/Kconfig
```kconfig
# SPDX-License-Identifier: GPL-2.0

if ARCH_ZYNQMP_R5

config SYS_BOARD
	string "Board name"
	default "zynqmp_r5"

config SYS_VENDOR
	string "Vendor name"
	default "xilinx"

config SYS_SOC
	default "zynqmp-r5"

config SYS_CONFIG_NAME
	string "Board configuration name"
	default "xilinx_zynqmp_r5"
	help
	  This option contains information about board configuration name.
	  Based on this option include/configs/<CONFIG_SYS_CONFIG_NAME>.h header
	  will be used for board configuration.

config CPU_FREQ_HZ
	int "CPU frequency"
	default 800000000
	help
	  The value, in Hz, that the CPU clock is running at.

config SYS_MALLOC_F_LEN
	default 0x600

endif
```

## release/src-rt-5.04behnd.4916/bootloaders/u-boot-2024.04/arch/arm/mach-zynqmp/Kconfig
```kconfig
if ARCH_ZYNQMP

config SPL_FS_FAT
	default y

config SPL_LIBCOMMON_SUPPORT
	default y

config SPL_LIBDISK_SUPPORT
	default y

config SPL_LIBGENERIC_SUPPORT
	default y

config SPL_MMC
	default y if MMC_SDHCI_ZYNQ

config SPL_SERIAL
	default y

config SPL_SPI_FLASH_SUPPORT
	default y if ZYNQ_QSPI

config SPL_SPI
	default y if ZYNQ_QSPI

config SYS_BOARD
	string "Board name"
	default "zynqmp"

config SYS_VENDOR
	string "Vendor name"
	default "xilinx"

config SYS_SOC
	default "zynqmp"

config SYS_CONFIG_NAME
	string "Board configuration name"
	default "xilinx_zynqmp"
	help
	  This option contains information about board configuration name.
	  Based on this option include/configs/<CONFIG_SYS_CONFIG_NAME>.h header
	  will be used for board configuration.

config SYS_MEM_RSVD_FOR_MMU
	bool "Reserve memory for MMU Table"
	help
	  If defined this option is used to setup different space for
	  MMU table than the one which will be allocated during
	  relocation.

config BOOT_INIT_FILE
	string "boot.bin init register filename"
	depends on SPL
	default ""
	help
	  Add register writes to boot.bin format (max 256 pairs).
	  Expect a table of register-value pairs, e.g. "0x12345678 0x4321"

config PMUFW_INIT_FILE
	string "PMU firmware"
	depends on SPL
	default ""
	help
	  Include external PMUFW (Platform Management Unit FirmWare) to
	  a Xilinx bootable image (boot.bin).

config ZYNQMP_SPL_PM_CFG_OBJ_FILE
	string "PMU firmware configuration object to load at runtime by SPL"
	depends on SPL
	help
	  Path to a binary PMU firmware configuration object to be linked
	  into U-Boot SPL and loaded at runtime into the PMU firmware.

	  The ZynqMP Power Management Unit (PMU) needs a configuration
	  object for most SoC peripherals to work. To have it loaded by
	  U-Boot SPL set here the file name (absolute path or relative to
	  the top source tree) of your configuration, which must be a
	  binary blob. It will be linked in the SPL binary and loaded
	  into the PMU firmware by U-Boot SPL during board
	  initialization.

	  Leave this option empty if your PMU firmware has a hard-coded
	  configuration object or you are loading it by any other means.

config ZYNQMP_NO_DDR
	bool "Disable DDR MMU mapping"
	help
	  This option configures MMU with no DDR to avoid speculative
	  access to DDR memory where DDR is not present.

config SPL_ZYNQMP_DRAM_ECC_INIT
	bool "Initialize DRAM ECC"
	depends on SPL
	help
	  This option initializes all memory to 0xdeadbeef. Must be set if your
	  memory is of ECC type.

config SPL_ZYNQMP_DRAM_BANK1_BASE
	depends on SPL_ZYNQMP_DRAM_ECC_INIT
	hex "DRAM Bank1 address"
	default 0x00000000
	help
	  Start address of DRAM ECC bank1

config SPL_ZYNQMP_DRAM_BANK1_LEN
	depends on SPL_ZYNQMP_DRAM_ECC_INIT
	hex "DRAM Bank1 size"
	default 0x80000000
	help
	  Size in bytes of the DRAM ECC bank1

config SPL_ZYNQMP_DRAM_BANK2_BASE
	depends on SPL_ZYNQMP_DRAM_ECC_INIT
	hex "DRAM Bank2 address"
	default 0x800000000
	help
	  Start address of DRAM ECC bank2

config SPL_ZYNQMP_DRAM_BANK2_LEN
	depends on SPL_ZYNQMP_DRAM_ECC_INIT
	hex "DRAM Bank2 size"
	default 0x0
	help
	  Size in bytes of the DRAM ECC bank2. A null size takes no action.

config SYS_MALLOC_F_LEN
	default 0x600

config DEFINE_TCM_OCM_MMAP
	bool "Define TCM and OCM memory in MMU Table"
	default y if MP
	help
	  This option if enabled defines the TCM and OCM memory and its
	  memory attributes in MMU table entry.

config ZYNQMP_PSU_INIT_ENABLED
	bool "Include psu_init"
	select BOARD_EARLY_INIT_F
	help
	  Include psu_init to full u-boot.

config SPL_ZYNQMP_PSU_INIT_ENABLED
	bool "Include psu_init in SPL"
	default y if SPL
	select BOARD_EARLY_INIT_F
	help
	  Include psu_init by default in SPL.

config SPL_ZYNQMP_ALT_BOOTMODE_ENABLED
	bool "Overwrite SPL bootmode"
	depends on SPL
	help
	  Overwrite bootmode selected via boot mode pins to tell SPL what should
	  be the next boot device.

config SPL_ZYNQMP_RESTORE_JTAG
	bool "Restore JTAG"
	depends on SPL
	help
	  Booting SPL in secure mode causes the CSU to disable the JTAG interface
	  even if no eFuses were burnt. This option restores the interface if
	  possible.

config ZYNQ_SDHCI_MAX_FREQ
	default 200000000

config SPL_ZYNQMP_ALT_BOOTMODE
	hex
	default 0x0 if JTAG_MODE
	default 0x1 if QSPI_MODE_24BIT
	default 0x2 if QSPI_MODE_32BIT
	default 0x3 if SD_MODE
	default 0x4 if NAND_MODE
	default 0x5 if SD_MODE1
	default 0x6 if EMMC_MODE
	default 0x7 if USB_MODE
	default 0xa if SW_USBHOST_MODE
	default 0xb if SW_SATA_MODE
	default 0xe if SD1_LSHFT_MODE

choice
	prompt "Boot mode"
	depends on SPL_ZYNQMP_ALT_BOOTMODE_ENABLED
	default JTAG_MODE

config JTAG_MODE
	bool "JTAG_MODE"

config QSPI_MODE_24BIT
	bool "QSPI_MODE_24BIT"

config QSPI_MODE_32BIT
	bool "QSPI_MODE_32BIT"

config SD_MODE
	bool "SD_MODE"

config SD_MODE1
	bool "SD_MODE1"

config NAND_MODE
	bool "NAND_MODE"

config EMMC_MODE
	bool "EMMC_MODE"

config USB_MODE
	bool "USB"

config SW_USBHOST_MODE
	bool "SW USBHOST_MODE"

config SW_SATA_MODE
	bool "SW SATA_MODE"

config SD1_LSHFT_MODE
	bool "SD1_LSHFT_MODE"

endchoice

source "board/xilinx/Kconfig"
source "board/xilinx/zynqmp/Kconfig"

endif
```

## release/src-rt-5.04behnd.4916/bootloaders/u-boot-2024.04/arch/m68k/Kconfig
```kconfig
menu "M68000 architecture"
	depends on M68K

config SYS_ARCH
	default "m68k"

config STATIC_RELA
	default y

# processor family
config MCF520x
	select OF_CONTROL
	select DM
        select DM_SERIAL
	bool

config MCF52x2
	select OF_CONTROL
	select DM
        select DM_SERIAL
	bool

config MCF523x
	select OF_CONTROL
	select DM
        select DM_SERIAL
	bool

config MCF530x
	select OF_CONTROL
	select DM
        select DM_SERIAL
	bool

config MCF5301x
	select OF_CONTROL
	select DM
        select DM_SERIAL
	bool

config MCF532x
	select OF_CONTROL
	select DM
        select DM_SERIAL
	bool

config MCF537x
	select OF_CONTROL
	select DM
        select DM_SERIAL
	bool

config MCF5441x
	select OF_CONTROL
	select DM
        select DM_SERIAL
	bool

# processor type
config M5208
	bool
	select MCF520x

config M5235
	bool
	select MCF523x

config M5249
	bool
	select MCF52x2

config M5253
	bool
	select MCF52x2

config M5271
	bool
	select MCF52x2

config M5272
	bool
	select MCF52x2

config M5275
	bool
	select MCF52x2

config M5282
	bool
	select MCF52x2

config M5307
	bool
	select MCF530x

config M53015
	bool
	select MCF5301x

config M5329
	bool
	select MCF532x

config M5373
	bool
	select MCF532x
	select MCF537x

config M54418
	bool
	select MCF5441x

# peripherals
config CF_DSPI
	bool

choice
	prompt "Target select"
	optional

config TARGET_M5235EVB
	bool "Support M5235EVB"
	select M5235

config TARGET_COBRA5272
	bool "Support cobra5272"
	select M5272

config TARGET_EB_CPU5282
	bool "Support eb_cpu5282"
	select M5282
	select HW_WATCHDOG

config TARGET_M5208EVBE
	bool "Support M5208EVBE"
	select M5208

config TARGET_M5249EVB
	bool "Support M5249EVB"
	select M5249

config TARGET_M5253DEMO
	bool "Support M5253DEMO"
	select M5253

config TARGET_M5272C3
	bool "Support M5272C3"
	select M5272

config TARGET_M5275EVB
	bool "Support M5275EVB"
	select M5275

config TARGET_M5282EVB
	bool "Support M5282EVB"
	select M5282

config TARGET_ASTRO_MCF5373L
	bool "Support astro_mcf5373l"
	select M5373

config TARGET_M53017EVB
	bool "Support M53017EVB"
	select M53015

config TARGET_M5329EVB
	bool "Support M5329EVB"
	select M5329

config TARGET_M5373EVB
	bool "Support M5373EVB"
	select M5373

config TARGET_AMCORE
	bool "Support AMCORE"
	select M5307

config TARGET_STMARK2
        bool "Support stmark2"
        select CF_DSPI
        select M54418

endchoice

source "board/BuS/eb_cpu5282/Kconfig"
source "board/astro/mcf5373l/Kconfig"
source "board/cobra5272/Kconfig"
source "board/freescale/m5208evbe/Kconfig"
source "board/freescale/m5235evb/Kconfig"
source "board/freescale/m5249evb/Kconfig"
source "board/freescale/m5253demo/Kconfig"
source "board/freescale/m5272c3/Kconfig"
source "board/freescale/m5275evb/Kconfig"
source "board/freescale/m5282evb/Kconfig"
source "board/freescale/m53017evb/Kconfig"
source "board/freescale/m5329evb/Kconfig"
source "board/freescale/m5373evb/Kconfig"
source "board/sysam/amcore/Kconfig"
source "board/sysam/stmark2/Kconfig"

config M68K_QEMU
	bool "Build with workarounds for incomplete QEMU emulation"
	help
	  QEMU 8.x currently does not implement RAMBAR accesses and
	  DMA timers. Enable this option for U-Boot CI purposes only
	  to skip the RAMBAR accesses.

config MCFTMR
	bool "Use DMA timer"
	default y if !M68K_QEMU
	default n if M68K_QEMU

endmenu
```

## release/src-rt-5.04behnd.4916/bootloaders/u-boot-2024.04/arch/microblaze/Kconfig
```kconfig
menu "MicroBlaze architecture"
	depends on MICROBLAZE

config SYS_ARCH
	default "microblaze"

config STATIC_RELA
	def_bool y

choice
	prompt "Target select"
	optional

config TARGET_MICROBLAZE_GENERIC
	bool "Support microblaze-generic"
	select BOARD_LATE_INIT
	select DM
	select DM_SERIAL
	select OF_CONTROL
	select SUPPORT_SPL
	select SPL_LIBCOMMON_SUPPORT if SPL
	select SPL_LIBGENERIC_SUPPORT if SPL
	select SYSRESET
	select DM_SPI
	select DM_SPI_FLASH
	select MTD
	select SPI
	imply CMD_DM

endchoice

source "board/xilinx/Kconfig"
source "board/xilinx/microblaze-generic/Kconfig"

endmenu
```
