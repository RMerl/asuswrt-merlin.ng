## release/src-rt-5.04behnd.4916/bootloaders/u-boot-2024.04/arch/arm/mach-tegra/Kconfig
```kconfig
if ARCH_TEGRA

config SPL_GPIO
	default y

config SPL_LIBCOMMON_SUPPORT
	default y

config SPL_LIBGENERIC_SUPPORT
	default y

config SPL_SERIAL
	default y

config TEGRA_CLKRST
	bool

config TEGRA_CRYPTO
	bool "Tegra AES128 crypto module"
	select AES

config TEGRA_GP_PADCTRL
	bool

config TEGRA_IVC
	bool "Tegra IVC protocol"
	help
	  IVC (Inter-VM Communication) protocol is a Tegra-specific IPC
	  (Inter Processor Communication) framework. Within the context of
	  U-Boot, it is typically used for communication between the main CPU
	  and various auxiliary processors.

config TEGRA_MC
	bool

config TEGRA_PMC
	bool

config TEGRA_PMC_SECURE
	bool
	depends on TEGRA_PMC

config TEGRA_COMMON
	bool "Tegra common options"
	select BOARD_EARLY_INIT_F
	select CLK
	select DM
	select DM_GPIO
	select DM_I2C
	select DM_KEYBOARD
	select DM_MMC
	select DM_PWM
	select DM_RESET
	select DM_SERIAL
	select DM_SPI
	select DM_SPI_FLASH
	select MISC
	select MTD
	select OF_CONTROL
	select SPI
	select SYSRESET
	select SYSRESET_TEGRA
	imply CMD_DM
	imply CRC32_VERIFY

config TEGRA_NO_BPMP
	bool "Tegra common options for SoCs without BPMP"
	select TEGRA_CAR
	select TEGRA_CAR_CLOCK
	select TEGRA_CAR_RESET

config TEGRA_ARMV7_COMMON
	bool "Tegra 32-bit common options"
	select BINMAN
	select CPU_V7A
	select PINCTRL
	select PINCTRL_TEGRA
	select SPL
	select SPL_BOARD_INIT if SPL
	select SPL_DM if SPL
	select SPL_PINCTRL if SPL
	select SPL_PINCTRL_TEGRA if SPL
	select SPL_SKIP_LOWLEVEL_INIT_ONLY if SPL
	select SPL_SYSRESET if SPL
	select SUPPORT_SPL
	select TIMER
	select TEGRA_CLKRST
	select TEGRA_COMMON
	select TEGRA_GPIO
	select TEGRA_GP_PADCTRL
	select TEGRA_MC
	select TEGRA_NO_BPMP
	select TEGRA_PMC
	select TEGRA_TIMER

config TEGRA_ARMV8_COMMON
	bool "Tegra 64-bit common options"
	select ARM64
	select INIT_SP_RELATIVE
	select LINUX_KERNEL_IMAGE_HEADER
	select POSITION_INDEPENDENT
	select TEGRA_COMMON

if TEGRA_ARMV8_COMMON
config LNX_KRNL_IMG_TEXT_OFFSET_BASE
	default 0x80000000
endif

choice
	prompt "Tegra SoC select"
	optional

config TEGRA20
	bool "Tegra20 family"
	select ARM_ERRATA_716044
	select ARM_ERRATA_742230
	select ARM_ERRATA_751472
	select TEGRA_ARMV7_COMMON

config TEGRA30
	bool "Tegra30 family"
	select ARM_ERRATA_743622
	select ARM_ERRATA_751472
	select TEGRA_ARMV7_COMMON

config TEGRA114
	bool "Tegra114 family"
	select TEGRA_ARMV7_COMMON

config TEGRA124
	bool "Tegra124 family"
	select TEGRA_ARMV7_COMMON
	imply REGMAP
	imply SYSCON

config TEGRA210
	bool "Tegra210 family"
	select GICV2
	select PINCTRL
	select PINCTRL_TEGRA
	select TIMER
	select TEGRA_ARMV8_COMMON
	select TEGRA_CLKRST
	select TEGRA_GPIO
	select TEGRA_GP_PADCTRL
	select TEGRA_MC
	select TEGRA_NO_BPMP
	select TEGRA_PMC
	select TEGRA_PMC_SECURE
	select TEGRA_TIMER

config TEGRA186
	bool "Tegra186 family"
	select DM_MAILBOX
	select GICV2
	select TEGRA186_BPMP
	select TEGRA186_CLOCK
	select TEGRA186_GPIO
	select TEGRA186_RESET
	select TEGRA_ARMV8_COMMON
	select TEGRA_HSP
	select TEGRA_IVC

endchoice

config TEGRA_DISCONNECT_UDC_ON_BOOT
	bool "Disconnect USB device mode controller on boot"
	depends on CI_UDC
	default y
	help
	  When loading U-Boot into RAM over USB protocols using tools such as
	  tegrarcm or L4T's exec-uboot.sh/tegraflash.py, Tegra's USB device
	  mode controller is initialized and enumerated by the host PC running
	  the tool. Unfortunately, these tools do not shut down the USB
	  controller before executing the downloaded code, and so the host PC
	  does not "de-enumerate" the USB device. This option shuts down the
	  USB controller when U-Boot boots to avoid leaving a stale USB device
	  present.

config TEGRA_SUPPORT_NON_SECURE
	bool "Support executing U-Boot in non-secure (NS) mode"
	depends on TEGRA114 || TEGRA124
	help
	  Certain impossible actions will be skipped if the CPU is in NS mode,
	  such as ARM architectural timer initialization.

config CI_UDC_HAS_HOSTPC
	def_bool y
	depends on CI_UDC && !TEGRA20

config SYS_MALLOC_F_LEN
	default 0x1800

source "arch/arm/mach-tegra/tegra20/Kconfig"
source "arch/arm/mach-tegra/tegra30/Kconfig"
source "arch/arm/mach-tegra/tegra114/Kconfig"
source "arch/arm/mach-tegra/tegra124/Kconfig"
source "arch/arm/mach-tegra/tegra210/Kconfig"
source "arch/arm/mach-tegra/tegra186/Kconfig"

config TEGRA_SPI
	def_bool y
	depends on TEGRA20_SFLASH || TEGRA20_SLINK || TEGRA114_SPI

choice
	prompt "UART to use for console"
	depends on PINCTRL_TEGRA
	default TEGRA_ENABLE_UARTA

config TEGRA_ENABLE_UARTA
	bool "Use UARTA"

config TEGRA_ENABLE_UARTB
	bool "Use UARTB"

config TEGRA_ENABLE_UARTC
	bool "Use UARTC"

config TEGRA_ENABLE_UARTD
	bool "Use UARTD"

endchoice

config TEGRA_GPU
	bool "Enable setting up the GPU"
	depends on TEGRA124 || TEGRA210

config CMD_ENTERRCM
	bool "Enable 'enterrcm' command"
	default y
	help
	  Tegra's boot ROM supports a mode whereby code may be downloaded and
	  flash-programmed over a USB connection. On dev boards, this is
	  typically entered by holding down a "force recovery" button and
	  resetting the CPU. However, not all boards have such a button (one
	  example is the Compulab Trimslice), so a method to enter RCM from
	  software is useful.

	  Even on boards other than Trimslice, controlling this over a UART
	  may be useful, e.g. to allow simple remote control without the need
	  for mechanical button actuators, or hooking up relays/... to the
	  button.

config CMD_EBTUPDATE
	bool "Enable 'ebtupdate' command"
	depends on TEGRA20 || TEGRA30
	select TEGRA_CRYPTO
	help
	  Updating u-boot from within u-boot in rather complex or even
	  impossible on production devices. To make it easier procedure of
	  re-cryption was created. If your device was re-crypted choose Y.

endif
```

## release/src-rt-5.04behnd.4916/bootloaders/u-boot-2024.04/arch/arm/mach-tegra/tegra124/Kconfig
```kconfig
if TEGRA124

choice
	prompt "Tegra124 board select"
	optional

config TARGET_APALIS_TK1
	bool "Toradex Apalis TK1 module"
	select ARCH_SUPPORT_PSCI
	select CPU_V7_HAS_NONSEC
	select CPU_V7_HAS_VIRT

config TARGET_JETSON_TK1
	bool "NVIDIA Tegra124 Jetson TK1 board"
	select ARCH_SUPPORT_PSCI
	select BOARD_LATE_INIT
	select CPU_V7_HAS_NONSEC
	select CPU_V7_HAS_VIRT

config TARGET_CEI_TK1_SOM
	bool "Colorado Engineering Inc Tegra124 TK1-som board"
	select ARCH_SUPPORT_PSCI
	select BOARD_LATE_INIT
	select CPU_V7_HAS_NONSEC if !SPL_BUILD
	select CPU_V7_HAS_VIRT if !SPL_BUILD
	help
	  The Colorado Engineering Tegra TK1-SOM is a very compact
	  (51mmx58mm) board that is functionally almost the same as
	  the Jetson TK1.  The main differences are in which balls on
	  the SoC are assigned to which functions, and the PCIEe
	  configuration.

config TARGET_NYAN_BIG
	bool "Google/NVIDIA Nyan-big Chromebook"
	select BOARD_LATE_INIT
	help
	  Nyan Big is a Tegra124 clamshell board that is very similar
	  to venice2, but it has a different panel, the sdcard CD and WP
	  sense are flipped, and it has a different revision of the AS3722
	  PMIC. The retail name is the Acer Chromebook 13 CB5-311-T7NN
	  (13.3-inch HD, NVIDIA Tegra K1, 2GB).

config TARGET_VENICE2
	bool "NVIDIA Tegra124 Venice2"
	select BOARD_LATE_INIT

endchoice

config SYS_SOC
	default "tegra124"

source "board/cei/cei-tk1-som/Kconfig"
source "board/nvidia/jetson-tk1/Kconfig"
source "board/nvidia/nyan-big/Kconfig"
source "board/nvidia/venice2/Kconfig"
source "board/toradex/apalis-tk1/Kconfig"

endif
```

## release/src-rt-5.04behnd.4916/bootloaders/u-boot-2024.04/arch/arm/mach-tegra/tegra20/Kconfig
```kconfig
if TEGRA20

config TEGRA_LP0
	bool
	select TEGRA_CLOCK_SCALING
	select TEGRA_CRYPTO

config TEGRA_PMU
	bool

config TEGRA_CLOCK_SCALING
	bool

config TEGRA_UARTA_GPU
	bool

config TEGRA_UARTA_SDIO1
	bool

choice
	prompt "Tegra20 board select"
	optional

config TARGET_HARMONY
	bool "NVIDIA Tegra20 Harmony evaluation board"
	select BOARD_LATE_INIT

config TARGET_MEDCOM_WIDE
	bool "Avionic Design Medcom-Wide board"
	select BOARD_LATE_INIT

config TARGET_PAZ00
	bool "Paz00 board"
	select BOARD_LATE_INIT

config TARGET_PLUTUX
	bool "Avionic Design Plutux board"
	select BOARD_LATE_INIT

config TARGET_SEABOARD
	bool "NVIDIA Seaboard"
	select BOARD_LATE_INIT
	select TEGRA_LP0
	select TEGRA_PMU

config TARGET_TEC
	bool "Avionic Design Tamonten Evaluation Carrier"
	select BOARD_LATE_INIT

config TARGET_TRIMSLICE
	bool "Compulab TrimSlice board"
	select BOARD_LATE_INIT
	select TEGRA_UARTA_GPU

config TARGET_VENTANA
	bool "NVIDIA Tegra20 Ventana evaluation board"
	select BOARD_LATE_INIT

config TARGET_COLIBRI_T20
	bool "Toradex Colibri T20 board"
	select BOARD_LATE_INIT
	select TEGRA_UARTA_SDIO1

endchoice

config SYS_SOC
	default "tegra20"

source "board/nvidia/harmony/Kconfig"
source "board/avionic-design/medcom-wide/Kconfig"
source "board/compal/paz00/Kconfig"
source "board/avionic-design/plutux/Kconfig"
source "board/nvidia/seaboard/Kconfig"
source "board/avionic-design/tec/Kconfig"
source "board/compulab/trimslice/Kconfig"
source "board/nvidia/ventana/Kconfig"
source "board/toradex/colibri_t20/Kconfig"

endif
```

## release/src-rt-5.04behnd.4916/bootloaders/u-boot-2024.04/arch/arm/mach-tegra/tegra210/Kconfig
```kconfig
if TEGRA210

choice
	prompt "Tegra210 board select"

config TARGET_P2371_0000
	bool "NVIDIA Tegra210 P2371-0000 board"
	select BOARD_LATE_INIT
	help
	  P2371-0000 is a P2581 or P2530 CPU board married to a P2595 I/O
	  board. The combination contains SoC, DRAM, eMMC, SD card slot,
	  HDMI, USB micro-B port, Ethernet via USB3, USB3 host port, SATA,
	  a GPIO expansion header, and an analog audio jack.

config TARGET_P2371_2180
	bool "NVIDIA Tegra210 P2371-2180 (Jetson TX1) board"
	select BOARD_LATE_INIT
	help
	  P2371-2180 (Jetson TX1 developer kit) is a P2180 CPU board married
	  to a P2597 I/O board. The combination contains SoC, DRAM, eMMC, SD
	  card slot, HDMI, USB micro-B port, Ethernet via USB3, USB3 host
	  port, SATA, PCIe, and two GPIO expansion headers.

config TARGET_P2571
	bool "NVIDIA Tegra210 P2571 base board"
	select BOARD_LATE_INIT
	help
	  P2571 is a P2530 married to a P1963 I/O board

config TARGET_P3450_0000
	bool "NVIDIA Jetson Nano Developer Kit"
	select BOARD_LATE_INIT
	help
	  P3450-0000 is a P3448 CPU board married to a P3449 I/O board.

endchoice

config SYS_SOC
	default "tegra210"

source "board/nvidia/p2371-0000/Kconfig"
source "board/nvidia/p2371-2180/Kconfig"
source "board/nvidia/p2571/Kconfig"
source "board/nvidia/p3450-0000/Kconfig"

endif
```

## release/src-rt-5.04behnd.4916/bootloaders/u-boot-2024.04/arch/arm/mach-tegra/tegra30/Kconfig
```kconfig
if TEGRA30

choice
	prompt "Tegra30 board select"
	optional

config TARGET_APALIS_T30
	bool "Toradex Apalis T30 board"
	select BOARD_LATE_INIT

config TARGET_BEAVER
	bool "NVIDIA Tegra30 Beaver evaluation board"
	select BOARD_LATE_INIT

config TARGET_CARDHU
	bool "NVIDIA Tegra30 Cardhu evaluation board"
	select BOARD_LATE_INIT

config TARGET_COLIBRI_T30
	bool "Toradex Colibri T30 board"
	select BOARD_LATE_INIT

config TARGET_ENDEAVORU
	bool "HTC Endeavoru T30 board"
	select BOARD_LATE_INIT

config TARGET_GROUPER
	bool "Asus and Google Grouper board"
	select BOARD_LATE_INIT

config TARGET_TEC_NG
	bool "Avionic Design TEC-NG board"
	select BOARD_LATE_INIT

config TARGET_TRANSFORMER_T30
	bool "Asus Tegra30 Transformer board"
	select BOARD_LATE_INIT

config TARGET_X3_T30
	bool "LG X3 Tegra30 board"
	select BOARD_LATE_INIT

endchoice

config SYS_SOC
	default "tegra30"

source "board/toradex/apalis_t30/Kconfig"
source "board/nvidia/beaver/Kconfig"
source "board/nvidia/cardhu/Kconfig"
source "board/toradex/colibri_t30/Kconfig"
source "board/htc/endeavoru/Kconfig"
source "board/asus/grouper/Kconfig"
source "board/avionic-design/tec-ng/Kconfig"
source "board/asus/transformer-t30/Kconfig"
source "board/lg/x3-t30/Kconfig"

endif
```

## release/src-rt-5.04behnd.4916/bootloaders/u-boot-2024.04/arch/arm/mach-u8500/Kconfig
```kconfig
if ARCH_U8500

config SYS_SOC
	default "u8500"

choice
	prompt "U8500 board selection"

config TARGET_STEMMY
	bool "Samsung (stemmy) board"
	select MISC_INIT_R
	help
	  The Samsung "stemmy" board supports Samsung smartphones released with
	  the ST-Ericsson NovaThor U8500 SoC, e.g.

	      - Samsung Galaxy Ace 2 (GT-I8160)		"codina"
	      - Samsung Galaxy Amp (SGH-I407)		"kyle"
	      - Samsung Galaxy Beam (GT-I8530)		"gavini"
	      - Samsung Galaxy Exhibit (SGH-T599)	"codina" (TMO)
	      - Samsung Galaxy S Advance (GT-I9070)	"janice"
	      - Samsung Galaxy S III mini (GT-I8190)	"golden"
	      - Samsung Galaxy Xcover 2 (GT-S7710)	"skomer"

	  See doc/board/ste/stemmy.rst for details.

endchoice

source "board/ste/stemmy/Kconfig"

endif
```

## release/src-rt-5.04behnd.4916/bootloaders/u-boot-2024.04/arch/arm/mach-versal-net/Kconfig
```kconfig
# SPDX-License-Identifier: GPL-2.0

if ARCH_VERSAL_NET

config SYS_BOARD
	string "Board name"
	default "versal-net"

config SYS_VENDOR
	string "Vendor name"
	default "xilinx"

config SYS_SOC
	default "versal-net"

config SYS_CONFIG_NAME
	string "Board configuration name"
	default "xilinx_versal_net"
	help
	  This option contains information about board configuration name.
	  Based on this option include/configs/<CONFIG_SYS_CONFIG_NAME>.h header
	  will be used for board configuration.

config COUNTER_FREQUENCY
	int "Timer clock frequency"
	default 0
	help
	  Setup time clock frequency for certain platform

config IOU_SWITCH_DIVISOR0
	hex "IOU switch divisor0"
	default 0x20
	help
	  Setup time clock divisor for input clock.

config SYS_MEM_RSVD_FOR_MMU
	bool "Reserve memory for MMU Table"
	help
	  If defined this option is used to setup different space for
	  MMU table than the one which will be allocated during
	  relocation.

config GICV3
	def_bool y

config SYS_MALLOC_LEN
	default 0x2000000

config ZYNQ_SDHCI_MAX_FREQ
	default 200000000

source "board/xilinx/Kconfig"
source "board/xilinx/versal-net/Kconfig"

endif
```

## release/src-rt-5.04behnd.4916/bootloaders/u-boot-2024.04/arch/arm/mach-versal/Kconfig
```kconfig
# SPDX-License-Identifier: GPL-2.0+

if ARCH_VERSAL

config SYS_BOARD
	string "Board name"
	default "versal"

config SYS_VENDOR
	string "Vendor name"
	default "xilinx"

config SYS_SOC
	default "versal"

config SYS_CONFIG_NAME
	string "Board configuration name"
	default "xilinx_versal"
	help
	  This option contains information about board configuration name.
	  Based on this option include/configs/<CONFIG_SYS_CONFIG_NAME>.h header
	  will be used for board configuration.

config SYS_MALLOC_LEN
	default 0x2000000

config ZYNQ_SDHCI_MAX_FREQ
	default 200000000

config IOU_SWITCH_DIVISOR0
	hex "IOU switch divisor0"
	default 0x20
	help
	  Setup time clock divisor for input clock.

config SYS_MEM_RSVD_FOR_MMU
	bool "Reserve memory for MMU Table"
	help
	  If defined this option is used to setup different space for
	  MMU table than the one which will be allocated during
	  relocation.

config DEFINE_TCM_OCM_MMAP
	bool "Define TCM and OCM memory in MMU Table"
	default y if MP
	help
	  This option if enabled defines the TCM and OCM memory and its
	  memory attributes in MMU table entry.

config VERSAL_NO_DDR
	bool "Disable DDR MMU mapping"
	help
	  This option configures MMU with no DDR to avoid speculative
	  access to DDR memory where DDR is not present.

source "board/xilinx/Kconfig"
source "board/xilinx/versal/Kconfig"

endif
```
