## release/src-rt-5.04behnd.4916/bootloaders/u-boot-2024.04/arch/arm/mach-sti/Kconfig
```kconfig
if ARCH_STI

config SYS_SOC
	default "stih410"

choice
	prompt "STiH410 board select"

config TARGET_STIH410_B2260
	bool "96Boards STiH410-B2260"
	help
	  Support for 96Board STiH410-B2260 based on STMicroelectronics
	  STiH410 soc. This board complies with 96Board Open Platform
	  Specifications. Features:
	  - 1GB DDR
	  - On-Board USB combo WiFi/Bluetooth RTL8723BU
	    with PCB soldered antenna
	  - Ethernet 1000-BaseT
	  - Sata
	  - HDMI
	  - 2 x USB2 type A
	  - micro USB2 type AB
	  - SD card slot
	  - High speed connector (SD/I2C/USB interfaces)
	  - Low speed connector (UART/I2C/GPIO/SPI/PCM interfaces)

endchoice

source "board/st/stih410-b2260/Kconfig"

endif
```

## release/src-rt-5.04behnd.4916/bootloaders/u-boot-2024.04/arch/arm/mach-stm32/Kconfig
```kconfig
if ARCH_STM32

config STM32F4
	bool "stm32f4 family"
	select CLK
	select DM_GPIO
	select DM_RESET
	select MISC
	select PINCTRL
	select PINCTRL_STM32
	select RAM
	select STM32_RCC
	select STM32_RESET
	select STM32_SDRAM
	select STM32_SERIAL
	select STM32_TIMER
	select TIMER

config STM32F7
	bool "stm32f7 family"
	select CLK
	select DM_GPIO
	select DM_RESET
	select MISC
	select PINCTRL
	select PINCTRL_STM32
	select RAM
	select STM32_RCC
	select STM32_RESET
	select STM32_SDRAM
	select STM32_SERIAL
	select STM32_TIMER
	select SUPPORT_SPL
	select TIMER
	imply SPL_OS_BOOT

config STM32H7
	bool "stm32h7 family"
	select CLK
	select DM_GPIO
	select DM_RESET
	select MISC
	select PINCTRL
	select PINCTRL_STM32
	select RAM
	select REGMAP
	select STM32_RCC
	select STM32_RESET
	select STM32_SDRAM
	select STM32_SERIAL
	select STM32_TIMER
	select SYSCON
	select TIMER

source "arch/arm/mach-stm32/stm32f4/Kconfig"
source "arch/arm/mach-stm32/stm32f7/Kconfig"
source "arch/arm/mach-stm32/stm32h7/Kconfig"

endif
```

## release/src-rt-5.04behnd.4916/bootloaders/u-boot-2024.04/arch/arm/mach-stm32/stm32f4/Kconfig
```kconfig
if STM32F4

config TARGET_STM32F429_DISCOVERY
	bool "STM32F429 Discovery board"

config TARGET_STM32F429_EVALUATION
	bool "STM32F429 Evaluation board"

config TARGET_STM32F469_DISCOVERY
	bool "STM32F469 Discovery board"

source "board/st/stm32f429-discovery/Kconfig"
source "board/st/stm32f429-evaluation/Kconfig"
source "board/st/stm32f469-discovery/Kconfig"

endif
```

## release/src-rt-5.04behnd.4916/bootloaders/u-boot-2024.04/arch/arm/mach-stm32/stm32f7/Kconfig
```kconfig
if STM32F7

config TARGET_STM32F746_DISCO
	bool "STM32F746 Discovery board"

source "board/st/stm32f746-disco/Kconfig"

endif
```

## release/src-rt-5.04behnd.4916/bootloaders/u-boot-2024.04/arch/arm/mach-stm32/stm32h7/Kconfig
```kconfig
if STM32H7

config TARGET_STM32H743_DISCO
	bool "STM32H743 Discovery board"

config TARGET_STM32H743_EVAL
	bool "STM32H743 Evaluation board"

config TARGET_STM32H750_ART_PI
	bool "STM32H750 ART Pi board"

source "board/st/stm32h743-eval/Kconfig"
source "board/st/stm32h743-disco/Kconfig"
source "board/st/stm32h750-art-pi/Kconfig"

endif
```

## release/src-rt-5.04behnd.4916/bootloaders/u-boot-2024.04/arch/arm/mach-stm32mp/Kconfig
```kconfig
if ARCH_STM32MP

config SPL
	select SPL_BOARD_INIT
	select SPL_CLK
	select SPL_DM
	select SPL_DM_SEQ_ALIAS
	select SPL_DRIVERS_MISC
	select SPL_FRAMEWORK
	select SPL_GPIO
	select SPL_LIBCOMMON_SUPPORT
	select SPL_LIBGENERIC_SUPPORT
	select SPL_OF_CONTROL
	select SPL_OF_TRANSLATE
	select SPL_PINCTRL
	select SPL_REGMAP
	select SPL_DM_RESET
	select SPL_SERIAL
	select SPL_SYSCON
	select SPL_WATCHDOG if WATCHDOG
	imply BOOTSTAGE_STASH if SPL_BOOTSTAGE
	imply SPL_BOOTSTAGE if BOOTSTAGE
	imply SPL_DISPLAY_PRINT
	imply SPL_LIBDISK_SUPPORT
	imply SPL_SPI_LOAD if SPL_SPI

config SYS_SOC
	default "stm32mp"

config SYS_MALLOC_LEN
	default 0x2000000

config ENV_SIZE
	default 0x2000

choice
	prompt "Select STMicroelectronics STM32MPxxx Soc"
	default STM32MP15X

config STM32MP13X
	bool "Support STMicroelectronics STM32MP13x Soc"
	select ARM_SMCCC
	select CPU_V7A
	select CPU_V7_HAS_NONSEC
	select CPU_V7_HAS_VIRT
	select OF_BOARD
	select OF_BOARD_SETUP
	select PINCTRL_STM32
	select STM32_RCC
	select STM32_RESET
	select STM32_SERIAL
	select SYS_ARCH_TIMER
	imply CMD_NVEDIT_INFO
	help
		support of STMicroelectronics SOC STM32MP13x family
		STMicroelectronics MPU with core ARMv7

config STM32MP15X
	bool "Support STMicroelectronics STM32MP15x Soc"
	select ARCH_SUPPORT_PSCI
	select BINMAN
	select CPU_V7A
	select CPU_V7_HAS_NONSEC
	select CPU_V7_HAS_VIRT
	select OF_BOARD if TFABOOT
	select OF_BOARD_SETUP
	select PINCTRL_STM32
	select STM32_RCC
	select STM32_RESET
	select STM32_SERIAL
	select SUPPORT_SPL
	select SYS_ARCH_TIMER
	imply CMD_NVEDIT_INFO
	help
		support of STMicroelectronics SOC STM32MP15x family
		STM32MP157, STM32MP153 or STM32MP151
		STMicroelectronics MPU with core ARMv7
		dual core A7 for STM32MP157/3, monocore for STM32MP151

config STM32MP25X
	bool "Support STMicroelectronics STM32MP25x Soc"
	select ARM64
	select CLK_STM32MP25
	select OF_BOARD
	select PINCTRL_STM32
	select STM32_RCC
	select STM32_RESET
	select STM32_SERIAL
	select SYS_ARCH_TIMER
	select TFABOOT
	imply CLK_SCMI
	imply CMD_NVEDIT_INFO
	imply DM_REGULATOR
	imply DM_REGULATOR_SCMI
	imply OPTEE
	imply RESET_SCMI
	imply SYSRESET_PSCI
	imply TEE
	imply VERSION_VARIABLE
	help
		Support of STMicroelectronics SOC STM32MP25x family
		STMicroelectronics MPU with 2 * A53 core and 1 M33 core
endchoice

config NR_DRAM_BANKS
	default 1

config DDR_CACHEABLE_SIZE
	hex "Size of the DDR marked cacheable in pre-reloc stage"
	default 0x40000000
	help
		Define the size of the DDR marked as cacheable in U-Boot
		pre-reloc stage.
		This option can be useful to avoid speculatif access
		to secured area of DDR used by TF-A or OP-TEE before U-Boot
		initialization.
		The areas marked "no-map" in device tree should be located
		before this limit: STM32_DDR_BASE + DDR_CACHEABLE_SIZE.

config SYS_MMCSD_RAW_MODE_U_BOOT_PARTITION_MMC2
	hex "Partition on MMC2 to use to load U-Boot from"
	depends on SYS_MMCSD_RAW_MODE_U_BOOT_USE_PARTITION
	default 1
	help
	  Partition on the second MMC to load U-Boot from when the MMC is being
	  used in raw mode

config STM32_ETZPC
	bool "STM32 Extended TrustZone Protection"
	depends on STM32MP15X || STM32MP13X
	default y
	imply BOOTP_SERVERIP
	help
	  Say y to enable STM32 Extended TrustZone Protection

config STM32_ECDSA_VERIFY
	bool "STM32 ECDSA verification via the ROM API"
	depends on SPL_ECDSA_VERIFY
	default y
	help
	  Say y to enable the uclass driver for ECDSA verification using the
	  ROM API provided on STM32MP.
	  The ROM API is only available during SPL for now.

config CMD_STM32KEY
	bool "command stm32key to fuse public key hash"
	depends on CMDLINE
	help
		fuse public key hash in corresponding fuse used to authenticate
		binary.
		This command is used to evaluate the secure boot on stm32mp SOC,
		it is deactivated by default in real products.

source "arch/arm/mach-stm32mp/Kconfig.13x"
source "arch/arm/mach-stm32mp/Kconfig.15x"
source "arch/arm/mach-stm32mp/Kconfig.25x"
source "arch/arm/mach-stm32mp/cmd_stm32prog/Kconfig"
endif
```

## release/src-rt-5.04behnd.4916/bootloaders/u-boot-2024.04/arch/arm/mach-stm32mp/Kconfig.13x
```kconfig
if STM32MP13X

choice
	prompt "STM32MP13x board select"
	optional

config TARGET_ST_STM32MP13X
	bool "STMicroelectronics STM32MP13x boards"
	imply BOOTSTAGE
	imply CMD_BOOTSTAGE
	imply CMD_CLS if CMD_BMP
	imply DISABLE_CONSOLE
	imply PRE_CONSOLE_BUFFER
	imply SILENT_CONSOLE
	help
		target the STMicroelectronics board with SOC STM32MP13x
		managed by board/st/stm32mp1.
		The difference between board are managed with devicetree

endchoice

config TEXT_BASE
	default 0xC0000000

config PRE_CON_BUF_ADDR
	default 0xC0800000

config PRE_CON_BUF_SZ
	default 4096

config BOOTSTAGE_STASH_ADDR
	default 0xC3000000

if BOOTCOUNT_GENERIC
config SYS_BOOTCOUNT_SINGLEWORD
	default y

# TAMP_BOOTCOUNT = TAMP_BACKUP_REGISTER(31)
config SYS_BOOTCOUNT_ADDR
	default 0x5C00A17C
endif

if DEBUG_UART

# debug on UART4 by default
config DEBUG_UART_BASE
	default 0x40010000

# clock source is HSI on reset
config DEBUG_UART_CLOCK
	default 48000000 if STM32_FPGA
	default 64000000
endif

source "board/st/stm32mp1/Kconfig"

endif
```

## release/src-rt-5.04behnd.4916/bootloaders/u-boot-2024.04/arch/arm/mach-stm32mp/Kconfig.15x
```kconfig
if STM32MP15X

config STM32MP15X_STM32IMAGE
	bool "Support STM32 image for generated U-Boot image"
	depends on TFABOOT
	help
		Support of STM32 image generation for SOC STM32MP15x
		for TF-A boot when FIP container is not used

choice
	prompt "STM32MP15x board select"
	optional

config TARGET_ST_STM32MP15X
	bool "STMicroelectronics STM32MP15x boards"
	imply BOOTSTAGE
	imply CMD_BOOTSTAGE
	imply CMD_CLS if CMD_BMP
	imply DISABLE_CONSOLE
	imply PRE_CONSOLE_BUFFER
	imply SILENT_CONSOLE
	help
		target the STMicroelectronics board with SOC STM32MP15x
		managed by board/st/stm32mp1:
		Evalulation board (EV1) or Discovery board (DK1 and DK2).
		The difference between board are managed with devicetree

config TARGET_DH_STM32MP1_PDK2
	bool "DH STM32MP1 PDK2"
	help
		Target the DH PDK2 development kit with STM32MP15x SoM.

config TARGET_MICROGEA_STM32MP1
	bool "Engicam MicroGEA STM32MP1 SOM"
	imply BOOTSTAGE
	imply CMD_BOOTSTAGE
	imply CMD_CLS if CMD_BMP
	imply DISABLE_CONSOLE
	imply PRE_CONSOLE_BUFFER
	imply SILENT_CONSOLE
	help
	  MicroGEA STM32MP1 is a STM32MP157A based Micro SOM.

	  MicroGEA STM32MP1 MicroDev 2.0:
	  * MicroDev 2.0 is a general purpose miniature carrier board with CAN,
	    LTE and LVDS panel interfaces.
	  * MicroGEA STM32MP1 needs to mount on top of this MicroDev 2.0 board
	    for creating complete MicroGEA STM32MP1 MicroDev 2.0 Carrier board.

	  MicroGEA STM32MP1 MicroDev 2.0 7" OF:
	  * 7" OF is a capacitive touch 7" Open Frame panel solutions with LVDS
	    panel and toucscreen.
	  * MicroGEA STM32MP1 needs to mount on top of MicroDev 2.0 board with
	    pluged 7" OF for creating complete MicroGEA STM32MP1 MicroDev 2.0 7"
	    Open Frame Solution board.

config TARGET_ICORE_STM32MP1
	bool "Engicam i.Core STM32MP1 SOM"
	imply BOOTSTAGE
	imply CMD_BOOTSTAGE
	imply CMD_CLS if CMD_BMP
	imply DISABLE_CONSOLE
	imply PRE_CONSOLE_BUFFER
	imply SILENT_CONSOLE
	help
	  i.Core STM32MP1 is an EDIMM SOM based on STM32MP157A.

	  i.Core STM32MP1 EDIMM2.2:
	  * EDIMM2.2 is a Form Factor Capacitive Evaluation Board.
	  * i.Core STM32MP1 needs to mount on top of EDIMM2.2 for
	    creating complete i.Core STM32MP1 EDIMM2.2 Starter Kit.

	  i.Core STM32MP1 C.TOUCH 2.0
	  * C.TOUCH 2.0 is a general purpose Carrier board.
	  * i.Core STM32MP1 needs to mount on top of this Carrier board
	    for creating complete i.Core STM32MP1 C.TOUCH 2.0 board.

endchoice

config STM32MP15_PWR
	bool "Enable driver for STM32MP15x PWR"
	depends on DM_REGULATOR && DM_PMIC
	default y
	help
		This config enables implementation of driver-model pmic and
		regulator uclass features for access to STM32MP15x PWR.

config SPL_STM32MP15_PWR
	bool "Enable driver for STM32MP15x PWR in SPL"
	depends on SPL && SPL_DM_REGULATOR && SPL_DM_PMIC
	default y
	help
		This config enables implementation of driver-model pmic and
		regulator uclass features for access to STM32MP15x PWR in SPL.

config TEXT_BASE
	default 0xC0100000

config PRE_CON_BUF_ADDR
	default 0xC02FF000

config PRE_CON_BUF_SZ
	default 4096

config BOOTSTAGE_STASH_ADDR
	default 0xC3000000

if BOOTCOUNT_GENERIC
config SYS_BOOTCOUNT_SINGLEWORD
	default y

# TAMP_BOOTCOUNT = TAMP_BACKUP_REGISTER(21)
config SYS_BOOTCOUNT_ADDR
	default 0x5C00A154
endif

if DEBUG_UART

config DEBUG_UART_BOARD_INIT
	default y if SPL

# debug on UART4 by default
config DEBUG_UART_BASE
	default 0x40010000

# clock source is HSI on reset
config DEBUG_UART_CLOCK
	default 64000000
endif

source "board/st/stm32mp1/Kconfig"
source "board/dhelectronics/dh_stm32mp1/Kconfig"
source "board/engicam/stm32mp1/Kconfig"

endif
```

## release/src-rt-5.04behnd.4916/bootloaders/u-boot-2024.04/arch/arm/mach-stm32mp/Kconfig.25x
```kconfig
if STM32MP25X

choice
	prompt "STM32MP25x board select"
	optional

config TARGET_ST_STM32MP25X
	bool "STMicroelectronics STM32MP25x boards"
	imply BOOTSTAGE
	imply CMD_BOOTSTAGE
	help
		target the STMicroelectronics board with SOC STM32MP25x
		managed by board/st/stm32mp2
		The difference between board are managed with devicetree

endchoice

config TEXT_BASE
	default 0x84000000

config PRE_CON_BUF_ADDR
	default 0x84800000

config PRE_CON_BUF_SZ
	default 4096

config BOOTSTAGE_STASH_ADDR
	default 0x87000000

if DEBUG_UART

config DEBUG_UART_BOARD_INIT
	default y

# debug on USART2 by default
config DEBUG_UART_BASE
	default 0x400e0000

endif

source "board/st/stm32mp2/Kconfig"

endif
```

## release/src-rt-5.04behnd.4916/bootloaders/u-boot-2024.04/arch/arm/mach-stm32mp/cmd_stm32prog/Kconfig
```kconfig
config CMD_STM32PROG
	bool "command stm32prog for STM32CudeProgrammer"
	select DFU
	select DFU_RAM
	select DFU_VIRT
	select PARTITION_TYPE_GUID
	imply CMD_GPT if MMC
	imply CMD_MTD if MTD
	imply DFU_MMC if MMC
	imply DFU_MTD if MTD
	help
		activate a specific command stm32prog for STM32MP soc family
		witch update the device with the tools STM32CubeProgrammer
		NB: access to not volatile memory (NOR/NAND/SD/eMMC) is based
		    on U-Boot DFU framework

config CMD_STM32PROG_USB
	bool "support stm32prog over USB"
	depends on CMD_STM32PROG
	default y
	help
		activate the command "stm32prog usb" for STM32MP soc family
		witch update the device with the tools STM32CubeProgrammer,
		using USB with DFU protocol

config CMD_STM32PROG_SERIAL
	bool "support stm32prog over UART"
	depends on CMD_STM32PROG
	default y
	help
		activate the command "stm32prog serial" for STM32MP soc family
		with the tools STM32CubeProgrammer using U-Boot serial device
		and UART protocol.

config CMD_STM32PROG_OTP
	bool "support stm32prog for OTP update"
	depends on CMD_STM32PROG
	default y if ARM_SMCCC || OPTEE
	help
		Support the OTP update with the command "stm32prog" for STM32MP
```
