// SPDX-License-Identifier: GPL-2.0+
/*
 * Copyright (C) 2018 Angelo Dureghello <angelo@sysam.it>
 */

/dts-v1/;
/include/ "mcf5253.dtsi"

/ {
	model = "Freescale M5253DEMO";
	compatible = "fsl,M5253DEMO";

	chosen {
		stdout-path = "serial0:115200n8";
	};
};

&uart0 {
	bootph-all;
	status = "okay";
};

&i2c0 {
	clock-frequency = <80000>;
	u-boot,i2c-slave-addr = <0x7f>;
	status = "okay";
};
