## release/src-rt-5.04behnd.4916/bootloaders/u-boot-2024.04/arch/powerpc/cpu/mpc83xx/Kconfig
```kconfig
menu "mpc83xx CPU"
	depends on MPC83xx

config DEFAULT_IMMR
	hex
	default 0xFF400000

config E300
	def_bool y

config SYS_CPU
	default "mpc83xx"

config SYS_83XX_DDR_USES_CS0
	bool
	help
	  DDR should be configured using CS0 and CS1 instead of CS2 and CS3.

choice
	prompt "Target select"
	optional

config TARGET_CMPCPRO
	bool "Support CMPCPRO board from CSSI"
	select ARCH_MPC832X

config TARGET_MPC837XERDB
	bool "Support MPC837XERDB"
	select ARCH_MPC837X
	select BOARD_EARLY_INIT_F
	select SYS_83XX_DDR_USES_CS0

config TARGET_KMETER1
	bool "Support kmeter1"
	select VENDOR_KM
	select KM_ENABLE_FULL_DM_DTS_SUPPORT

config TARGET_KMCOGE5NE
	bool "Support kmcoge5ne"
	select VENDOR_KM
	select KM_ENABLE_FULL_DM_DTS_SUPPORT

config TARGET_KMTEGR1
	bool "Support kmtegr1"
	select VENDOR_KM
	select KM_ENABLE_FULL_DM_DTS_SUPPORT

config TARGET_TUXX1
	bool "Support tuxx1"
	select VENDOR_KM
	select KM_ENABLE_FULL_DM_DTS_SUPPORT

config TARGET_KMSUPX5
	bool "Support kmsupx5"
	select VENDOR_KM
	select KM_ENABLE_FULL_DM_DTS_SUPPORT

config TARGET_TUGE1
	bool "Support tuge1"
	select VENDOR_KM
	select KM_ENABLE_FULL_DM_DTS_SUPPORT

config TARGET_KMOPTI2
	bool "Support kmopti2"
	select VENDOR_KM
	select KM_ENABLE_FULL_DM_DTS_SUPPORT

config TARGET_KMTEPR2
	bool "Support kmtepr2"
	select VENDOR_KM
	select KM_ENABLE_FULL_DM_DTS_SUPPORT

config TARGET_GAZERBEAM
	bool "Support gazerbeam"
	select ARCH_MPC8308
	select SYS_FSL_ERRATUM_ESDHC111
	imply ENV_IS_IN_FLASH
	help
	  The "Gazerbeam" is a modular system by Guntermann & Drunck GmbH
	  Systementwicklung based on the NXP MPC8308 SoC for usage in KVM
	  appliances.

	  Features include:
	  * Two gigabit ethernet ports
	  * Multiple USB ports (depending on variant)
	  * Several gigabit ethernet or optical fiber ports (depending on
	    variant)
	  * Several display port inputs and outputs, and supporting redrivers
	    (depending on variant)
	  * Several FPGAs with custom logic (depending on variant)

endchoice

config MPC83XX_QUICC_ENGINE
	bool

# TODO: Imply MPC83xx PCI driver
config MPC83XX_PCI_SUPPORT
	bool

# TODO: Imply TSEC driver
config MPC83XX_TSEC1_SUPPORT
	bool

config MPC83XX_TSEC2_SUPPORT
	bool

config MPC83XX_PCIE1_SUPPORT
	bool

config MPC83XX_PCIE2_SUPPORT
	bool

config MPC83XX_SDHC_SUPPORT
	bool

config MPC83XX_SATA
	bool

config MPC83XX_SECOND_I2C
	bool

config MPC83XX_LDP_PIN
	bool

config ARCH_MPC830X
	bool
	select MPC83XX_SDHC_SUPPORT
	select SYS_CACHE_SHIFT_5

config ARCH_MPC8308
	bool
	select ARCH_MPC830X
	select MPC83XX_TSEC1_SUPPORT
	select MPC83XX_TSEC2_SUPPORT
	select MPC83XX_PCIE1_SUPPORT
	select MPC83XX_SECOND_I2C

config ARCH_MPC831X
	bool
	select MPC83XX_PCI_SUPPORT
	select MPC83XX_TSEC1_SUPPORT
	select MPC83XX_TSEC2_SUPPORT
	select SYS_CACHE_SHIFT_5

config ARCH_MPC8313
	bool
	select ARCH_MPC831X
	select MPC83XX_SECOND_I2C
	select FSL_ELBC

config ARCH_MPC832X
	bool
	select MPC83XX_QUICC_ENGINE
	select MPC83XX_PCI_SUPPORT
	select SYS_CACHE_SHIFT_5

config ARCH_MPC834X
	bool
	select SYS_CACHE_SHIFT_5

config ARCH_MPC8360
	bool
	select MPC83XX_QUICC_ENGINE
	select MPC83XX_PCI_SUPPORT
	select MPC83XX_LDP_PIN
	select MPC83XX_SECOND_I2C
	select SYS_CACHE_SHIFT_5

config ARCH_MPC837X
	bool
	select MPC83XX_PCI_SUPPORT
	select MPC83XX_TSEC1_SUPPORT
	select MPC83XX_TSEC2_SUPPORT
	select MPC83XX_PCIE1_SUPPORT
	select MPC83XX_PCIE2_SUPPORT
	select MPC83XX_SDHC_SUPPORT
	select MPC83XX_SATA
	select MPC83XX_LDP_PIN
	select MPC83XX_SECOND_I2C
	select SYS_CACHE_SHIFT_5
	select FSL_ELBC

source "arch/powerpc/cpu/mpc83xx/hrcw/Kconfig"
source "arch/powerpc/cpu/mpc83xx/bats/Kconfig"
source "arch/powerpc/cpu/mpc83xx/lblaw/Kconfig"
source "arch/powerpc/cpu/mpc83xx/elbc/Kconfig"
source "arch/powerpc/cpu/mpc83xx/hid/Kconfig"
source "arch/powerpc/cpu/mpc83xx/sysio/Kconfig"
source "arch/powerpc/cpu/mpc83xx/arbiter/Kconfig"
source "arch/powerpc/cpu/mpc83xx/initreg/Kconfig"

config 83XX_PCICLK
	hex "PCI clock frequency"
	default 0xDEADBEEF
	help
	  If required, the PCI clock frequency to use when configuring
	  the host bridge.

config FSL_ELBC
	bool

config FSL_SERDES
	bool "SerDes initialization"
	depends on !MPC83XX_SERDES

config NEVER_ASSERT_ODT_TO_CPU
	bool "Never assert ODT to internal IOs"

source "board/freescale/mpc837xerdb/Kconfig"
source "board/gdsys/mpc8308/Kconfig"
source "board/cssi/cmpcpro/Kconfig"

endmenu
```

## release/src-rt-5.04behnd.4916/bootloaders/u-boot-2024.04/arch/powerpc/cpu/mpc83xx/arbiter/Kconfig
```kconfig
menu "Arbiter"

choice
	prompt "Pipeline depth"

config ACR_PIPE_DEP_UNSET
	bool "Don't set value"

config ACR_PIPE_DEP_1
	bool "1"

config ACR_PIPE_DEP_2
	bool "2"

config ACR_PIPE_DEP_3
	bool "3"

config ACR_PIPE_DEP_4
	bool "4"

endchoice

choice
	prompt "Repeat count"

config ACR_RPTCNT_UNSET
	bool "Don't set value"

config ACR_RPTCNT_1
	bool "1"

config ACR_RPTCNT_2
	bool "2"

config ACR_RPTCNT_3
	bool "3"

config ACR_RPTCNT_4
	bool "4"

config ACR_RPTCNT_5
	bool "5"

config ACR_RPTCNT_6
	bool "6"

config ACR_RPTCNT_7
	bool "7"

config ACR_RPTCNT_8
	bool "8"

endchoice

choice
	prompt "Address parking"

config ACR_APARK_UNSET
	bool "Don't set value"

config ACR_APARK_MASTER
	bool "Park to master"

config ACR_APARK_LAST
	bool "Park to last owner"

config ACR_APARK_DISABLE
	bool "Disabled"

endchoice

choice
	prompt "Parking master"

config ACR_PARKM_UNSET
	bool "Don't set value"

config ACR_PARKM_E300
	bool "e300 core"

config ACR_PARKM_TSEC_1_2
	bool "TSEC1, TSEC2"

config ACR_PARKM_USB_I2C1_BOOT
	bool "USB/I2C1_BOOT"

config ACR_PARKM_DMA_ESDHC_USB
	bool "DMA, ESDHC, USB"

config ACR_PARKM_PEX
	bool "PCI Express"

if MPC83XX_QUICC_ENGINE

config ACR_PARKM_ENC_CORE
	bool "Encryption core"

endif

endchoice

config ACR_PIPE_DEP
	hex
	default 0x0 if ACR_PIPE_DEP_UNSET
	default 0x0 if ACR_PIPE_DEP_1
	default 0x10000 if ACR_PIPE_DEP_2
	default 0x20000 if ACR_PIPE_DEP_3
	default 0x30000 if ACR_PIPE_DEP_4

config ACR_RPTCNT
	hex
	default 0x0 if ACR_RPTCNT_UNSET
	default 0x0 if ACR_RPTCNT_1
	default 0x100 if ACR_RPTCNT_2
	default 0x200 if ACR_RPTCNT_3
	default 0x300 if ACR_RPTCNT_4
	default 0x400 if ACR_RPTCNT_5
	default 0x500 if ACR_RPTCNT_6
	default 0x600 if ACR_RPTCNT_7
	default 0x700 if ACR_RPTCNT_8

config ACR_APARK
	hex
	default 0x0 if ACR_APARK_UNSET
	default 0x0 if ACR_APARK_MASTER
	default 0x10 if ACR_APARK_LAST
	default 0x20 if ACR_APARK_DISABLE

config ACR_PARKM
	hex
	default 0x0 if ACR_PARKM_UNSET
	default 0x0 if ACR_PARKM_E300
	default 0x2 if ACR_PARKM_TSEC_1_2
	default 0x3 if ACR_PARKM_USB_I2C1_BOOT
	default 0x4 if ACR_PARKM_DMA_ESDHC_USB
	default 0x5 if ACR_PARKM_PEX
	default 0x5 if ACR_PARKM_ENC_CORE

endmenu
```

## release/src-rt-5.04behnd.4916/bootloaders/u-boot-2024.04/arch/powerpc/cpu/mpc83xx/elbc/Kconfig
```kconfig
menu "ELBC register setup"

choice
	prompt "OR/BR for NAND SPL"

config ELBC_BR_OR_NAND_PRELIM_NONE
	bool "None"

config ELBC_BR_OR_NAND_PRELIM_0
	bool "0"

config ELBC_BR_OR_NAND_PRELIM_1
	bool "1"

config ELBC_BR_OR_NAND_PRELIM_2
	bool "2"

config ELBC_BR_OR_NAND_PRELIM_3
	bool "3"

config ELBC_BR_OR_NAND_PRELIM_4
	bool "4"

endchoice

endmenu
```
