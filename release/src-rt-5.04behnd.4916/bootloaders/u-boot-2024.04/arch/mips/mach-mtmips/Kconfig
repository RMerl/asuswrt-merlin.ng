## release/src-rt-5.04behnd.4916/bootloaders/u-boot-2024.04/arch/mips/mach-mtmips/Kconfig
```kconfig
menu "MediaTek MIPS platforms"
	depends on ARCH_MTMIPS

config SYS_VENDOR
	default "mediatek" if BOARD_MT7628_RFB || BOARD_MT7620_RFB || BOARD_MT7620_MT7530_RFB

config SYS_MALLOC_F_LEN
	default 0x1000

config SYS_SOC
	default "mt7620" if SOC_MT7620
	default "mt7621" if SOC_MT7621
	default "mt7628" if SOC_MT7628

config SYS_DCACHE_SIZE
	default 32768

config SYS_DCACHE_LINE_SIZE
	default 32

config SYS_ICACHE_SIZE
	default 65536 if SOC_MT7620 || SOC_MT7628
	default 32768 if SOC_MT7621

config SYS_ICACHE_LINE_SIZE
	default 32

config SYS_SCACHE_LINE_SIZE
	default 32 if SOC_MT7621

config TEXT_BASE
	default 0x9c000000 if !SPL && !SOC_MT7621
	default 0x80200000 if SPL || SOC_MT7621

config SPL_TEXT_BASE
	default 0x9c000000 if !SOC_MT7621
	default 0x80100000 if SOC_MT7621

config SPL_SIZE_LIMIT
	default 0x30000 if SOC_MT7621

config TPL_TEXT_BASE
	default 0xbfc00000 if SOC_MT7621

config TPL_MAX_SIZE
	default 4096 if SOC_MT7621

config SPL_PAYLOAD
	default "u-boot-lzma.img" if SPL_LZMA

config BUILD_TARGET
	default "u-boot-with-spl.bin" if SPL && !SOC_MT7621
	default "u-boot-lzma.img" if SOC_MT7621
	default "u-boot.bin"

config MAX_MEM_SIZE
	int
	default 256 if SOC_MT7620 || SOC_MT7628
	default 512 if SOC_MT7621

choice
	prompt "MediaTek MIPS SoC select"

config SOC_MT7620
	bool "MT7620"
	select SYS_CACHE_SHIFT_5
	select SYS_MIPS_CACHE_INIT_RAM_LOAD
	select PINCTRL_MT7620
	select MT7620_SERIAL
	select MISC
	select SPL_SEPARATE_BSS if SPL
	select SPL_LOADER_SUPPORT if SPL
	select SPL_OF_CONTROL if SPL_DM
	select SPL_OF_PLATDATA if SPL_DM
	select SPL_DM_SERIAL if SPL_DM
	help
	  This supports MediaTek MT7620.

config SOC_MT7621
	bool "MT7621"
	select MIPS_CM
	select MIPS_L2_CACHE
	select SYS_CACHE_SHIFT_5
	select SYS_MIPS_CACHE_INIT_RAM_LOAD
	select PINCTRL_MT7621
	select MTK_SERIAL
	select REGMAP
	select SYSCON
	select BINMAN
	select SUPPORT_TPL
	select SPL_LOADER_SUPPORT if SPL
	select SPL_INIT_STACK_WITHOUT_MALLOC_F if SPL
	help
	  This supports MediaTek MT7621.

config SOC_MT7628
	bool "MT7628"
	select SYS_CACHE_SHIFT_5
	select MIPS_INIT_STACK_IN_SRAM
	select MIPS_SRAM_INIT
	select SYS_MIPS_CACHE_INIT_RAM_LOAD
	select PINCTRL_MT7628
	select MTK_SERIAL
	select SYSRESET
	select SYSRESET_RESETCTL
	select SPL_SEPARATE_BSS if SPL
	select SPL_INIT_STACK_WITHOUT_MALLOC_F if SPL
	select SPL_LOADER_SUPPORT if SPL
	select SPL_OF_CONTROL if SPL_DM
	select SPL_SIMPLE_BUS if SPL_DM
	select SPL_DM_SERIAL if SPL_DM
	select SPL_CLK if SPL_DM && SPL_SERIAL
	select SPL_SYSRESET if SPL_DM
	select SPL_OF_LIBFDT if SPL_OF_CONTROL
	help
	  This supports MediaTek MT7628/MT7688.

endchoice

source "arch/mips/mach-mtmips/mt7620/Kconfig"
source "arch/mips/mach-mtmips/mt7621/Kconfig"
source "arch/mips/mach-mtmips/mt7628/Kconfig"

endmenu
```

## release/src-rt-5.04behnd.4916/bootloaders/u-boot-2024.04/arch/mips/mach-mtmips/mt7620/Kconfig
```kconfig
if SOC_MT7620

config DEBUG_UART_BOARD_INIT
	default y

choice
	prompt "Board select"

config BOARD_MT7620_RFB
	bool "MediaTek MT7620 RFB"
	help
	  The reference design of MT7620A (WS2120). The board has 64 MiB DDR2,
	  8 MiB SPI-NOR flash, 1 built-in 6 port switch (two GE PHYs and five
	  FE PHYs,one port can be configured to use either FE PHY or GE PHY),
	  1 UART, 1 USB host, 1 SDXC, 1 PCIe socket and JTAG pins.

config BOARD_MT7620_MT7530_RFB
	bool "MediaTek MT7620-MT7530 RFB"
	help
	  The reference design of MT7620DA (MTKC712). The board has 64 MiB
	  intergrated DDR2 KGD, 16 MiB SPI-NOR flash, an external 5-port giga
	  switch MT7530 and 1 UART.

endchoice

choice
	prompt "CPU frequency select"
	default CPU_FREQ_580MHZ

config CPU_FREQ_480MHZ
	bool "480MHz"

config CPU_FREQ_500MHZ
	bool "500MHz"

config CPU_FREQ_520MHZ
	bool "520MHz"

config CPU_FREQ_540MHZ
	bool "540MHz"

config CPU_FREQ_560MHZ
	bool "560MHz"

config CPU_FREQ_580MHZ
	bool "580MHz"

config CPU_FREQ_600MHZ
	bool "600MHz"

config CPU_FREQ_620MHZ
	bool "620MHz"

endchoice

config CPU_FREQ_MULTI
	int
	range 0 7
	default 0 if CPU_FREQ_480MHZ
	default 1 if CPU_FREQ_500MHZ
	default 2 if CPU_FREQ_520MHZ
	default 3 if CPU_FREQ_540MHZ
	default 4 if CPU_FREQ_560MHZ
	default 5 if CPU_FREQ_580MHZ
	default 6 if CPU_FREQ_600MHZ
	default 7 if CPU_FREQ_620MHZ

config SYS_CONFIG_NAME
	string "Board configuration name"
	default "mt7620" if  BOARD_MT7620_RFB || BOARD_MT7620_MT7530_RFB

config SYS_BOARD
	string "Board name"
	default "mt7620" if  BOARD_MT7620_RFB || BOARD_MT7620_MT7530_RFB

endif
```

## release/src-rt-5.04behnd.4916/bootloaders/u-boot-2024.04/arch/mips/mach-mtmips/mt7621/Kconfig
```kconfig
if SOC_MT7621

menu "CPU & DDR configuration"

config MT7621_CPU_FREQ
	int "CPU Frequency (MHz)"
	range 400 1200
	default 880

choice
	prompt "DRAM Frequency"
	default MT7621_DRAM_FREQ_1200

config MT7621_DRAM_FREQ_400
	bool "400MHz"

config MT7621_DRAM_FREQ_800
	bool "800MHz"

config MT7621_DRAM_FREQ_1066
	bool "1066MHz"

config MT7621_DRAM_FREQ_1200
	bool "1200MHz"

endchoice

choice
	prompt "DDR2 timing parameters"
	default MT7621_DRAM_DDR2_1024M

config MT7621_DRAM_DDR2_512M
	bool "64MB"

config MT7621_DRAM_DDR2_1024M
	bool "128MB"

config MT7621_DRAM_DDR2_512M_W9751G6KB_A02_1066MHZ
	bool "W9751G6KB_A02 @ 1066MHz (64MB)"

config MT7621_DRAM_DDR2_1024M_W971GG6KB25_800MHZ
	bool "W971GG6KB25 @ 800MHz (128MB)"

config MT7621_DRAM_DDR2_1024M_W971GG6KB18_1066MHZ
	bool "W971GG6KB18 @ 1066MHz (128MB)"

endchoice

choice
	prompt "DDR3 timing parameters"
	default MT7621_DRAM_DDR3_2048M

config MT7621_DRAM_DDR3_1024M
	bool "128MB"

config MT7621_DRAM_DDR3_1024M_KGD
	bool "128MB KGD (MT7621DA)"

config MT7621_DRAM_DDR3_2048M
	bool "256MB"

config MT7621_DRAM_DDR3_4096M
	bool "512MB"

endchoice

endmenu

config DEBUG_UART_BOARD_INIT
	default y

config MT7621_BOOT_FROM_NAND
	bool "Boot from NAND"
	help
	  Select this if u-boot will boot from NAND flash. When booting from
	  NAND, SPL will be loaded by bootrom directly and no TPL is needed.

choice
	prompt "Board select"

config BOARD_MT7621_RFB
	bool "MediaTek MT7621 RFB (SPI-NOR)"
	help
	  The reference design of MT7621A (WS3010) booting from SPI-NOR flash.
	  The board can be configured with DDR2 (64MiB~256MiB) or DDR3
	  (128MiB~512MiB). The board has 16 MiB SPI-NOR flash, built-in MT7530
	  GbE switch, 1 UART, 1 USB 2.0 host, 1 USB 3.0 host, 1 SDXC, 3 PCIe
	  sockets, 1 RGMII to external GbE PHY, 2 audio jacks (in/out),
	  JTAG pins and expansion GPIO pins.

config BOARD_MT7621_NAND_RFB
	bool "MediaTek MT7621 RFB (NAND)"
	help
	  The reference design of MT7621A (WS3010) booting from NAND flash.
	  The board can be configured with DDR2 (64MiB~256MiB) or DDR3
	  (128MiB~512MiB). The board has 128 MiB parallel NAND flash, built-in
	  MT7530 GbE switch, 1 UART, 1 USB 2.0 host, 1 USB 3.0 host, 3 PCIe
	  sockets, 1 RGMII to external GbE PHY, 2 audio jacks (in/out),
	  JTAG pins and expansion GPIO pins.

endchoice

config SYS_CONFIG_NAME
	string "Board configuration name"
	default "mt7621" if  BOARD_MT7621_RFB || BOARD_MT7621_NAND_RFB

config SYS_BOARD
	string "Board name"
	default "mt7621" if  BOARD_MT7621_RFB || BOARD_MT7621_NAND_RFB

config SYS_VENDOR
	default "mediatek" if BOARD_MT7621_RFB || BOARD_MT7621_NAND_RFB

endif
```

## release/src-rt-5.04behnd.4916/bootloaders/u-boot-2024.04/arch/mips/mach-mtmips/mt7628/Kconfig
```kconfig
if SOC_MT7628

choice
	prompt "Board select"

config BOARD_GARDENA_SMART_GATEWAY_MT7688
	bool "GARDENA smart Gateway"
	select BOARD_LATE_INIT
	help
	  GARDENA smart Gateway boards have a MT7688 SoC with 128 MiB of RAM
	  and 8 MiB of flash (SPI NOR) and additional SPI NAND storage.

config BOARD_LINKIT_SMART_7688
	bool "LinkIt Smart 7688"
	help
	  Seeed LinkIt Smart 7688 boards have a MT7688 SoC with 128 MiB of RAM
	  and 32 MiB of flash (SPI).
	  Between its different peripherals there's an integrated switch with 4
	  ethernet ports, 1 USB port, 1 UART, GPIO buttons and LEDs, and
	  a MT7688 (PCIe).

config BOARD_MT7628_RFB
	bool "MediaTek MT7628 RFB"
	help
	  The reference design of MT7628. The board has 128 MiB DDR2, 8 MiB
	  SPI-NOR flash, 1 built-in switch with 5 ports, 1 UART, 1 USB host,
	  1 SDXC, 1 PCIe socket and JTAG pins.

config BOARD_VOCORE2
	bool "VoCore2"
	select SPL_SERIAL
	select SPL_UART2_SPIS_PINMUX
	help
	  VoCore VoCore2 board has a MT7628 SoC with 128 MiB of RAM
	  and 16 MiB of flash (SPI).

endchoice

config SPL_UART2_SPIS_PINMUX
	bool "Use alternative pinmux for UART2 in SPL stage"
	depends on SPL_SERIAL
	help
	  Select this if the UART2 of your board is connected to GPIO 16/17
	  (shared with SPIS) rather than the usual GPIO 20/21.

config SYS_BOARD
	string "Board name"
	default "mt7628" if BOARD_MT7628_RFB

config SYS_CONFIG_NAME
	string "Board configuration name"
	default "mt7628" if BOARD_MT7628_RFB

source "board/gardena/smart-gateway-mt7688/Kconfig"
source "board/seeed/linkit-smart-7688/Kconfig"
source "board/vocore/vocore2/Kconfig"

endif
```

## release/src-rt-5.04behnd.4916/bootloaders/u-boot-2024.04/arch/mips/mach-octeon/Kconfig
```kconfig
menu "Octeon platforms"
	depends on ARCH_OCTEON

config SYS_SOC
	string
	default "octeon"

config OCTEON_CN7XXX
	bool "Octeon CN7XXX SoC"

config OCTEON_CN70XX
	bool "Octeon CN70XX SoC"
	select OCTEON_CN7XXX

config OCTEON_CN73XX
	bool "Octeon CN73XX SoC"
	select OCTEON_CN7XXX

config OCTEON_CN78XX
	bool "Octeon CN78XX SoC"
	select OCTEON_CN7XXX

choice
	prompt "Octeon MIPS family select"

config SOC_OCTEON3
	bool "Octeon III family"
	help
	 This selects the Octeon III SoC family CN70xx, CN73XX, CN78xx
	 and CNF75XX.

endchoice

choice
	prompt "Octeon 3 board select"
	default TARGET_OCTEON_EBB7304

config TARGET_OCTEON_EBB7304
	bool "Marvell Octeon EBB7304"
	select OCTEON_CN73XX
	help
	 Choose this for the Octeon EBB7304 board

config TARGET_OCTEON_NIC23
	bool "Marvell Octeon NIC23"
	select OCTEON_CN73XX
	help
	 Choose this for the Octeon NIC23 board

endchoice

config SYS_DCACHE_SIZE
	default 32768

config SYS_DCACHE_LINE_SIZE
	default 128

config SYS_ICACHE_SIZE
	default	79872

config SYS_ICACHE_LINE_SIZE
	default 128

config SYS_PCI_64BIT
	bool
	default y

source "board/Marvell/octeon_ebb7304/Kconfig"
source "board/Marvell/octeon_nic23/Kconfig"

endmenu
```

## release/src-rt-5.04behnd.4916/bootloaders/u-boot-2024.04/arch/mips/mach-pic32/Kconfig
```kconfig
menu "Microchip PIC32 platforms"
	depends on MACH_PIC32

config SYS_SOC
	default "pic32mzda" if SOC_PIC32MZDA

choice
	prompt "PIC32 SoC select"

config SOC_PIC32MZDA
	bool "Microchip PIC32MZ[DA] family"
	select SYS_CACHE_SHIFT_4
	select ROM_EXCEPTION_VECTORS
	select SUPPORTS_CPU_MIPS32_R1
	select SUPPORTS_CPU_MIPS32_R2
	select SUPPORTS_LITTLE_ENDIAN
	select SYS_MIPS_CACHE_INIT_RAM_LOAD
	help
	  This supports Microchip PIC32MZ[DA] family of microcontrollers.

endchoice

choice
	prompt "Board select"

config TARGET_PIC32MZDASK
	bool "Microchip PIC32MZ[DA] Starter Kit"
	depends on SOC_PIC32MZDA
	help
	  This supports Microchip PIC32MZ[DA] Starter Kit.

endchoice

source "board/microchip/pic32mzda/Kconfig"

endmenu
```

## release/src-rt-5.04behnd.4916/bootloaders/u-boot-2024.04/arch/nios2/Kconfig
```kconfig
menu "Nios II architecture"
	depends on NIOS2

config SYS_ARCH
	default "nios2"

config SYS_CONFIG_NAME
	string "Board header file"
	help
	  This option should contain the base name of board header file.
	  The header file include/configs/<CONFIG_SYS_CONFIG_NAME>.h
	  should be included from include/config.h.

endmenu
```

## release/src-rt-5.04behnd.4916/bootloaders/u-boot-2024.04/arch/powerpc/Kconfig
```kconfig
menu "PowerPC architecture"
	depends on PPC

config SYS_ARCH
	default "powerpc"

choice
	prompt "CPU select"
	optional

config MPC83xx
	bool "MPC83xx"
	select CREATE_ARCH_SYMLINK
	select SYS_FSL_HAS_SEC
	select SYS_FSL_SEC_BE
	select SYS_FSL_SEC_COMPAT_2

config MPC85xx
	bool "MPC85xx"
	select CREATE_ARCH_SYMLINK
	select SYS_FSL_DDR
	select SYS_FSL_DDR_BE
	select SYS_FSL_IFC_BE
	select BINMAN if MPC85XX_HAVE_RESET_VECTOR && OF_SEPARATE
	imply CMD_HASH
	imply CMD_IRQ
	imply USB_EHCI_HCD if USB

config MPC8xx
	bool "MPC8xx"
	select CREATE_ARCH_SYMLINK
	select BOARD_EARLY_INIT_F
	imply CMD_REGINFO
	imply WDT_MPC8xxx

endchoice

config FSL_LBC
	def_bool y
	depends on (MPC85xx || MPC83xx) && !FSL_IFC

config HIGH_BATS
	bool "Enable high BAT registers"
	help
	  Enable BATs (block address translation registers) 4-7 on machines
	  that support them.

config SYS_INIT_RAM_LOCK
	bool "Lock some portion of L1 for initial ram stack"
	depends on MPC83xx || MPC85xx

config SYS_SRIO
	bool "Serial RapidIO support"

config SRIO1
	bool "Board has SRIO 1 port available"
	depends on SYS_SRIO

config SRIO2
	bool "Board has SRIO 2 port available"
	depends on SYS_SRIO

config SRIO_PCIE_BOOT_MASTER
	bool "Board can support master function for Boot from SRIO and PCIE"
	depends on SYS_SRIO

source "arch/powerpc/cpu/mpc83xx/Kconfig"
source "arch/powerpc/cpu/mpc85xx/Kconfig"
source "arch/powerpc/cpu/mpc8xx/Kconfig"
source "arch/powerpc/lib/Kconfig"

config USE_UBOOTPATH
	bool "Set a default 'uboot' value in the environment"
	help
	  Many default environment scripts will check the "uboot" variable
	  to determine the name of the file to load via tftp that will then
	  be written to flash.

config UBOOTPATH
	string "Value of the default 'uboot' value in the environment"
	depends on USE_UBOOTPATH
	default "u-boot.bin"

endmenu
```
