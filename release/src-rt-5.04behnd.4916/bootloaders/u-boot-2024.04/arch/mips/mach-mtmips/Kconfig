## release/src-rt-5.04behnd.4916/bootloaders/u-boot-2024.04/arch/riscv/cpu/fu740/Kconfig
```kconfig
# SPDX-License-Identifier: GPL-2.0+
#
# Copyright (C) 2020-2021 SiFive, Inc
# Pragnesh Patel <pragnesh.patel@sifive.com>

config SIFIVE_FU740
	bool
	select ARCH_EARLY_INIT_R
	select RAM
	select SPL_RAM if SPL
	imply CPU
	imply CPU_RISCV
	imply RISCV_TIMER if (RISCV_SMODE || SPL_RISCV_SMODE)
	imply SPL_RISCV_ACLINT
	imply CMD_CPU
	imply SPL_CPU
	imply SPL_OPENSBI
	imply SPL_LOAD_FIT
	imply SMP
	imply CLK_SIFIVE
	imply CLK_SIFIVE_PRCI
	imply SIFIVE_CACHE
	imply SIFIVE_CCACHE
	imply SIFIVE_SERIAL
	imply MACB
	imply MII
	imply SPI
	imply SPI_SIFIVE
	imply MMC
	imply MMC_SPI
	imply MMC_BROKEN_CD
	imply CMD_MMC
	imply DM_GPIO
	imply SIFIVE_GPIO
	imply CMD_GPIO
	imply MISC
	imply SIFIVE_OTP
	imply DM_PWM
	imply PWM_SIFIVE
	imply DM_I2C
	imply SYS_I2C_OCORES
	imply SPL_I2C

if ENV_IS_IN_SPI_FLASH

config ENV_OFFSET
	default 0x505000

config ENV_SIZE
	default 0x20000

config ENV_SECT_SIZE
	default 0x10000

endif # ENV_IS_IN_SPI_FLASH
```

## release/src-rt-5.04behnd.4916/bootloaders/u-boot-2024.04/arch/riscv/cpu/generic/Kconfig
```kconfig
# SPDX-License-Identifier: GPL-2.0+
#
# Copyright (C) 2018, Bin Meng <bmeng.cn@gmail.com>

config GENERIC_RISCV
	bool
	select BINMAN if SPL
	select ARCH_EARLY_INIT_R
	select SYS_CACHE_SHIFT_6
	imply CPU
	imply CPU_RISCV
	imply RISCV_TIMER if (RISCV_SMODE || SPL_RISCV_SMODE)
	imply RISCV_ACLINT if RISCV_MMODE
	imply SPL_RISCV_ACLINT if SPL_RISCV_MMODE
	imply CMD_CPU
	imply SPL_CPU
	imply SPL_OPENSBI
	imply SPL_LOAD_FIT
```

## release/src-rt-5.04behnd.4916/bootloaders/u-boot-2024.04/arch/riscv/cpu/jh7110/Kconfig
```kconfig
# SPDX-License-Identifier: GPL-2.0+
#
# Copyright (C) 2022 StarFive Technology Co., Ltd.

config STARFIVE_JH7110
	bool
	select ARCH_EARLY_INIT_R
	select CLK_JH7110
	select CPU
	select CPU_RISCV
	select RAM
	select RESET_JH7110
	select SUPPORT_SPL
	select SPL_RAM if SPL
	select SPL_STARFIVE_DDR
	select SYS_CACHE_SHIFT_6
	select SPL_ZERO_MEM_BEFORE_USE
	select PINCTRL_STARFIVE_JH7110
	imply MMC
	imply MMC_BROKEN_CD
	imply MMC_SPI
	imply RISCV_TIMER if (RISCV_SMODE || SPL_RISCV_SMODE)
	imply SIFIVE_CACHE
	imply SIFIVE_CCACHE
	imply SMP
	imply SPI
	imply SPL_CPU
	imply SPL_LOAD_FIT
	imply SPL_OPENSBI
	imply SPL_RISCV_ACLINT
	imply SPL_SYS_MALLOC_CLEAR_ON_INIT
```

## release/src-rt-5.04behnd.4916/bootloaders/u-boot-2024.04/arch/sandbox/Kconfig
```kconfig
menu "Sandbox architecture"
	depends on SANDBOX

config SYS_ARCH
	default "sandbox"

config SYS_BOARD
	default "sandbox"

config SYS_CPU
	default "sandbox"

config SANDBOX64
	bool "Use 64-bit addresses"
	select PHYS_64BIT
	depends on HOST_64BIT

config SANDBOX_RAM_SIZE_MB
	int "RAM size in MiB"
	default 256
	range 64 4095 if !SANDBOX64
	range 64 268435456 if SANDBOX64
	help
	  Memory size of the sandbox in MiB. The default value is 256 MiB.
	  The minimum value is 64 MiB. The maximum value is 4095 MiB for the
	  32bit sandbox.

config SANDBOX_SPL
	bool "Enable SPL for sandbox"
	select SUPPORT_SPL

config SANDBOX_TPL
	bool "Enable TPL for sandbox"
	select SUPPORT_TPL

config SANDBOX_VPL
	bool "Enable VPL for sandbox"
	select SUPPORT_VPL

config SYS_CONFIG_NAME
	default "sandbox_spl" if SANDBOX_SPL
	default "sandbox" if !SANDBOX_SPL

config HOST_32BIT
	def_bool ! $(cc-define,_LP64)

config HOST_64BIT
	def_bool $(cc-define,_LP64)

config HOST_HAS_SDL
	def_bool $(success,sdl2-config --version)

config SANDBOX_SDL
	bool "Enable SDL2 support in sandbox"
	default HOST_HAS_SDL

config SANDBOX_CRASH_RESET
	bool "Reset on crash"
	help
	  If an illegal instruction or an illegal memory access occurs, the
	  sandbox by default writes a crash dump and exits. If you set this
	  flag, the sandbox is reset instead. This may be useful when running
	  test suites like the UEFI self certification test which continue
	  with the next test after a crash.

config SANDBOX_BITS_PER_LONG
	int
	default 32 if HOST_32BIT
	default 64 if HOST_64BIT

config SYS_FDT_LOAD_ADDR
	hex "Address at which to load devicetree"
	default 0x100
	help
	  With sandbox the devicetree is loaded into the emulated RAM. This sets
	  the address that is used. There must be enough space at this address
	  to load the full devicetree without it overwriting anything else.

	  See `doc/arch/sandbox.rst` for more information.

endmenu

config FWU_NUM_BANKS
	default 2

config FWU_NUM_IMAGES_PER_BANK
	default 2
```

## release/src-rt-5.04behnd.4916/bootloaders/u-boot-2024.04/arch/sh/Kconfig
```kconfig
menu "SuperH architecture"
	depends on SH

config CPU_SH4
	bool

config CPU_SH7751
	bool
	select CPU_SH4

choice
	prompt "Target select"
	optional

config TARGET_R2DPLUS
	bool "Renesas R2D-PLUS"
	select CPU_SH7751

endchoice

config SYS_ARCH
	default "sh"

config SYS_CPU
	default "sh4" if CPU_SH4

source "arch/sh/lib/Kconfig"

source "board/renesas/r2dplus/Kconfig"

endmenu
```

## release/src-rt-5.04behnd.4916/bootloaders/u-boot-2024.04/arch/sh/lib/Kconfig
```kconfig
config CMD_SH_ZIMAGEBOOT
	bool "zimageboot - Boot a zImage on SH"
	default y
	help
	  This is special SH-specific command to boot a zImage (compressed
	  Linux image) on SH-architecture boards.
```
