// SPDX-License-Identifier: GPL-2.0+ OR X11
/*
 * e500v2 Power ISA Device Tree Source (include)
 *
 * Copyright 2012 Freescale Semiconductor Inc.
 * Copyright 2019 NXP
 */

/ {
	cpus {
		power-isa-version = "2.03";
		power-isa-b;		// Base
		power-isa-e;		// Embedded
		power-isa-atb;		// Alternate Time Base
		power-isa-cs;		// Cache Specification
		power-isa-e.le;		// Embedded.Little-Endian
		power-isa-e.pm;		// Embedded.Performance Monitor
		power-isa-ecl;		// Embedded Cache Locking
		power-isa-mmc;		// Memory Coherence
		power-isa-sp;		// Signal Processing Engine
		power-isa-sp.fd;	// SPE.Embedded Float Scalar Double
		power-isa-sp.fs;	// SPE.Embedded Float Scalar Single
		power-isa-sp.fv;	// SPE.Embedded Float Vector
		mmu-type = "power-embedded";
	};
};
