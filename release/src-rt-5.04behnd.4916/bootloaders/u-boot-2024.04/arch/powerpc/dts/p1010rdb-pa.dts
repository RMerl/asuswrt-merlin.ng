// SPDX-License-Identifier: GPL-2.0+ OR X11
/*
 * P1010 RDB Device Tree Source
 *
 * Copyright 2020 NXP
 */

/include/ "p1010si-pre.dtsi"

/ {
	model = "fsl,P1010RDB";
	compatible = "fsl,P1010RDB";

	/include/ "p1010rdb_32b.dtsi"
};

/include/ "p1010si-post.dtsi"
/include/ "p1010rdb.dtsi"
