// SPDX-License-Identifier: GPL-2.0+ OR X11
/*
 * P1010RDB Device Tree Source
 *
 * Copyright 2020 NXP
 */

soc: soc@ffe00000 {
	ranges = <0x0 0x0 0xffe00000 0x100000>;
};

pci1: pcie@ffe09000 {
	reg = <0 0xffe09000 0 0x1000>;
	ranges = <0x2000000 0x0 0xa0000000 0 0xa0000000 0x0 0x20000000
		  0x1000000 0x0 0x00000000 0 0xffc10000 0x0 0x10000>;
};

pci0: pcie@ffe0a000 {
	reg = <0 0xffe0a000 0 0x1000>;
	ranges = <0x2000000 0x0 0x80000000 0 0x80000000 0x0 0x20000000
		  0x1000000 0x0 0x00000000 0 0xffc00000 0x0 0x10000>;
};
