// SPDX-License-Identifier: GPL-2.0+ OR X11
/*
 * P1010RDB Device Tree Source (36-bit address map)
 *
 * Copyright 2020 NXP
 */

soc: soc@fffe00000 {
	ranges = <0x0 0xf 0xffe00000 0x100000>;
};

pci1: pcie@fffe09000 {
	reg = <0xf 0xffe09000 0 0x1000>;
	ranges = <0x2000000 0x0 0xc0000000 0xc 0x20000000 0x0 0x20000000
		  0x1000000 0x0 0x00000000 0xf 0xffc10000 0x0 0x10000>;
};

pci0: pcie@fffe0a000 {
	reg = <0xf 0xffe0a000 0 0x1000>;
	ranges = <0x2000000 0x0 0xc0000000 0xc 0x20000000 0x0 0x20000000
		  0x1000000 0x0 0x00000000 0xf 0xffc10000 0x0 0x10000>;
};
