// SPDX-License-Identifier: GPL-2.0+ OR X11
/*
 * P1010 Silicon/SoC Device Tree Source (pre include)
 *
 * Copyright 2020 NXP
 */

/dts-v1/;

/include/ "e500v2_power_isa.dtsi"

/ {
	compatible = "fsl,P1010";
	#address-cells = <2>;
	#size-cells = <2>;
	interrupt-parent = <&mpic>;

	cpus {
		#address-cells = <1>;
		#size-cells = <0>;

		PowerPC,P1010@0 {
			device_type = "cpu";
			reg = <0x0>;
		};
	};
};
