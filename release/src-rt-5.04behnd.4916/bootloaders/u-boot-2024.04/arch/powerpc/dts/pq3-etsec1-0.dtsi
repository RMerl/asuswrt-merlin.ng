// SPDX-License-Identifier: GPL-2.0+ OR X11
/*
 * PQ3 eTSEC device tree stub [ @ offsets 0x24000 ]
 *
 * Copyright 2011-2012 Freescale Semiconductor Inc.
 * Copyright 2020 NXP
 */

ethernet@24000 {
	#address-cells = <1>;
	#size-cells = <1>;
	cell-index = <0>;
	device_type = "network";
	model = "eTSEC";
	compatible = "gianfar";
	reg = <0x24000 0x1000>;
	ranges = <0x0 0x24000 0x1000>;
	fsl,magic-packet;
	local-mac-address = [ 00 00 00 00 00 00 ];
	interrupts = <29 2 0 0 30 2 0 0 34 2 0 0>;
};

mdio@24520 {
	#address-cells = <1>;
	#size-cells = <0>;
	compatible = "fsl,gianfar-mdio";
	reg = <0x24520 0x20>;
};
