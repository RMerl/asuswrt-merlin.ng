// SPDX-License-Identifier: GPL-2.0+ OR X11
/*
 * PQ3 eTSEC device tree stub [ @ offsets 0x26000 ]
 *
 * Copyright 2011-2012 Freescale Semiconductor Inc.
 * Copyright 2020 NXP
 */

ethernet@26000 {
	#address-cells = <1>;
	#size-cells = <1>;
	cell-index = <2>;
	device_type = "network";
	model = "eTSEC";
	compatible = "gianfar";
	reg = <0x26000 0x1000>;
	ranges = <0x0 0x26000 0x1000>;
	fsl,magic-packet;
	local-mac-address = [ 00 00 00 00 00 00 ];
	interrupts = <31 2 0 0 32 2 0 0 33 2 0 0>;
};

mdio@26520 {
	#address-cells = <1>;
	#size-cells = <0>;
	compatible = "fsl,gianfar-tbi";
	reg = <0x26520 0x20>;
};
