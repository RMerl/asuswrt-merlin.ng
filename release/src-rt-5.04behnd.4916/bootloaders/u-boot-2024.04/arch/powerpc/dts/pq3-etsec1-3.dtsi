// SPDX-License-Identifier: GPL-2.0+ OR X11
/*
 * PQ3 eTSEC device tree stub [ @ offsets 0x27000 ]
 *
 * Copyright 2011-2012 Freescale Semiconductor Inc.
 * Copyright 2020 NXP
 */

ethernet@27000 {
	#address-cells = <1>;
	#size-cells = <1>;
	cell-index = <3>;
	device_type = "network";
	model = "eTSEC";
	compatible = "gianfar";
	reg = <0x27000 0x1000>;
	ranges = <0x0 0x27000 0x1000>;
	fsl,magic-packet;
	local-mac-address = [ 00 00 00 00 00 00 ];
	interrupts = <37 2 0 0 38 2 0 0 39 2 0 0>;
};

mdio@27520 {
	#address-cells = <1>;
	#size-cells = <0>;
	compatible = "fsl,gianfar-tbi";
	reg = <0x27520 0x20>;
};
