// SPDX-License-Identifier: GPL-2.0+ OR X11
/*
 * PQ3 eTSEC2 device tree stub [ @ offsets 0x24000/0xb0000 ]
 *
 * Copyright 2011 Freescale Semiconductor Inc.
 * Copyright 2020 NXP
 */

mdio@24000 {
	#address-cells = <1>;
	#size-cells = <0>;
	compatible = "fsl,etsec2-mdio";
	reg = <0x24000 0x1000 0xb0030 0x4>;
};

ethernet@b0000 {
	#address-cells = <1>;
	#size-cells = <1>;
	device_type = "network";
	model = "eTSEC";
	compatible = "fsl,etsec2";
	reg = <0xb0000 0x1000>;
	fsl,num_rx_queues = <0x8>;
	fsl,num_tx_queues = <0x8>;
	fsl,magic-packet;
	local-mac-address = [ 00 00 00 00 00 00 ];
	ranges;

	queue-group@b0000 {
		#address-cells = <1>;
		#size-cells = <1>;
		reg = <0xb0000 0x1000>;
		interrupts = <29 2 0 0 30 2 0 0 34 2 0 0>;
	};
};
