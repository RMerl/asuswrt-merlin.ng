// SPDX-License-Identifier: GPL-2.0+ OR X11
/*
 * PQ3 eTSEC2 Group 2 device tree stub [ @ offsets 0xb6000 ]
 *
 * Copyright 2011 Freescale Semiconductor Inc.
 * Copyright 2020 NXP
 */

&enet2_grp2 {
	queue-group@b6000 {
		#address-cells = <1>;
		#size-cells = <1>;
		reg = <0xb6000 0x1000>;
		interrupts = <25 2 0 0 26 2 0 0 27 2 0 0>;
	};
};
