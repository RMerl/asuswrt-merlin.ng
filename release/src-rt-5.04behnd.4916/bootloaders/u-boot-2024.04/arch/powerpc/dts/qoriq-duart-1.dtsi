// SPDX-License-Identifier: GPL-2.0-or-later
/*
 * QorIQ DUART device tree stub [ controller @ offset 0x11d000 ]
 *
 * Copyright 2011 Freescale Semiconductor Inc.
 */

serial2: serial@11d500 {
	cell-index = <2>;
	device_type = "serial";
	compatible = "fsl,ns16550", "ns16550";
	reg = <0x11d500 0x100>;
	clock-frequency = <0>;
	interrupts = <37 2 0 0>;
};

serial3: serial@11d600 {
	cell-index = <3>;
	device_type = "serial";
	compatible = "fsl,ns16550", "ns16550";
	reg = <0x11d600 0x100>;
	clock-frequency = <0>;
	interrupts = <37 2 0 0>;
};
