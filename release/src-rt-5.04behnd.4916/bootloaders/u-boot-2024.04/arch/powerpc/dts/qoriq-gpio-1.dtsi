// SPDX-License-Identifier: (GPL-2.0+ OR BSD-3-Clause)
/*
 * QorIQ GPIO device tree stub [ controller @ offset 0x131000 ]
 *
 * Copyright 2013 Freescale Semiconductor Inc.
 * Copyright 2020 NXP
 *
 */

gpio1: gpio@131000 {
	compatible = "fsl,qoriq-gpio";
	reg = <0x131000 0x1000>;
	interrupts = <54 2 0 0>;
	#gpio-cells = <2>;
	gpio-controller;
};
