// SPDX-License-Identifier: (GPL-2.0+ OR BSD-3-Clause)
/*
 * QorIQ GPIO device tree stub [ controller @ offset 0x133000 ]
 *
 * Copyright 2013 Freescale Semiconductor Inc.
 * Copyright 2020 NXP
 *
 */

gpio3: gpio@133000 {
	compatible = "fsl,qoriq-gpio";
	reg = <0x133000 0x1000>;
	interrupts = <87 2 0 0>;
	#gpio-cells = <2>;
	gpio-controller;
};
