// SPDX-License-Identifier: GPL-2.0+ OR X11
/*
 * QorIQ I2C Device Tree stub
 *
 * Copyright 2020 NXP
 */
i2c0: i2c@118000 {
	#address-cells = <1>;
	#size-cells = <0>;
	cell-index = <0>;
	compatible = "fsl-i2c";
	bootph-all;
	reg = <0x118000 0x100>;
	interrupts = <38 2 0 0>;
};

i2c1: i2c@118100 {
	#address-cells = <1>;
	#size-cells = <0>;
	cell-index = <1>;
	compatible = "fsl-i2c";
	bootph-all;
	reg = <0x118100 0x100>;
	interrupts = <38 2 0 0>;
};
