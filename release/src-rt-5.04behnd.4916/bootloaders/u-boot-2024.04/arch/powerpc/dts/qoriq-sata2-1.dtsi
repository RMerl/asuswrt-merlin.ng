// SPDX-License-Identifier: GPL-2.0-or-later
/*
 * QorIQ SATAv2 device tree stub [ controller @ offset 0x221000 ]
 *
 * Copyright 2011 Freescale Semiconductor Inc.
 */

sata@221000 {
	compatible = "fsl,pq-sata-v2";
	reg = <0x221000 0x1000>;
	interrupts = <69 0x2 0 0>;
};
