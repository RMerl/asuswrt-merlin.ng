## release/src-rt-5.04behnd.4916/bootloaders/u-boot-2024.04/arch/x86/cpu/apollolake/Kconfig
```kconfig
# SPDX-License-Identifier: GPL-2.0
#
# Copyright 2019 Google LLC
#

config INTEL_APOLLOLAKE
	bool
	select FSP_VERSION2
	select HAVE_FSP
	select ARCH_MISC_INIT
	select USE_CAR
	select INTEL_SOC
	select INTEL_PMC
	select TPL_X86_TSC_TIMER_NATIVE
	select SPL_PCH
	select TPL_PCH
	select PCIEX_LENGTH_256MB
	select PCH
	select P2SB
	select SMP_AP_WORK
	select INTEL_GMA_SWSMISCI
	select ACPI_GNVS_EXTERNAL
	select TPL_OF_PLATDATA_PARENT
	select TPL_OF_PLATDATA_INST
	select TPL_READ_ONLY
	imply ENABLE_MRC_CACHE
	imply AHCI_PCI
	imply SCSI
	imply SCSI_AHCI
	imply SPI_FLASH
	imply USB
	imply USB_EHCI_HCD
	imply TPL
	imply SPL
	imply TPL_X86_16BIT_INIT
	imply TPL_OF_PLATDATA
	imply ACPI_PMC
	imply MMC
	imply DM_MMC
	imply MMC_PCI
	imply MMC_SDHCI
	imply CMD_MMC
	imply VIDEO_FSP
	imply PINCTRL_INTEL
	imply PINCTRL_INTEL_APL
	imply HAVE_VBT
	imply HAVE_X86_FIT
	imply INTEL_GPIO
	imply SMP
	imply HAVE_ITSS
	imply HAVE_P2SB
	imply CLK
	imply CMD_CLK
	imply CLK_INTEL
	imply ACPI_GPE
	imply INTEL_GMA_ACPI

if INTEL_APOLLOLAKE

config DCACHE_RAM_BASE
	default 0xfef00000

config DCACHE_RAM_SIZE
	default 0xc0000

config DCACHE_RAM_MRC_VAR_SIZE
	default 0xb0000

config CPU_SPECIFIC_OPTIONS
	def_bool y
	select SMM_TSEG
	select X86_RAMTEST

config SMM_TSEG_SIZE
	hex
	default 0x800000

config MMCONF_BASE_ADDRESS
	hex
	default 0xe0000000

config TPL_SIZE_LIMIT
	default 0x7800

config CPU_ADDR_BITS
	default 39

config APL_SPI_FLASH_BOOT
	bool "Support booting with SPI-flash driver instead memory-mapped SPI"
	select TPL_SPI_FLASH_SUPPORT
	select TPL_SPI
	select TPL_DM_SPI
	select TPL_DM_SPI_FLASH
	help
	  This enables SPI and SPI flash in TPL. Without the this only
	  available boot method is to use memory-mapped SPI. Since this is
	  actually fast and produces a TPL which is 7KB smaller, memory-mapped
	  SPI is the default.

config APL_BOOT_FROM_FAST_SPI_FLASH
	bool "Boot using SPI flash driver"
	select APL_SPI_FLASH_BOOT
	help
	  This option is separate from APL_SPI_FLASH_BOOT since it is useful to
	  be able to compare booting speed with the same build. Enable this to
	  use the SPI-flash driver to load SPL, U-Boot and FSP-M. For technical
	  reasons FSP-S is currently always loaded from memory-mapped SPI. See
	  Apollo Lake's arch_fsp_init_r() for details about that.

config VBT_ADDR
	default 0xff3f1000

endif
```

## release/src-rt-5.04behnd.4916/bootloaders/u-boot-2024.04/arch/x86/cpu/braswell/Kconfig
```kconfig
# SPDX-License-Identifier: GPL-2.0+
#
# Copyright (C) 2017, Bin Meng <bmeng.cn@gmail.com>

config INTEL_BRASWELL
	bool
	select HAVE_FSP
	select ARCH_MISC_INIT
	select CPU_INTEL_TURBO_NOT_PACKAGE_SCOPED
	imply HAVE_INTEL_ME
	imply HAVE_VBT
	imply ENABLE_MRC_CACHE
	imply AHCI_PCI
	imply ICH_SPI
	imply MMC
	imply MMC_PCI
	imply MMC_SDHCI
	imply MMC_SDHCI_SDMA
	imply SCSI
	imply SCSI_AHCI
	imply SPI_FLASH
	imply SYS_NS16550
	imply USB
	imply USB_XHCI_HCD
	imply VIDEO_FSP

if INTEL_BRASWELL

config FSP_ADDR
	hex
	default 0xfff20000

endif
```

## release/src-rt-5.04behnd.4916/bootloaders/u-boot-2024.04/arch/x86/cpu/slimbootloader/Kconfig
```kconfig
# SPDX-License-Identifier: GPL-2.0+
#
# Copyright (C) 2019 Intel Corporation <www.intel.com>

config SYS_SLIMBOOTLOADER
	bool
	select USE_HOB
	imply SYS_NS16550
	imply AHCI_PCI
	imply SCSI
	imply SCSI_AHCI
	imply MMC
	imply MMC_PCI
	imply MMC_SDHCI
	imply MMC_SDHCI_SDMA
	imply USB
	imply USB_EHCI_HCD
	imply USB_XHCI_HCD
	imply E1000
	imply X86_TSC_READ_BASE
```

## release/src-rt-5.04behnd.4916/bootloaders/u-boot-2024.04/arch/xtensa/Kconfig
```kconfig
menu "Xtensa architecture"
	depends on XTENSA

config SYS_ARCH
	string
	default "xtensa"

config SYS_CPU
	string "Xtensa Core Variant"

choice
	prompt "Target select"

config TARGET_XTFPGA
	bool "Support XTFPGA"
	select BOARD_POSTCLK_INIT

endchoice

config SYS_ICACHE_OFF
	bool "Do not enable icache"
	help
	  Do not enable instruction cache in U-Boot.

config SPL_SYS_ICACHE_OFF
	bool "Do not enable icache in SPL"
	depends on SPL
	default SYS_ICACHE_OFF
	help
	  Do not enable instruction cache in SPL.

config SYS_DCACHE_OFF
	bool "Do not enable dcache"
	help
	  Do not enable data cache in U-Boot.

config SPL_SYS_DCACHE_OFF
	bool "Do not enable dcache in SPL"
	depends on SPL
	default SYS_DCACHE_OFF
	help
	  Do not enable data cache in SPL.

source "board/cadence/xtfpga/Kconfig"

endmenu
```

## release/src-rt-5.04behnd.4916/bootloaders/u-boot-2024.04/board/AndesTech/ae350/Kconfig
```kconfig
if TARGET_ANDES_AE350

config SYS_CPU
	default "andesv5"

config SYS_BOARD
	default "ae350"

config SYS_VENDOR
	default "AndesTech"

config SYS_SOC
	default "ae350"

config SYS_CONFIG_NAME
	default "ae350"

config ENV_SIZE
	default 0x2000 if ENV_IS_IN_SPI_FLASH

config ENV_OFFSET
	default 0x140000 if ENV_IS_IN_SPI_FLASH

config SPL_TEXT_BASE
	default 0x800000

config SPL_OPENSBI_LOAD_ADDR
	default 0x00000000

config SYS_FDT_BASE
	hex
	default 0x800f0000 if OF_SEPARATE

config BOARD_SPECIFIC_OPTIONS # dummy
	def_bool y
	select RISCV_NDS
	select SUPPORT_SPL
	select BINMAN if SPL
	imply SMP
	imply SPL_RAM_SUPPORT
	imply SPL_RAM_DEVICE
	imply OF_HAS_PRIOR_STAGE

endif
```

## release/src-rt-5.04behnd.4916/bootloaders/u-boot-2024.04/board/BuR/brppt2/Kconfig
```kconfig
if TARGET_BRPPT2

config SYS_BOARD
	default "brppt2"

config SYS_VENDOR
	default "BuR"

config SYS_SOC
	default "mx6"

config SYS_CONFIG_NAME
	default "brppt2"

config SPL_DM_SPI
	def_bool y

endif
```

## release/src-rt-5.04behnd.4916/bootloaders/u-boot-2024.04/board/BuR/brsmarc1/Kconfig
```kconfig
if TARGET_BRSMARC1

config SYS_BOARD
	default "brsmarc1"

config SYS_VENDOR
	default "BuR"

config SYS_SOC
	default "am33xx"

config SYS_CONFIG_NAME
	default "brsmarc1"

endif
```

## release/src-rt-5.04behnd.4916/bootloaders/u-boot-2024.04/board/BuR/brxre1/Kconfig
```kconfig
if TARGET_BRXRE1

config SYS_BOARD
	default "brxre1"

config SYS_VENDOR
	default "BuR"

config SYS_SOC
	default "am33xx"

config SYS_CONFIG_NAME
	default "brxre1"

endif
```

## release/src-rt-5.04behnd.4916/bootloaders/u-boot-2024.04/board/LaCie/net2big_v2/Kconfig
```kconfig
if TARGET_NET2BIG_V2

choice
	prompt "Board variant"

config D2NET_V2
	bool "D2NET v2"

config NET2BIG_V2
	bool "NET2BIG v2"

endchoice

config SYS_BOARD
	default "net2big_v2"

config SYS_VENDOR
	default "LaCie"

config SYS_CONFIG_NAME
	default "lacie_kw"

endif
```

## release/src-rt-5.04behnd.4916/bootloaders/u-boot-2024.04/board/LaCie/netspace_v2/Kconfig
```kconfig
if TARGET_NETSPACE_V2

choice
	prompt "Board variant"

config INETSPACE_V2
	bool "INETSPACE v2"
	select KW88F6281

config NETSPACE_LITE_V2
	bool "NETSPACE LITE v2"
	select KW88F6192

config NETSPACE_MAX_V2
	bool "NETSPACE MAX v2"
	select KW88F6281

config NETSPACE_MINI_V2
	bool "NETSPACE MINI v2"
	select KW88F6192

config NETSPACE_V2
	bool "NETSPACE v2"
	select KW88F6281

endchoice

config SYS_BOARD
	default "netspace_v2"

config SYS_VENDOR
	default "LaCie"

config SYS_CONFIG_NAME
	default "lacie_kw"

endif
```

## release/src-rt-5.04behnd.4916/bootloaders/u-boot-2024.04/board/Marvell/dreamplug/Kconfig
```kconfig
if TARGET_DREAMPLUG

config SYS_BOARD
	default "dreamplug"

config SYS_VENDOR
	default "Marvell"

config SYS_CONFIG_NAME
	default "dreamplug"

endif
```

## release/src-rt-5.04behnd.4916/bootloaders/u-boot-2024.04/board/Marvell/octeon_ebb7304/Kconfig
```kconfig
if TARGET_OCTEON_EBB7304

config SYS_BOARD
	string
	default "octeon_ebb7304"

config SYS_VENDOR
	string
	default "Marvell"

config SYS_CONFIG_NAME
	string
	default "octeon_ebb7304"

config DEFAULT_DEVICE_TREE
	string
	default "mrvl,octeon-ebb7304"

endif
```

## release/src-rt-5.04behnd.4916/bootloaders/u-boot-2024.04/board/Marvell/octeon_nic23/Kconfig
```kconfig
if TARGET_OCTEON_NIC23

config SYS_BOARD
	string
	default "octeon_nic23"

config SYS_VENDOR
	string
	default "Marvell"

config SYS_CONFIG_NAME
	string
	default "octeon_nic23"

config DEFAULT_DEVICE_TREE
	string
	default "mrvl,octeon-nic23"

endif
```

## release/src-rt-5.04behnd.4916/bootloaders/u-boot-2024.04/board/Marvell/octeontx/Kconfig
```kconfig
if TARGET_OCTEONTX_81XX || TARGET_OCTEONTX_83XX

config SYS_VENDOR
	string
	default	"Marvell"

config SYS_BOARD
	string
	default "octeontx"

config SYS_CONFIG_NAME
	default "octeontx_common"

endif
```

## release/src-rt-5.04behnd.4916/bootloaders/u-boot-2024.04/board/Marvell/octeontx2/Kconfig
```kconfig
if TARGET_OCTEONTX2_95XX || TARGET_OCTEONTX2_96XX

config SYS_VENDOR
	string
	default	"Marvell"

config SYS_BOARD
	string
	default "octeontx2"

config SYS_CONFIG_NAME
	default "octeontx2_common"

endif
```

## release/src-rt-5.04behnd.4916/bootloaders/u-boot-2024.04/board/Marvell/openrd/Kconfig
```kconfig
if TARGET_OPENRD

choice
	prompt "Board variant"

config BOARD_IS_OPENRD_BASE
	bool "Base"

config BOARD_IS_OPENRD_CLIENT
	bool "Client"

config BOARD_IS_OPENRD_ULTIMATE
	bool "Ultimate"

endchoice

config SYS_BOARD
	default "openrd"

config SYS_VENDOR
	default "Marvell"

config SYS_CONFIG_NAME
	default "openrd"

endif
```

## release/src-rt-5.04behnd.4916/bootloaders/u-boot-2024.04/board/Seagate/goflexhome/Kconfig
```kconfig
if TARGET_GOFLEXHOME

config SYS_BOARD
	default "goflexhome"

config SYS_VENDOR
	default "Seagate"

config SYS_CONFIG_NAME
	default "goflexhome"

endif
```

## release/src-rt-5.04behnd.4916/bootloaders/u-boot-2024.04/board/Seagate/nas220/Kconfig
```kconfig
if TARGET_NAS220

config SYS_BOARD
	default "nas220"

config SYS_VENDOR
	default "Seagate"

config SYS_CONFIG_NAME
	default "nas220"

endif
```

## release/src-rt-5.04behnd.4916/bootloaders/u-boot-2024.04/board/Synology/ds109/Kconfig
```kconfig
if TARGET_DS109

config SYS_BOARD
	default "ds109"

config SYS_VENDOR
	default "Synology"

config SYS_CONFIG_NAME
	default "ds109"

endif
```

## release/src-rt-5.04behnd.4916/bootloaders/u-boot-2024.04/board/Synology/ds414/Kconfig
```kconfig
if TARGET_DS414

config SYS_BOARD
	default "ds414"

config SYS_VENDOR
	default "Synology"

config SYS_CONFIG_NAME
	default "ds414"

endif
```

## release/src-rt-5.04behnd.4916/bootloaders/u-boot-2024.04/board/advantech/imx8mp_rsb3720a1/Kconfig
```kconfig
if TARGET_IMX8MP_RSB3720A1_4G || TARGET_IMX8MP_RSB3720A1_6G

config SYS_BOARD
	default "imx8mp_rsb3720a1"

config SYS_VENDOR
	default "advantech"

config SYS_CONFIG_NAME
	default "imx8mp_rsb3720"

endif
```

## release/src-rt-5.04behnd.4916/bootloaders/u-boot-2024.04/board/advantech/imx8qm_dmsse20_a1/Kconfig
```kconfig
if TARGET_IMX8QM_DMSSE20_A1

config SYS_BOARD
	default "imx8qm_dmsse20_a1"

config SYS_VENDOR
	default "advantech"

config SYS_CONFIG_NAME
	default "imx8qm_dmsse20"

config IMX_CONFIG
	default "board/advantech/imx8qm_dmsse20_a1/imximage.cfg"

endif
```

## release/src-rt-5.04behnd.4916/bootloaders/u-boot-2024.04/board/advantech/imx8qm_rom7720_a1/Kconfig
```kconfig
if TARGET_IMX8QM_ROM7720_A1

config SYS_BOARD
	default "imx8qm_rom7720_a1"

config SYS_VENDOR
	default "advantech"

config SYS_CONFIG_NAME
	default "imx8qm_rom7720"

config IMX_CONFIG
	default "board/advantech/imx8qm_rom7720_a1/imximage.cfg"

endif
```

## release/src-rt-5.04behnd.4916/bootloaders/u-boot-2024.04/board/advantech/som-db5800-som-6867/Kconfig
```kconfig
if TARGET_SOM_DB5800_SOM_6867

config SYS_BOARD
	default "som-db5800-som-6867"

config SYS_VENDOR
	default "advantech"

config SYS_SOC
	default "baytrail"

config SYS_CONFIG_NAME
	default "som-db5800-som-6867"

config TEXT_BASE
	default 0xfff00000

config BOARD_SPECIFIC_OPTIONS # dummy
	def_bool y
	select X86_RESET_VECTOR
	select INTEL_BAYTRAIL
	select BOARD_ROMSIZE_KB_8192
	select BOARD_EARLY_INIT_F
	select SPI_FLASH_MACRONIX

config PCIE_ECAM_BASE
	default 0xe0000000

endif
```

## release/src-rt-5.04behnd.4916/bootloaders/u-boot-2024.04/board/altera/arria10-socdk/fit_spl_fpga.its
```
// SPDX-License-Identifier: GPL-2.0
 /*
 * Copyright (C) 2019 Intel Corporation <www.intel.com>
 *
 */

/dts-v1/;

/ {
	description = "FIT image with FPGA bistream";
	#address-cells = <1>;

	images {
		fpga-periph-1 {
			description = "FPGA peripheral bitstream";
			data = /incbin/("../../../ghrd_10as066n2.periph.rbf");
			type = "fpga";
			arch = "arm";
			compression = "none";
		};

		fpga-core-1 {
			description = "FPGA core bitstream";
			data = /incbin/("../../../ghrd_10as066n2.core.rbf");
			type = "fpga";
			arch = "arm";
			compression = "none";
		};
	};

	configurations {
		default = "config-1";
		config-1 {
			description = "Boot with FPGA early IO release config";
			fpga = "fpga-periph-1", "fpga-core-1";
		};
	};
};
```
