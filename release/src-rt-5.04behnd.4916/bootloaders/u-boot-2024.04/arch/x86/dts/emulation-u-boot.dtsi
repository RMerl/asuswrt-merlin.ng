// SPDX-License-Identifier: GPL-2.0+
/*
 * Copyright (C) 2016 Google, Inc
 * Written by Simon Glass <sjg@chromium.org>
 */

#include <u-boot.dtsi>

#ifdef CONFIG_ROM_SIZE
&rom {
#ifdef CONFIG_SPL
	u-boot-spl-with-ucode-ptr {
		optional-ucode;
	};
#else
	u-boot-with-ucode-ptr {
		optional-ucode;
	};
#endif
};
#endif
