// SPDX-License-Identifier: GPL-2.0+
/*
 * Copyright (C) 2014, Bin Meng <bmeng.cn@gmail.com>
 * Copyright (C) 2016 Stefan Roese <sr@denx.de>
 */

/dts-v1/;

#include "dfi-bt700.dtsi"

/ {
	model = "theadorable-x86-DFI-BT700";
	compatible = "anonymous,theadorable-x86-dfi-bt700", "dfi,bt700",
			"intel,baytrail";

	aliases {
		serial0 = &pciuart0;
		spi0 = &spi;
	};
};
