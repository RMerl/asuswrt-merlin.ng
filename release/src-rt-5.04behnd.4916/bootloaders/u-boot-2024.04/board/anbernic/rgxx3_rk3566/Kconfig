## release/src-rt-5.04behnd.4916/bootloaders/u-boot-2024.04/board/anbernic/rgxx3_rk3566/Kconfig
```kconfig
if TARGET_ANBERNIC_RGXX3_RK3566

config SYS_BOARD
	default "rgxx3_rk3566"

config SYS_VENDOR
	default "anbernic"

config SYS_CONFIG_NAME
	default "anbernic-rgxx3-rk3566"

config BOARD_SPECIFIC_OPTIONS
	def_bool y

endif
```

## release/src-rt-5.04behnd.4916/bootloaders/u-boot-2024.04/board/aristainetos/Kconfig
```kconfig
if TARGET_ARISTAINETOS2C

source "board/aristainetos/common/Kconfig"

config SYS_BOARD
	default "aristainetos"

config SYS_BOARD_VERSION
	default 5

config IMX_CONFIG
	default "board/aristainetos/aristainetos2.cfg"

endif

if TARGET_ARISTAINETOS2CCSLB

source "board/aristainetos/common/Kconfig"

config SYS_BOARD
	default "aristainetos"

config SYS_BOARD_VERSION
	default 6

config IMX_CONFIG
	default "board/aristainetos/aristainetos2.cfg"

endif
```

## release/src-rt-5.04behnd.4916/bootloaders/u-boot-2024.04/board/aristainetos/common/Kconfig
```kconfig
config SYS_BOARD_VERSION
	int "select version of aristainetos board"
	help
	  version of aristainetos board version
	  5 version 2c and 2d
	  6 version 2c-cslb

config SYS_I2C_MXC_I2C1
	default y

config SYS_I2C_MXC_I2C2
	default y

config SYS_I2C_MXC_I2C3
	default y

config SYS_I2C_MXC_I2C4
	default y

config SYS_MALLOC_LEN
	default 0x4000000

config ENV_SIZE
	default 0x3000

config ENV_SECT_SIZE
	default 0x10000

config ENV_OFFSET
	default 0xd0000

config SYS_CONFIG_NAME
	default "aristainetos2"
```

## release/src-rt-5.04behnd.4916/bootloaders/u-boot-2024.04/board/armadeus/opos6uldev/Kconfig
```kconfig
if TARGET_OPOS6ULDEV

config SYS_BOARD
	default "opos6uldev"

config SYS_VENDOR
	default "armadeus"

config SYS_CONFIG_NAME
	default "opos6uldev"

endif
```

## release/src-rt-5.04behnd.4916/bootloaders/u-boot-2024.04/board/armltd/corstone1000/Kconfig
```kconfig
if TARGET_CORSTONE1000

config SYS_BOARD
	default "corstone1000"

config SYS_VENDOR
	default "armltd"

config SYS_CONFIG_NAME
	default "corstone1000"

endif
```

## release/src-rt-5.04behnd.4916/bootloaders/u-boot-2024.04/board/armltd/total_compute/Kconfig
```kconfig
if TARGET_TOTAL_COMPUTE

config SYS_BOARD
	default "total_compute"

config SYS_VENDOR
	default "armltd"

config SYS_CONFIG_NAME
	default "total_compute"

endif
```

## release/src-rt-5.04behnd.4916/bootloaders/u-boot-2024.04/board/armltd/vexpress/Kconfig
```kconfig
if TARGET_VEXPRESS_CA9X4

config SYS_BOARD
	default "vexpress"

config SYS_VENDOR
	default "armltd"

config SYS_CONFIG_NAME
	default "vexpress_ca9x4"

endif
```

## release/src-rt-5.04behnd.4916/bootloaders/u-boot-2024.04/board/armltd/vexpress64/Kconfig
```kconfig
if ARCH_VEXPRESS64

config SYS_BOARD
	default "vexpress64"

config SYS_VENDOR
	default "armltd"

config SYS_CONFIG_NAME
	default "vexpress_aemv8"

config VEXPRESS64_BASE_MODEL
	bool
	select SEMIHOSTING
	imply VIRTIO_MMIO
	select VIRTIO_BLK if VIRTIO_MMIO
	select VIRTIO_NET if VIRTIO_MMIO
	select DM_ETH if VIRTIO_NET
	imply RTC_PL031
	select DM_RTC if RTC_PL031
	imply EFI_SET_TIME if DM_RTC
	select LINUX_KERNEL_IMAGE_HEADER
	select POSITION_INDEPENDENT

choice
	prompt "VExpress64 board variant"

config TARGET_VEXPRESS64_BASE_FVP
	bool "Support Versatile Express ARMv8a FVP BASE model"
	select VEXPRESS64_BASE_MODEL
	imply OF_HAS_PRIOR_STAGE

config TARGET_VEXPRESS64_BASER_FVP
	bool "Support Versatile Express ARMv8r64 FVP BASE model"
	select VEXPRESS64_BASE_MODEL
	imply OF_HAS_PRIOR_STAGE

config TARGET_VEXPRESS64_JUNO
	bool "Support Versatile Express Juno Development Platform"
	select PCIE_ECAM_GENERIC if PCI
	select SATA_SIL
	select SMC911X if DM_ETH
	select SMC911X_32_BIT if SMC911X
	select CMD_USB if USB
	select USB_EHCI_HCD if USB
	select USB_EHCI_GENERIC if USB
	select USB_OHCI_HCD if USB
	select USB_OHCI_GENERIC if USB
	imply OF_HAS_PRIOR_STAGE

endchoice

config JUNO_DTB_PART
	string "NOR flash partition holding DTB"
	default "board.dtb"
	help
	  The ARM partition name in the NOR flash memory holding the
	  device tree blob to configure U-Boot.

config LNX_KRNL_IMG_TEXT_OFFSET_BASE
	default TEXT_BASE

config TEXT_BASE
	default 0x88000000 if TARGET_VEXPRESS64_BASE_FVP
	default 0xe0000000 if TARGET_VEXPRESS64_JUNO
	default 0x00001000 if TARGET_VEXPRESS64_BASER_FVP

config SYS_MALLOC_LEN
	default 0x810000 if TARGET_VEXPRESS64_JUNO
	default 0x840000 if TARGET_VEXPRESS64_BASE_FVP

config SYS_MALLOC_F_LEN
	default 0x2000

config SYS_LOAD_ADDR
	default 0x10000000 if TARGET_VEXPRESS64_BASER_FVP
	default 0x90000000

config ENV_ADDR
	default 0x0BFC0000 if TARGET_VEXPRESS64_JUNO
	default 0x0FFC0000 if TARGET_VEXPRESS64_BASE_FVP
	default 0x8FFC0000 if TARGET_VEXPRESS64_BASER_FVP

config ENV_SIZE
	default 0x10000 if TARGET_VEXPRESS64_JUNO
	default 0x40000

config ENV_SECT_SIZE
	default 0x10000 if TARGET_VEXPRESS64_JUNO
	default 0x40000

endif
```

## release/src-rt-5.04behnd.4916/bootloaders/u-boot-2024.04/board/aspeed/evb_ast2500/Kconfig
```kconfig
if TARGET_EVB_AST2500

config SYS_BOARD
	default "evb_ast2500"

config SYS_VENDOR
	default "aspeed"

config SYS_CONFIG_NAME
	default "evb_ast2500"

endif
```

## release/src-rt-5.04behnd.4916/bootloaders/u-boot-2024.04/board/aspeed/evb_ast2600/Kconfig
```kconfig
if TARGET_EVB_AST2600

config SYS_BOARD
	default "evb_ast2600"

config SYS_VENDOR
	default "aspeed"

config SYS_CONFIG_NAME
	default "evb_ast2600"

endif
```

## release/src-rt-5.04behnd.4916/bootloaders/u-boot-2024.04/board/asus/grouper/Kconfig
```kconfig
if TARGET_GROUPER

config SYS_BOARD
	default "grouper"

config SYS_VENDOR
	default "asus"

config SYS_CONFIG_NAME
	default "grouper"

endif
```

## release/src-rt-5.04behnd.4916/bootloaders/u-boot-2024.04/board/asus/transformer-t30/Kconfig
```kconfig
if TARGET_TRANSFORMER_T30

config SYS_BOARD
	default "transformer-t30"

config SYS_VENDOR
	default "asus"

config SYS_CONFIG_NAME
	default "transformer-t30"

endif
```

## release/src-rt-5.04behnd.4916/bootloaders/u-boot-2024.04/board/atmel/at91sam9260ek/Kconfig
```kconfig
if TARGET_AT91SAM9260EK

config SYS_BOARD
	default "at91sam9260ek"

config SYS_VENDOR
	default "atmel"

config SYS_CONFIG_NAME
	default "at91sam9260ek"

choice
	prompt "Evaluation board"

config AT91SAM9G20EK
	bool "Atmel AT91SAM9G20 EK"

config AT91SAM9260EK
	bool "Atmel AT91SAM9260 EK"

endchoice

config AT91SAM9G20EK_2MMC
	bool "Atmel AT91SAM9G20 EK 2MMC variant"
	depends on AT91SAM9260EK

endif
```

## release/src-rt-5.04behnd.4916/bootloaders/u-boot-2024.04/board/atmel/at91sam9261ek/Kconfig
```kconfig
if TARGET_AT91SAM9261EK

config SYS_BOARD
	default "at91sam9261ek"

config SYS_VENDOR
	default "atmel"

config SYS_CONFIG_NAME
	default "at91sam9261ek"

choice
	prompt "Evaluation board"

config AT91SAM9G10EK
	bool "Atmel AT91SAM9G10 EK"

config AT91SAM9261EK
	bool "Atmel AT91SAM9261 EK"

config AT91SAM9G10
	bool "Atmel AT91SAM9G10 EK"

endchoice

endif
```

## release/src-rt-5.04behnd.4916/bootloaders/u-boot-2024.04/board/atmel/at91sam9263ek/Kconfig
```kconfig
if TARGET_AT91SAM9263EK

config SYS_BOARD
	default "at91sam9263ek"

config SYS_VENDOR
	default "atmel"

config SYS_CONFIG_NAME
	default "at91sam9263ek"

config SYS_USE_NORFLASH
	bool "Use the NOR flash on the platform"

endif
```

## release/src-rt-5.04behnd.4916/bootloaders/u-boot-2024.04/board/atmel/at91sam9n12ek/Kconfig
```kconfig
if TARGET_AT91SAM9N12EK

config SYS_BOARD
	default "at91sam9n12ek"

config SYS_VENDOR
	default "atmel"

config SYS_CONFIG_NAME
	default "at91sam9n12ek"

endif
```

## release/src-rt-5.04behnd.4916/bootloaders/u-boot-2024.04/board/atmel/at91sam9x5ek/Kconfig
```kconfig
if TARGET_AT91SAM9X5EK

config SYS_BOARD
	default "at91sam9x5ek"

config SYS_VENDOR
	default "atmel"

config SYS_CONFIG_NAME
	default "at91sam9x5ek"

endif
```

## release/src-rt-5.04behnd.4916/bootloaders/u-boot-2024.04/board/atmel/sam9x60_curiosity/Kconfig
```kconfig
if TARGET_SAM9X60_CURIOSITY

config SYS_BOARD
	default "sam9x60_curiosity"

config SYS_VENDOR
	default "atmel"

config SYS_SOC
        default "at91"

config SYS_CONFIG_NAME
	default "sam9x60_curiosity"

endif
```

## release/src-rt-5.04behnd.4916/bootloaders/u-boot-2024.04/board/atmel/sam9x60ek/Kconfig
```kconfig
if TARGET_SAM9X60EK

config SYS_BOARD
	default "sam9x60ek"

config SYS_VENDOR
	default "atmel"

config SYS_CONFIG_NAME
	default "sam9x60ek"

endif
```

## release/src-rt-5.04behnd.4916/bootloaders/u-boot-2024.04/board/atmel/sama5d27_wlsom1_ek/Kconfig
```kconfig
if TARGET_SAMA5D27_WLSOM1_EK

config SYS_BOARD
	default "sama5d27_wlsom1_ek"

config SYS_VENDOR
	default "atmel"

config SYS_SOC
	default "at91"

config SYS_CONFIG_NAME
	default "sama5d27_wlsom1_ek"

endif
```

## release/src-rt-5.04behnd.4916/bootloaders/u-boot-2024.04/board/atmel/sama5d29_curiosity/Kconfig
```kconfig
if TARGET_SAMA5D29_CURIOSITY

config SYS_BOARD
	default "sama5d29_curiosity"

config SYS_VENDOR
	default "atmel"

config SYS_SOC
	default "at91"

config SYS_CONFIG_NAME
	default "sama5d29_curiosity"

endif
```

## release/src-rt-5.04behnd.4916/bootloaders/u-boot-2024.04/board/atmel/sama5d2_icp/Kconfig
```kconfig
if TARGET_SAMA5D2_ICP

config SYS_BOARD
	default "sama5d2_icp"

config SYS_VENDOR
	default "atmel"

config SYS_SOC
	default "at91"

config SYS_CONFIG_NAME
	default "sama5d2_icp"

endif
```

## release/src-rt-5.04behnd.4916/bootloaders/u-boot-2024.04/board/atmel/sama7g5ek/Kconfig
```kconfig
if TARGET_SAMA7G5EK

config SYS_BOARD
	default "sama7g5ek"

config SYS_VENDOR
	default "atmel"

config SYS_SOC
	default "at91"

config SYS_CONFIG_NAME
	default "sama7g5ek"

endif
```

## release/src-rt-5.04behnd.4916/bootloaders/u-boot-2024.04/board/beacon/beacon-rzg2m/Kconfig
```kconfig
if TARGET_BEACON_RZG2M

config SYS_SOC
	default "renesas"

config SYS_BOARD
	default "beacon-rzg2m"

config SYS_VENDOR
	default "beacon"

config SYS_CONFIG_NAME
	default "beacon-rzg2m"

endif
```

## release/src-rt-5.04behnd.4916/bootloaders/u-boot-2024.04/board/beacon/imx8mm/Kconfig
```kconfig
if TARGET_IMX8MM_BEACON

config SYS_BOARD
	default "imx8mm"

config SYS_VENDOR
	default "beacon"

config SYS_CONFIG_NAME
	default "imx8mm_beacon"

config IMX_CONFIG
	default "board/beacon/imx8mm/imximage-8mm-lpddr4.cfg"

endif
```
