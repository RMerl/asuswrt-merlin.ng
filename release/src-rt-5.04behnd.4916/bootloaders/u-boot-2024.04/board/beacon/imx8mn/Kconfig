## release/src-rt-5.04behnd.4916/bootloaders/u-boot-2024.04/board/beacon/imx8mn/Kconfig
```kconfig
if TARGET_IMX8MN_BEACON

config SYS_BOARD
	default "imx8mn"

config SYS_VENDOR
	default "beacon"

config SYS_CONFIG_NAME
	default "imx8mn_beacon"

config IMX8MN_FORCE_NOM_SOC
	bool "Force to use nominal mode for SOC and ARM"

config IMX8MN_BEACON_2GB_LPDDR
	bool "Enable 2GB LPDDR"

config IMX_CONFIG
	default "board/beacon/imx8mn/imximage-8mn-lpddr4.cfg"

endif
```

## release/src-rt-5.04behnd.4916/bootloaders/u-boot-2024.04/board/beacon/imx8mp/Kconfig
```kconfig
if TARGET_IMX8MP_BEACON

config SYS_BOARD
	default "imx8mp"

config SYS_VENDOR
	default "beacon"

config SYS_CONFIG_NAME
	default "imx8mp_beacon"

config IMX_CONFIG
	default "board/freescale/imx8mp_evk/imximage-8mp-lpddr4.cfg"


endif
```

## release/src-rt-5.04behnd.4916/bootloaders/u-boot-2024.04/board/beagle/beagle/Kconfig
```kconfig
if TARGET_OMAP3_BEAGLE

config SYS_BOARD
	default "beagle"

config SYS_VENDOR
	default "beagle"

config SYS_CONFIG_NAME
	default "omap3_beagle"

endif
```

## release/src-rt-5.04behnd.4916/bootloaders/u-boot-2024.04/board/beagle/beagleboneai64/Kconfig
```kconfig
# SPDX-License-Identifier: GPL-2.0+
#
# Copyright (C) 2022-2023 Texas Instruments Incorporated - https://www.ti.com/
# Copyright (C) 2022-2023 Jason Kridner, BeagleBoard.org Foundation
# Copyright (C) 2022-2023 Robert Nelson, BeagleBoard.org Foundation
#

choice
	prompt "BeagleBoard.org J721E/TDA4VM based BeagleBone AI-64 board"
	optional

config TARGET_J721E_A72_BEAGLEBONEAI64
	bool "BeagleBoard.org J721E BeagleBone AI-64 running on A72"
	select ARM64
	select SYS_DISABLE_DCACHE_OPS
	select BINMAN

config TARGET_J721E_R5_BEAGLEBONEAI64
	bool "BeagleBoard.org J721E BeagleBone AI-64 running on R5"
	select CPU_V7R
	select SYS_THUMB_BUILD
	select K3_LOAD_SYSFW
	select RAM
	select SPL_RAM
	select K3_DDRSS
	select BINMAN
	imply SYS_K3_SPL_ATF

endchoice

if TARGET_J721E_A72_BEAGLEBONEAI64

config SYS_BOARD
       default "beagleboneai64"

config SYS_VENDOR
       default "beagle"

config SYS_CONFIG_NAME
       default "j721e_evm"

source "board/ti/common/Kconfig"

endif

if TARGET_J721E_R5_BEAGLEBONEAI64

config SYS_BOARD
       default "beagleboneai64"

config SYS_VENDOR
       default "beagle"

config SYS_CONFIG_NAME
       default "j721e_evm"

source "board/ti/common/Kconfig"

endif
```

## release/src-rt-5.04behnd.4916/bootloaders/u-boot-2024.04/board/beagle/beagleplay/Kconfig
```kconfig
# SPDX-License-Identifier:     GPL-2.0+
#
# Copyright (C) 2022-2023 Texas Instruments Incorporated - https://www.ti.com/
# Copyright (C) 2022-2023 Robert Nelson, BeagleBoard.org Foundation
#

choice
	prompt "BeagleBoard.org AM625 based BeaglePlay board"
	optional

config TARGET_AM625_A53_BEAGLEPLAY
	bool "BeagleBoard.org AM625 BeaglePlay running on A53"
	select ARM64
	select BINMAN

config TARGET_AM625_R5_BEAGLEPLAY
	bool "BeagleBoard.org AM625 BeaglePlay running on R5"
	select CPU_V7R
	select SYS_THUMB_BUILD
	select K3_LOAD_SYSFW
	select RAM
	select SPL_RAM
	select K3_DDRSS
	select BINMAN
	imply SYS_K3_SPL_ATF

endchoice

if TARGET_AM625_A53_BEAGLEPLAY

config SYS_BOARD
       default "beagleplay"

config SYS_VENDOR
       default "beagle"

config SYS_CONFIG_NAME
       default "am62x_evm"

source "board/ti/common/Kconfig"

endif

if TARGET_AM625_R5_BEAGLEPLAY

config SYS_BOARD
       default "beagleplay"

config SYS_VENDOR
       default "beagle"

config SYS_CONFIG_NAME
       default "am62x_evm"

config SPL_LDSCRIPT
	default "arch/arm/mach-omap2/u-boot-spl.lds"

source "board/ti/common/Kconfig"

endif
```

## release/src-rt-5.04behnd.4916/bootloaders/u-boot-2024.04/board/bluewater/gurnard/Kconfig
```kconfig
if TARGET_GURNARD

config GURNARD_SPLASH
	def_bool y

config SYS_BOARD
	default "gurnard"

config SYS_VENDOR
	default "bluewater"

config SYS_CONFIG_NAME
	default "snapper9g45"

endif
```

## release/src-rt-5.04behnd.4916/bootloaders/u-boot-2024.04/board/bosch/acc/Kconfig
```kconfig
if TARGET_MX6Q_ACC

config SYS_VENDOR
	default "bosch"

config SYS_BOARD
	default "acc"

config SYS_CONFIG_NAME
	default "imx6q-bosch-acc"

config SYS_BOOT_EMMC
	bool "Boot from EMMC"
	default y
	help
	  Say N here if you want to boot from SD card or microUSB.
	  Say Y to boot from eMMC.

endif
```

## release/src-rt-5.04behnd.4916/bootloaders/u-boot-2024.04/board/broadcom/bcm968380gerg/Kconfig
```kconfig
if BOARD_BROADCOM_BCM968380GERG

config SYS_BOARD
	default "bcm968380gerg"

config SYS_VENDOR
	default "broadcom"

config SYS_CONFIG_NAME
	default "broadcom_bcm968380gerg"

endif
```

## release/src-rt-5.04behnd.4916/bootloaders/u-boot-2024.04/board/broadcom/bcmns/Kconfig
```kconfig
if TARGET_BCMNS

config SYS_BOARD
	default "bcmns"

config SYS_VENDOR
	default "broadcom"

config SYS_CONFIG_NAME
	default "bcmns"

endif
```

## release/src-rt-5.04behnd.4916/bootloaders/u-boot-2024.04/board/broadcom/bcmns3/Kconfig
```kconfig
if TARGET_BCMNS3

config SYS_BOARD
	default "bcmns3"

config SYS_VENDOR
	default "broadcom"

config SYS_SOC
	default "bcmns3"

config SYS_CONFIG_NAME
	default "bcm_ns3"

config CMD_BCM_EXT_UTILS
	bool "Enable Broadcom-specific U-Boot commands"
	default y
	help
	  Enable Broadcom specific U-Boot commands such as error log setup
	  command or any other commands specific to NS3 platform.

endif
```

## release/src-rt-5.04behnd.4916/bootloaders/u-boot-2024.04/board/broadcom/bcmns3/fit/multi.its
```
/*
 * U-Boot uImage source file with multiple kernels, ramdisks and FDT blobs
 */

/dts-v1/;

/ {
	description = "Various kernels, ramdisks and FDT blobs";
	#address-cells = <1>;

	images {
		kernel {
			description = "Linux kernel Image";
			data = /incbin/("./Image");
			type = "kernel";
			arch = "arm64";
			os = "linux";
			compression = "none";
			load = <0x80080000>;
			entry = <0x80080000>;
			hash-1 {
				algo = "sha1";
			};
			signature {
				algo = "sha1,rsa2048";
				key-name-hint = "dev";
			};
		};

		fdt-ns3 {
			description = "FDT Blob";
			data = /incbin/("./dt-blob.bin");
			type = "flat_dt";
			arch = "arm64";
			compression = "none";
			hash-1 {
				algo = "sha1";
			};
			signature {
				algo = "sha1,rsa2048";
				key-name-hint = "dev";
			};
		};
	};

	configurations {
		default = "config-ns3";
		config-ns3 {
			description = "FIT1 configuration";
			kernel = "kernel";
			fdt = "fdt-ns3";
			signature {
				algo = "sha1,rsa2048";
				key-name-hint = "dev";
				sign-images = "fdt", "kernel";
			};
		};
	};
};
```

## release/src-rt-5.04behnd.4916/bootloaders/u-boot-2024.04/board/bsh/imx6ulz_smm_m2/Kconfig
```kconfig
if TARGET_MX6ULZ_SMM_M2

config SYS_BOARD
	default "imx6ulz_smm_m2"

config SYS_VENDOR
	default "bsh"

config SYS_CONFIG_NAME
	default "imx6ulz_smm_m2"

endif
```

## release/src-rt-5.04behnd.4916/bootloaders/u-boot-2024.04/board/bsh/imx8mn_smm_s2/Kconfig
```kconfig
config BSH_SMM_S2_DDR3L_256
	bool "BSH SMM S2 DDR3L 256 MiB RAM support"

config BSH_SMM_S2_DDR3L_512
	bool "BSH SMM S2 DDR3L 512 MiB RAM support"

if TARGET_IMX8MN_BSH_SMM_S2

config SYS_BOARD
	default "imx8mn_smm_s2"

config SYS_VENDOR
	default "bsh"

config IMX_CONFIG
	default "board/bsh/imx8mn_smm_s2/imximage-8mn-ddr3.cfg"

config SYS_CONFIG_NAME
	default "imx8mn_bsh_smm_s2"

config BOARD_SPECIFIC_OPTIONS # dummy
	def_bool y
	select BSH_SMM_S2_DDR3L_256

endif

if TARGET_IMX8MN_BSH_SMM_S2PRO

config SYS_BOARD
	default "imx8mn_smm_s2"

config SYS_VENDOR
	default "bsh"

config IMX_CONFIG
	default "board/bsh/imx8mn_smm_s2/imximage-8mn-ddr3.cfg"

config SYS_CONFIG_NAME
	default "imx8mn_bsh_smm_s2pro"

config BOARD_SPECIFIC_OPTIONS # dummy
	def_bool y
	select BSH_SMM_S2_DDR3L_512

endif
```

## release/src-rt-5.04behnd.4916/bootloaders/u-boot-2024.04/board/buffalo/lsxl/Kconfig
```kconfig
if TARGET_LSXL

config SYS_BOARD
	default "lsxl"

config SYS_VENDOR
	default "buffalo"

config SYS_CONFIG_NAME
	default "lsxl"

choice
	prompt "Board model"

config LSCHLV2
	bool "LSCHLV2 support"

config LSXHL
	bool "LSXHL support"

endchoice

endif
```

## release/src-rt-5.04behnd.4916/bootloaders/u-boot-2024.04/board/cadence/xtfpga/Kconfig
```kconfig
if TARGET_XTFPGA

choice
	prompt "XTFPGA board type select"

config XTFPGA_LX60
	bool "Support Avnet LX60"
config XTFPGA_LX110
	bool "Support Avnet LX110"
config XTFPGA_LX200
	bool "Support Avnet LX200"
config XTFPGA_ML605
	bool "Support Xilinx ML605"
config XTFPGA_KC705
	bool "Support Xilinx KC705"

endchoice

config SYS_BOARD
	string
	default "xtfpga"

config SYS_VENDOR
	string
	default "cadence"

config SYS_CONFIG_NAME
	string
	default "xtfpga"

config BOARD_SDRAM_SIZE
	hex
	default 0x04000000 if XTFPGA_LX60
	default 0x03000000 if XTFPGA_LX110
	default 0x06000000 if XTFPGA_LX200
	default 0x18000000 if XTFPGA_ML605
	default 0x38000000 if XTFPGA_KC705

endif
```

## release/src-rt-5.04behnd.4916/bootloaders/u-boot-2024.04/board/cloos/imx8mm_phg/Kconfig
```kconfig
if TARGET_IMX8MM_PHG

config SYS_BOARD
	default "imx8mm_phg"

config SYS_VENDOR
	default "cloos"

config SYS_CONFIG_NAME
	default "imx8mm_phg"

config IMX_CONFIG
	default "board/cloos/imx8mm_phg/imximage-8mm-lpddr4.cfg"

endif
```

## release/src-rt-5.04behnd.4916/bootloaders/u-boot-2024.04/board/cloudengines/pogo_v4/Kconfig
```kconfig
# SPDX-License-Identifier: GPL-2.0+
#
# (C) Copyright 2014-2021 Tony Dinh <mibodhi@gmail.com>
#
if TARGET_POGO_V4

config SYS_BOARD
	default "pogo_v4"

config SYS_VENDOR
	default "cloudengines"

config SYS_CONFIG_NAME
	default "pogo_v4"

endif
```

## release/src-rt-5.04behnd.4916/bootloaders/u-boot-2024.04/board/compulab/cl-som-imx7/Kconfig
```kconfig
if TARGET_CL_SOM_IMX7

config SYS_BOARD
	default "cl-som-imx7"

config SYS_VENDOR
	default "compulab"

config SYS_CONFIG_NAME
	default "cl-som-imx7"

config SYS_MMC_DEV
	int
	default 0

config SYS_USB_DEV
	int
	default 0

config SYS_USB_IMG_LOAD_PART
	int
	default 1

endif
```

## release/src-rt-5.04behnd.4916/bootloaders/u-boot-2024.04/board/compulab/imx8mm-cl-iot-gate/Kconfig
```kconfig
if TARGET_IMX8MM_CL_IOT_GATE || TARGET_IMX8MM_CL_IOT_GATE_OPTEE

config SYS_BOARD
	default "imx8mm-cl-iot-gate"

config SYS_VENDOR
	default "compulab"

config SYS_CONFIG_NAME
	default "imx8mm-cl-iot-gate"

config IMX_CONFIG
	default "board/compulab/imx8mm-cl-iot-gate/imximage-8mm-lpddr4.cfg"

endif
```

## release/src-rt-5.04behnd.4916/bootloaders/u-boot-2024.04/board/conclusive/kstr-sama5d27/Kconfig
```kconfig
if TARGET_KSTR_SAMA5D27

config SYS_BOARD
	default "kstr-sama5d27"

config SYS_VENDOR
	default "conclusive"

config SYS_SOC
	default "at91"

config SYS_CONFIG_NAME
	default "kstr-sama5d27"

endif
```

## release/src-rt-5.04behnd.4916/bootloaders/u-boot-2024.04/board/congatec/cgtqmx8/Kconfig
```kconfig
if TARGET_CONGA_QMX8

config SYS_BOARD
	default "cgtqmx8"

config SYS_VENDOR
	default "congatec"

config SYS_CONFIG_NAME
	default "cgtqmx8"

config IMX_CONFIG
	default "board/congatec/cgtqmx8/imximage.cfg"

source "board/congatec/common/Kconfig"

endif
```

## release/src-rt-5.04behnd.4916/bootloaders/u-boot-2024.04/board/congatec/common/Kconfig
```kconfig
config USB_TCPC
	bool "USB Typec port controller simple driver"
	help
	  Enable USB type-c port controller (TCPC) driver
```

## release/src-rt-5.04behnd.4916/bootloaders/u-boot-2024.04/board/coreboot/coreboot/Kconfig
```kconfig
if VENDOR_COREBOOT

config SYS_BOARD
	default "coreboot"

config SYS_VENDOR
	default "coreboot"

config SYS_SOC
	default "coreboot"

config TEXT_BASE
	default 0x01110000

config BOARD_SPECIFIC_OPTIONS # dummy
	def_bool y
	select BOARD_EARLY_INIT_R

config SYS_CAR_ADDR
	hex "Board specific Cache-As-RAM (CAR) address"
	default 0x01920000
	help
	  This option specifies the board specific Cache-As-RAM (CAR) address.

config SYS_CAR_SIZE
	hex "Board specific Cache-As-RAM (CAR) size"
	default 0x4000
	help
	  This option specifies the board specific Cache-As-RAM (CAR) size.

endif  # CONFIG_VENDOR_COREBOOT

if TARGET_COREBOOT

config SYS_CONFIG_NAME
	default "coreboot"

endif
```

## release/src-rt-5.04behnd.4916/bootloaders/u-boot-2024.04/board/cortina/common/Kconfig
```kconfig
config CORTINA_PLATFORM
       bool "Cortina-Access Platform"
       default y
       help
         Select this option for Cortina-Access platforms
	 to enables selection of CAxxxx drivers
```

## release/src-rt-5.04behnd.4916/bootloaders/u-boot-2024.04/board/cortina/presidio-asic/Kconfig
```kconfig
if TARGET_PRESIDIO_ASIC
config BIT64
       bool
       default y

select SOC_CA7774

config SYS_BOARD
	default "presidio-asic"

config SYS_VENDOR
	default "cortina"

config SYS_CONFIG_NAME
	default "presidio_asic"

source "board/cortina/common/Kconfig"
endif
```
