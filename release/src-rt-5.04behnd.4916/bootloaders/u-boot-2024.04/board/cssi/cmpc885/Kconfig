## release/src-rt-5.04behnd.4916/bootloaders/u-boot-2024.04/board/cssi/cmpc885/Kconfig
```kconfig
if TARGET_CMPC885

config SYS_BOARD
	default "cmpc885"

config SYS_VENDOR
	default "cssi"

config SYS_CONFIG_NAME
	default "cmpc885"

config TEXT_BASE
	default 0x40000000

config CPLD_BASE
	hex
	default 0xc8000000

config FPGA_BASE
	hex
	default 0xd0000000

endif
```

## release/src-rt-5.04behnd.4916/bootloaders/u-boot-2024.04/board/cssi/cmpcpro/Kconfig
```kconfig
if TARGET_CMPCPRO

config SYS_BOARD
	default "cmpcpro"

config SYS_VENDOR
	default "cssi"

config SYS_CONFIG_NAME
	default "cmpcpro"

config TEXT_BASE
	default 0x40000000

config CPLD_BASE
	hex
	default 0x90000000

config FPGA_BASE
	hex
	default 0x80000000

config PCI
	default no

endif
```

## release/src-rt-5.04behnd.4916/bootloaders/u-boot-2024.04/board/cssi/mcr3000/Kconfig
```kconfig
if TARGET_MCR3000

config SYS_BOARD
	default "mcr3000"

config SYS_VENDOR
	default "cssi"

config SYS_CONFIG_NAME
	default "mcr3000"

config TEXT_BASE
	default 0x04000000

endif
```

## release/src-rt-5.04behnd.4916/bootloaders/u-boot-2024.04/board/data_modul/imx8mm_edm_sbc/Kconfig
```kconfig
if TARGET_IMX8MM_DATA_MODUL_EDM_SBC

config SYS_BOARD
	default "imx8mm_edm_sbc"

config SYS_VENDOR
	default "data_modul"

config SYS_CONFIG_NAME
	default "imx8mm_data_modul_edm_sbc"

endif
```

## release/src-rt-5.04behnd.4916/bootloaders/u-boot-2024.04/board/data_modul/imx8mp_edm_sbc/Kconfig
```kconfig
if TARGET_IMX8MP_DATA_MODUL_EDM_SBC

config SYS_BOARD
	default "imx8mp_edm_sbc"

config SYS_VENDOR
	default "data_modul"

config SYS_CONFIG_NAME
	default "imx8mp_data_modul_edm_sbc"

config IMX_CONFIG
	default "board/data_modul/imx8mp_edm_sbc/imximage.cfg"

endif
```

## release/src-rt-5.04behnd.4916/bootloaders/u-boot-2024.04/board/davinci/da8xxevm/Kconfig
```kconfig
if TARGET_DA850EVM

config SYS_BOARD
	default "da8xxevm"

config SYS_VENDOR
	default "davinci"

config SYS_CONFIG_NAME
	default "da850evm"

menuconfig DA850_MAC
	bool "Use MAC Address"
	default y

if DA850_MAC
config MAC_ADDR_IN_SPIFLASH
	bool "MAC address in SPI Flash"
	default y
	help
	  The OMAP-L138 and AM1808 SoM are programmed with
	  their MAC address in SPI Flash from the factory
	  Enable this option to read the MAC from SPI Flash

endif

endif

if TARGET_OMAPL138_LCDK

config SYS_BOARD
	default "da8xxevm"

config SYS_VENDOR
	default "davinci"

config SYS_CONFIG_NAME
	default "omapl138_lcdk"

config NAND_6BYTES_OOB_FREE_10BYTES_ECC
	def_bool y

endif

source "board/ti/common/Kconfig"
```

## release/src-rt-5.04behnd.4916/bootloaders/u-boot-2024.04/board/dhelectronics/dh_imx6/Kconfig
```kconfig
if TARGET_DHCOMIMX6

config SYS_BOARD
	default "dh_imx6"

config SYS_VENDOR
	default "dhelectronics"

config SYS_CONFIG_NAME
	default "dh_imx6"

endif
```

## release/src-rt-5.04behnd.4916/bootloaders/u-boot-2024.04/board/dhelectronics/dh_imx8mp/Kconfig
```kconfig
if TARGET_IMX8MP_DH_DHCOM_PDK2

config SYS_BOARD
	default "dh_imx8mp"

config SYS_VENDOR
	default "dhelectronics"

config SYS_CONFIG_NAME
	default "imx8mp_dhcom_pdk2"

config IMX_CONFIG
	default "board/dhelectronics/dh_imx8mp/imximage-lpddr4.cfg"

endif
```

## release/src-rt-5.04behnd.4916/bootloaders/u-boot-2024.04/board/dhelectronics/dh_stm32mp1/Kconfig
```kconfig
if TARGET_DH_STM32MP1_PDK2

config SYS_BOARD
	default "dh_stm32mp1"

config SYS_VENDOR
	default "dhelectronics"

config SYS_CONFIG_NAME
	default "stm32mp15_dh_dhsom"

config ENV_SECT_SIZE
	default 0x10000 if ENV_IS_IN_SPI_FLASH

config ENV_OFFSET
	default 0x1E0000 if ENV_IS_IN_SPI_FLASH

config ENV_OFFSET_REDUND
	default 0x1F0000 if ENV_IS_IN_SPI_FLASH

source "board/st/common/Kconfig"
endif
```

## release/src-rt-5.04behnd.4916/bootloaders/u-boot-2024.04/board/dhelectronics/dh_stm32mp1/u-boot-dhcom.its
```
/dts-v1/;

/ {
	description = "U-Boot mainline";
	#address-cells = <1>;

	images {
		uboot {
			description = "U-Boot (32-bit)";
			data = /incbin/("u-boot-nodtb.bin");
			type = "standalone";
			os = "U-Boot";
			arch = "arm";
			compression = "none";
			load = <0xc0100000>;
			entry = <0xc0100000>;
		};

		fdt-1 {
			description = ".dtb";
			data = /incbin/("arch/arm/dts/stm32mp15xx-dhcom-pdk2.dtb");
			type = "flat_dt";
			arch = "arm";
			compression = "none";
		};

		fdt-2 {
			description = ".dtb";
			data = /incbin/("arch/arm/dts/stm32mp15xx-dhcom-drc02.dtb");
			type = "flat_dt";
			arch = "arm";
			compression = "none";
		};

		fdt-3 {
			description = ".dtb";
			data = /incbin/("arch/arm/dts/stm32mp15xx-dhcom-picoitx.dtb");
			type = "flat_dt";
			arch = "arm";
			compression = "none";
		};
	};

	configurations {
		default = "config-1";

		config-1 {
			/* DT+SoM+board model */
			description = "dh,stm32mp15xx-dhcom-pdk2_somrev0_boardrev0";
			firmware = "uboot";
			fdt = "fdt-1";
		};

		config-2 {
			/* DT+SoM+board model */
			description = "dh,stm32mp15xx-dhcom-pdk2_somrev1_boardrev0";
			firmware = "uboot";
			fdt = "fdt-1";
		};

		config-3 {
			/* DT+SoM+board model */
			description = "dh,stm32mp15xx-dhcom-drc02_somrev0_boardrev0";
			firmware = "uboot";
			fdt = "fdt-2";
		};

		config-4 {
			/* DT+SoM+board model */
			description = "dh,stm32mp15xx-dhcom-drc02_somrev1_boardrev0";
			firmware = "uboot";
			fdt = "fdt-2";
		};

		config-5 {
			/* DT+SoM+board model */
			description = "dh,stm32mp15xx-dhcom-picoitx_somrev0_boardrev0";
			loadables = "uboot";
			fdt = "fdt-3";
		};

		config-6 {
			/* DT+SoM+board model */
			description = "dh,stm32mp15xx-dhcom-picoitx_somrev1_boardrev0";
			loadables = "uboot";
			fdt = "fdt-3";
		};

		/* Add 587-100..587-400 with fdt-2..fdt-4 here */
	};
};
```

## release/src-rt-5.04behnd.4916/bootloaders/u-boot-2024.04/board/dhelectronics/dh_stm32mp1/u-boot-dhcor.its
```
/dts-v1/;

/ {
	description = "U-Boot mainline";
	#address-cells = <1>;

	images {
		uboot {
			description = "U-Boot (32-bit)";
			data = /incbin/("u-boot-nodtb.bin");
			type = "standalone";
			os = "U-Boot";
			arch = "arm";
			compression = "none";
			load = <0xc0100000>;
			entry = <0xc0100000>;
		};

		fdt-1 {
			description = ".dtb";
			data = /incbin/("arch/arm/dts/stm32mp15xx-dhcor-testbench.dtb");
			type = "flat_dt";
			arch = "arm";
			compression = "none";
		};

		fdt-2 {
			description = ".dtb";
			data = /incbin/("arch/arm/dts/stm32mp15xx-dhcor-avenger96.dtb");
			type = "flat_dt";
			arch = "arm";
			compression = "none";
		};

		fdt-3 {
			description = ".dtb";
			data = /incbin/("arch/arm/dts/stm32mp15xx-dhcor-drc-compact.dtb");
			type = "flat_dt";
			arch = "arm";
			compression = "none";
		};
	};

	configurations {
		default = "config-1";

		config-1 {
			/* DT+SoM+board model */
			description = "dh,stm32mp15xx-dhcor-testbench_somrev0_boardrev1";
			firmware = "uboot";
			fdt = "fdt-1";
		};

		config-2 {
			/* DT+SoM+board model */
			description = "arrow,stm32mp15xx-avenger96_somrev0_boardrev1";
			firmware = "uboot";
			fdt = "fdt-2";
		};

		config-3 {
			/* DT+SoM+board model */
			description = "dh,stm32mp15xx-dhcor-drc-compact_somrev0_boardrev0";
			firmware = "uboot";
			fdt = "fdt-3";
		};

		/* Add 586-200..586-400 with fdt-2..fdt-4 here */
	};
};
```

## release/src-rt-5.04behnd.4916/bootloaders/u-boot-2024.04/board/ea/ea-lpc3250devkitv2/Kconfig
```kconfig
if TARGET_EA_LPC3250DEVKITV2

config SYS_BOARD
	default "ea-lpc3250devkitv2"

config SYS_VENDOR
	default "ea"

config SYS_SOC
	default "lpc32xx"

config SYS_CONFIG_NAME
	default "ea-lpc3250devkitv2"

endif
```

## release/src-rt-5.04behnd.4916/bootloaders/u-boot-2024.04/board/ea/mx7ulp_com/Kconfig
```kconfig
if TARGET_MX7ULP_COM

config SYS_BOARD
	default "mx7ulp_com"

config SYS_VENDOR
	default "ea"

config SYS_CONFIG_NAME
	default "mx7ulp_com"

config IMX_CONFIG
	default "board/ea/mx7ulp_com/imximage.cfg"

endif
```

## release/src-rt-5.04behnd.4916/bootloaders/u-boot-2024.04/board/edgeble/neural-compute-module-2/Kconfig
```kconfig
if TARGET_RV1126_NEU2

config SYS_BOARD
	default "neural-compute-module-2"

config SYS_VENDOR
	default "edgeble"

config SYS_CONFIG_NAME
	default "neural-compute-module-2"

config BOARD_SPECIFIC_OPTIONS # dummy
	def_bool y
	select RAM_ROCKCHIP_LPDDR4

endif
```

## release/src-rt-5.04behnd.4916/bootloaders/u-boot-2024.04/board/edgeble/neural-compute-module-6/Kconfig
```kconfig
if TARGET_RK3588_NEU6

config SYS_BOARD
	default "neural-compute-module-6"

config SYS_VENDOR
	default "edgeble"

config SYS_CONFIG_NAME
	default "neural-compute-module-6"

config BOARD_SPECIFIC_OPTIONS # dummy
	def_bool y

endif
```

## release/src-rt-5.04behnd.4916/bootloaders/u-boot-2024.04/board/efi/Kconfig
```kconfig
if VENDOR_EFI

choice
	prompt "Mainboard model"
	optional

config TARGET_EFI_APP32
	bool "32-bit efi application"
	select EFI_APP
	help
	  This target is used for running U-Boot on top of EFI. In
	  this case EFI does the early initialisation, and U-Boot
	  takes over once the RAM, video and CPU are fully running.
	  U-Boot is loaded as an application from EFI.

config TARGET_EFI_APP64
	bool "64-bit efi application"
	select EFI_APP
	select X86_64
	help
	  This target is used for running U-Boot on top of EFI in 64-bit mode.
	  In this case EFI does the early initialisation, and U-Boot
	  takes over once the RAM, video and CPU are fully running.
	  U-Boot is loaded as an application from EFI.

config TARGET_EFI_PAYLOAD
	bool "efi payload"
	help
	  This target is used for running U-Boot on top of EFI. In
	  this case EFI does the early initialisation, and U-Boot
	  takes over once the RAM, video and CPU are fully running.
	  U-Boot is loaded as a payload from EFI.

endchoice

source "board/efi/efi-x86_app/Kconfig"
source "board/efi/efi-x86_payload/Kconfig"

endif
```

## release/src-rt-5.04behnd.4916/bootloaders/u-boot-2024.04/board/efi/efi-x86_app/Kconfig
```kconfig
if EFI_APP

config SYS_BOARD
	default "efi-x86_app"

config SYS_VENDOR
	default "efi"

config SYS_SOC
	default "efi"

config SYS_CONFIG_NAME
	default "efi-x86_app"

config BOARD_SPECIFIC_OPTIONS # dummy
	def_bool y
	imply VIDEO_EFI

endif
```

## release/src-rt-5.04behnd.4916/bootloaders/u-boot-2024.04/board/efi/efi-x86_payload/Kconfig
```kconfig
if TARGET_EFI_PAYLOAD

config SYS_BOARD
	default "efi-x86_payload"

config SYS_VENDOR
	default "efi"

config SYS_SOC
	default "efi"

config SYS_CONFIG_NAME
	default "efi-x86_payload"

config TEXT_BASE
	default 0x00200000

config BOARD_SPECIFIC_OPTIONS # dummy
	def_bool y
	select BOARD_EARLY_INIT_R
	imply SYS_NS16550
	imply SCSI
	imply SCSI_AHCI
	imply AHCI_PCI
	imply MMC
	imply MMC_PCI
	imply MMC_SDHCI
	imply MMC_SDHCI_SDMA
	imply USB
	imply USB_EHCI_HCD
	imply USB_XHCI_HCD
	imply USB_STORAGE
	imply USB_KEYBOARD
	imply VIDEO_EFI
	imply E1000
	imply ETH_DESIGNWARE
	imply PCH_GBE
	imply RTL8169

endif
```

## release/src-rt-5.04behnd.4916/bootloaders/u-boot-2024.04/board/elgin/elgin_rv1108/Kconfig
```kconfig
if TARGET_ELGIN_RV1108

config SYS_BOARD
	default "elgin_rv1108"

config SYS_VENDOR
	default "elgin"

config SYS_CONFIG_NAME
	default "elgin_rv1108"

config BOARD_SPECIFIC_OPTIONS # dummy
	def_bool y

endif
```

## release/src-rt-5.04behnd.4916/bootloaders/u-boot-2024.04/board/emulation/common/Kconfig
```kconfig
config MTDPARTS_NOR0
	string "mtd boot partition for nor0"
	default "64m(u-boot)" if TARGET_QEMU_ARM_64BIT && !TFABOOT
	depends on SYS_MTDPARTS_RUNTIME
	help
	  This define the partition of nor0 used to build mtparts dynamically
	  for boot from nor0.

config MTDPARTS_NOR1
	string "mtd u-boot env partition for nor1"
	default "64m(u-boot-env)" if TARGET_QEMU_ARM_64BIT && !TFABOOT
	depends on SYS_MTDPARTS_RUNTIME
	help
	  This define the partition of nor1 used to build mtparts dynamically
	  for the u-boot env stored on nor1.
```

## release/src-rt-5.04behnd.4916/bootloaders/u-boot-2024.04/board/emulation/qemu-arm/Kconfig
```kconfig
if TARGET_QEMU_ARM_32BIT || TARGET_QEMU_ARM_64BIT

config TEXT_BASE
	default 0x00000000

config BOARD_SPECIFIC_OPTIONS # dummy
	def_bool y
	select QFW if ACPI
	select QFW_MMIO if CMD_QFW
	imply VIRTIO_MMIO
	imply VIRTIO_PCI
	imply VIRTIO_NET
	imply VIRTIO_BLK

config PRE_CON_BUF_ADDR
	hex
	default 0x40100000

endif

if TARGET_QEMU_ARM_64BIT && !TFABOOT
config BOARD_SPECIFIC_OPTIONS
	imply SYS_MTDPARTS_RUNTIME
	imply SET_DFU_ALT_INFO

source "board/emulation/common/Kconfig"
endif
```

## release/src-rt-5.04behnd.4916/bootloaders/u-boot-2024.04/board/emulation/qemu-ppce500/Kconfig
```kconfig
if TARGET_QEMU_PPCE500

config SYS_BOARD
	default "qemu-ppce500"

config SYS_VENDOR
	default "emulation"

config SYS_CONFIG_NAME
	default "qemu-ppce500"

config PLATFORM_BUS_MAP_ADDR
	hex
	default 0xf0000000
	help
	  The QEMU platform bus base mapped address in the virtual memory space.

endif
```

## release/src-rt-5.04behnd.4916/bootloaders/u-boot-2024.04/board/emulation/qemu-riscv/Kconfig
```kconfig
if TARGET_QEMU_VIRT

config SYS_BOARD
	default "qemu-riscv"

config SYS_VENDOR
	default "emulation"

config SYS_CPU
	default "generic"

config SYS_CONFIG_NAME
	default "qemu-riscv"

config TEXT_BASE
	default 0x81200000 if SPL
	default 0x80000000 if !RISCV_SMODE
	default 0x80200000 if RISCV_SMODE && ARCH_RV64I
	default 0x80400000 if RISCV_SMODE && ARCH_RV32I

config SPL_TEXT_BASE
	default 0x80000000

config SPL_OPENSBI_LOAD_ADDR
	hex
	default 0x80100000

config PRE_CON_BUF_ADDR
	hex
	default 0x81000000

config BOARD_SPECIFIC_OPTIONS # dummy
	def_bool y
	select GENERIC_RISCV
	select SUPPORT_SPL
	select QFW if ACPI
	select QFW_MMIO if QFW
	imply AHCI
	imply SMP
	imply BOARD_LATE_INIT
	imply PCI_INIT_R
	imply SPL_RAM_SUPPORT
	imply SPL_RAM_DEVICE
	imply CMD_PCI
	imply CMD_POWEROFF
	imply CMD_SBI
	imply CMD_SCSI
	imply CMD_PING
	imply CMD_EXT2
	imply CMD_EXT4
	imply CMD_FAT
	imply CMD_FS_GENERIC
	imply DOS_PARTITION
	imply ISO_PARTITION
	imply EFI_PARTITION
	imply SCSI_AHCI
	imply AHCI_PCI
	imply E1000
	imply PCI
	imply NVME_PCI
	imply PCIE_ECAM_GENERIC
	imply DM_RNG
	imply DM_RTC
	imply RTC_GOLDFISH
	imply SCSI
	imply SYS_NS16550
	imply SIFIVE_SERIAL
	imply HTIF_CONSOLE if 64BIT
	imply SYSRESET
	imply SYSRESET_CMD_POWEROFF
	imply SYSRESET_SYSCON
	imply VIRTIO_MMIO
	imply VIRTIO_PCI
	imply VIRTIO_NET
	imply VIRTIO_BLK
	imply MTD_NOR_FLASH
	imply CFI_FLASH
	imply OF_HAS_PRIOR_STAGE
	imply VIDEO
	imply VIDEO_BOCHS
	imply SYS_WHITE_ON_BLACK
	imply PRE_CONSOLE_BUFFER
	imply USB
	imply USB_XHCI_HCD
	imply USB_XHCI_PCI
	imply USB_KEYBOARD
	imply CMD_USB
	imply UFS
	imply UFS_PCI

endif
```

## release/src-rt-5.04behnd.4916/bootloaders/u-boot-2024.04/board/engicam/common/Kconfig
```kconfig
config IMX6_ENGICAM_COMMON
	bool "Engicam i.MX6 Common code"
	depends on SPL && MX6
	default y if TARGET_MX6Q_ENGICAM || TARGET_MX6UL_ENGICAM
	help
	  Common SPL and U-Boot proper code for Engicam i.MX6 targets.

	  Enable it in board Kconfig if it uses i.MX6 variant Engicam boards.
```

## release/src-rt-5.04behnd.4916/bootloaders/u-boot-2024.04/board/engicam/imx8mm/Kconfig
```kconfig
if TARGET_IMX8MM_ICORE_MX8MM

config SYS_BOARD
	default "imx8mm"

config SYS_VENDOR
	default "engicam"

config SYS_CONFIG_NAME
	default "imx8mm_icore_mx8mm"

config IMX_CONFIG
	default "arch/arm/mach-imx/imx8m/imximage-8mm-lpddr4.cfg"

endif
```
