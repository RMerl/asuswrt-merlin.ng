## release/src-rt-5.04behnd.4916/bootloaders/u-boot-2024.04/board/engicam/imx8mp/Kconfig
```kconfig
if TARGET_IMX8MP_ICORE_MX8MP

config SYS_BOARD
	default "imx8mp"

config SYS_VENDOR
	default "engicam"

config SYS_CONFIG_NAME
	default "imx8mp_icore_mx8mp"

config IMX_CONFIG
	default "board/engicam/imx8mp/imximage-lpddr4.cfg"

endif
```

## release/src-rt-5.04behnd.4916/bootloaders/u-boot-2024.04/board/engicam/px30_core/Kconfig
```kconfig
if TARGET_PX30_CORE

config SYS_BOARD
	default "px30_core"

config SYS_VENDOR
	default "engicam"

config SYS_CONFIG_NAME
	default "px30_core"

config BOARD_SPECIFIC_OPTIONS # dummy
	def_bool y
	select RAM_ROCKCHIP_DDR4

endif
```

## release/src-rt-5.04behnd.4916/bootloaders/u-boot-2024.04/board/engicam/stm32mp1/Kconfig
```kconfig
if TARGET_ICORE_STM32MP1 || TARGET_MICROGEA_STM32MP1

config SYS_BOARD
	default "stm32mp1"

config SYS_VENDOR
	default "engicam"

config SYS_CONFIG_NAME
	default "stm32mp15_common"

endif
```

## release/src-rt-5.04behnd.4916/bootloaders/u-boot-2024.04/board/firefly/firefly-rk3308/Kconfig
```kconfig
if TARGET_ROC_RK3308_CC

config SYS_BOARD
	default "firefly-rk3308"

config SYS_VENDOR
	default "firefly"

config SYS_CONFIG_NAME
	default "firefly_rk3308"

config BOARD_SPECIFIC_OPTIONS # dummy
	def_bool y

endif
```

## release/src-rt-5.04behnd.4916/bootloaders/u-boot-2024.04/board/firefly/roc-pc-rk3399/Kconfig
```kconfig
if TARGET_ROC_PC_RK3399

config SYS_BOARD
        default "roc-pc-rk3399"

config SYS_VENDOR
        default "firefly"

config SYS_CONFIG_NAME
        default "roc-pc-rk3399"

config BOARD_SPECIFIC_OPTIONS # dummy
        def_bool y

endif
```

## release/src-rt-5.04behnd.4916/bootloaders/u-boot-2024.04/board/freescale/imx8mm_evk/Kconfig
```kconfig
if TARGET_IMX8MM_EVK

config SYS_BOARD
	default "imx8mm_evk"

config SYS_VENDOR
	default "freescale"

config SYS_CONFIG_NAME
	default "imx8mm_evk"

config IMX_CONFIG
	default "board/freescale/imx8mm_evk/imximage-8mm-lpddr4.cfg"

endif
```

## release/src-rt-5.04behnd.4916/bootloaders/u-boot-2024.04/board/freescale/imx8mn_evk/Kconfig
```kconfig
if TARGET_IMX8MN_EVK || TARGET_IMX8MN_DDR4_EVK

config SYS_BOARD
	default "imx8mn_evk"

config SYS_VENDOR
	default "freescale"

config SYS_CONFIG_NAME
	default "imx8mn_evk"

config IMX8MN_LOW_DRIVE_MODE
	bool "Enable the low drive mode of iMX8MN on EVK board"

config IMX_CONFIG
	default "board/freescale/imx8mn_evk/imximage-8mn-ddr4.cfg"

endif
```

## release/src-rt-5.04behnd.4916/bootloaders/u-boot-2024.04/board/freescale/imx8mp_evk/Kconfig
```kconfig
if TARGET_IMX8MP_EVK

config SYS_BOARD
	default "imx8mp_evk"

config SYS_VENDOR
	default "freescale"

config SYS_CONFIG_NAME
	default "imx8mp_evk"

config IMX_CONFIG
	default "board/freescale/imx8mp_evk/imximage-8mp-lpddr4.cfg"

endif
```

## release/src-rt-5.04behnd.4916/bootloaders/u-boot-2024.04/board/freescale/imx8mq_evk/Kconfig
```kconfig
if TARGET_IMX8MQ_EVK

config SYS_BOARD
	default "imx8mq_evk"

config SYS_VENDOR
	default "freescale"

config SYS_CONFIG_NAME
	default "imx8mq_evk"

config IMX_CONFIG
	default "arch/arm/mach-imx/imx8m/imximage.cfg"

endif
```

## release/src-rt-5.04behnd.4916/bootloaders/u-boot-2024.04/board/freescale/imx8qm_mek/Kconfig
```kconfig
if TARGET_IMX8QM_MEK

config SYS_BOARD
	default "imx8qm_mek"

config SYS_VENDOR
	default "freescale"

config SYS_CONFIG_NAME
	default "imx8qm_mek"

config IMX_CONFIG
	default "board/freescale/imx8qm_mek/imximage.cfg"

endif
```

## release/src-rt-5.04behnd.4916/bootloaders/u-boot-2024.04/board/freescale/imx8qxp_mek/Kconfig
```kconfig
if TARGET_IMX8QXP_MEK

config SYS_BOARD
	default "imx8qxp_mek"

config SYS_VENDOR
	default "freescale"

config SYS_CONFIG_NAME
	default "imx8qxp_mek"

config IMX_CONFIG
	default "board/freescale/imx8qxp_mek/imximage.cfg"

endif
```

## release/src-rt-5.04behnd.4916/bootloaders/u-boot-2024.04/board/freescale/imx8ulp_evk/Kconfig
```kconfig
if TARGET_IMX8ULP_EVK

config SYS_BOARD
	default "imx8ulp_evk"

config SYS_VENDOR
	default "freescale"

config SYS_CONFIG_NAME
	default "imx8ulp_evk"

endif
```

## release/src-rt-5.04behnd.4916/bootloaders/u-boot-2024.04/board/freescale/imx93_evk/Kconfig
```kconfig
if TARGET_IMX93_11X11_EVK

config SYS_BOARD
	default "imx93_evk"

config SYS_VENDOR
	default "freescale"

config SYS_CONFIG_NAME
	default "imx93_evk"

config IMX93_EVK_LPDDR4X
	bool "Using LPDDR4X Timing and PMIC voltage"
	default y
	select IMX9_LPDDR4X
	help
	  Select the LPDDR4X timing and 0.6V VDDQ

endif
```

## release/src-rt-5.04behnd.4916/bootloaders/u-boot-2024.04/board/freescale/imxrt1020-evk/Kconfig
```kconfig
if TARGET_IMXRT1020_EVK

config SYS_BOARD
	string
	default "imxrt1020-evk"

config SYS_VENDOR
	string
	default "freescale"

config SYS_SOC
	string
	default "imxrt1020"

config SYS_CONFIG_NAME
	string
	default "imxrt1020-evk"

config IMX_CONFIG
	default "board/freescale/imxrt1020-evk/imximage.cfg"

endif
```

## release/src-rt-5.04behnd.4916/bootloaders/u-boot-2024.04/board/freescale/imxrt1050-evk/Kconfig
```kconfig
if TARGET_IMXRT1050_EVK

config SYS_BOARD
	string
	default "imxrt1050-evk"

config SYS_VENDOR
	string
	default "freescale"

config SYS_SOC
	string
	default "imxrt1050"

config SYS_CONFIG_NAME
	string
	default "imxrt1050-evk"

config IMX_CONFIG
	default "board/freescale/imxrt1050-evk/imximage.cfg"

endif
```

## release/src-rt-5.04behnd.4916/bootloaders/u-boot-2024.04/board/freescale/imxrt1170-evk/Kconfig
```kconfig
if TARGET_IMXRT1170_EVK

config SYS_BOARD
	string
	default "imxrt1170-evk"

config SYS_VENDOR
	string
	default "freescale"

config SYS_SOC
	string
	default "imxrt1170"

config SYS_CONFIG_NAME
	string
	default "imxrt1170-evk"

config IMX_CONFIG
	default "board/freescale/imxrt1170-evk/imximage.cfg"

endif
```

## release/src-rt-5.04behnd.4916/bootloaders/u-boot-2024.04/board/freescale/ls1012ardb/Kconfig
```kconfig
if TARGET_LS1012ARDB

config SYS_BOARD
	default "ls1012ardb"

config SYS_VENDOR
	default "freescale"

config SYS_SOC
	default "fsl-layerscape"

config SYS_CONFIG_NAME
	default "ls1012ardb"

if CHAIN_OF_TRUST
config SYS_LS_PFE_ESBC_ADDR
	hex "PFE Firmware HDR Addr"
	default 0x40640000

config SYS_LS_PFE_ESBC_LENGTH
	hex "length of PFE Firmware HDR"
	default 0xc00
endif

if FSL_PFE

config BOARD_SPECIFIC_OPTIONS # dummy
	def_bool y
	select PHYLIB
	imply PHY_REALTEK

config SYS_LS_PFE_FW_ADDR
	hex "Flash address of PFE firmware"
	default 0x40a00000

config SYS_LS_PFE_FW_LENGTH
	hex "length of PFE firmware"
	default 0x300000

config DDR_PFE_PHYS_BASEADDR
	hex "PFE DDR physical base address"
	default 0x03800000

config DDR_PFE_BASEADDR
	hex "PFE DDR base address"
	default 0x83800000

config PFE_EMAC1_PHY_ADDR
	hex "PFE DDR base address"
	default 0x2

config PFE_EMAC2_PHY_ADDR
	hex "PFE DDR base address"
	default 0x1

endif

endif

if TARGET_LS1012A2G5RDB

config SYS_BOARD
        default "ls1012ardb"

config SYS_VENDOR
        default "freescale"

config SYS_SOC
        default "fsl-layerscape"

config SYS_CONFIG_NAME
        default "ls1012a2g5rdb"

if FSL_PFE

config BOARD_SPECIFIC_OPTIONS # dummy
	def_bool y
	select PHYLIB
	imply PHYLIB_10G
	imply PHY_AQUANTIA

config SYS_LS_PFE_FW_ADDR
	hex "Flash address of PFE firmware"
	default 0x40a00000

config SYS_LS_PFE_FW_LENGTH
	hex "length of PFE firmware"
	default 0x300000

config DDR_PFE_PHYS_BASEADDR
	hex "PFE DDR physical base address"
	default 0x03800000

config DDR_PFE_BASEADDR
	hex "PFE DDR base address"
	default 0x83800000

config PFE_EMAC1_PHY_ADDR
	hex "PFE DDR base address"
	default 0x2

config PFE_EMAC2_PHY_ADDR
	hex "PFE DDR base address"
	default 0x1

endif

endif
```

## release/src-rt-5.04behnd.4916/bootloaders/u-boot-2024.04/board/freescale/ls1021aiot/Kconfig
```kconfig
if TARGET_LS1021AIOT

config SYS_BOARD
	default "ls1021aiot"

config SYS_VENDOR
	default "freescale"

config SYS_SOC
	default "ls102xa"

config SYS_CONFIG_NAME
	default "ls1021aiot"

endif
```

## release/src-rt-5.04behnd.4916/bootloaders/u-boot-2024.04/board/freescale/ls1021atsn/Kconfig
```kconfig
# SPDX-License-Identifier: GPL-2.0
if TARGET_LS1021ATSN

config SYS_BOARD
	default "ls1021atsn"

config SYS_VENDOR
	default "freescale"

config SYS_SOC
	default "ls102xa"

config SYS_CONFIG_NAME
	default "ls1021atsn"

endif
```

## release/src-rt-5.04behnd.4916/bootloaders/u-boot-2024.04/board/freescale/ls1028a/Kconfig
```kconfig
if TARGET_LS1028AQDS

config SYS_BOARD
	default "ls1028a"

config SYS_VENDOR
	default "freescale"

config SYS_SOC
	default "fsl-layerscape"

config SYS_CONFIG_NAME
	default "ls1028aqds"

config EMMC_BOOT
	bool "Support for booting from EMMC"

config TEXT_BASE
	default 0x96000000 if SD_BOOT || EMMC_BOOT
	default 0x82000000 if TFABOOT
	default 0x20100000

endif

if TARGET_LS1028ARDB

config SYS_BOARD
	default "ls1028a"

config SYS_VENDOR
	default "freescale"

config SYS_SOC
	default "fsl-layerscape"

config SYS_CONFIG_NAME
	default "ls1028ardb"

config EMMC_BOOT
	bool "Support for booting from EMMC"

config TEXT_BASE
	default 0x96000000 if SD_BOOT || EMMC_BOOT
	default 0x82000000 if TFABOOT
	default 0x20100000

endif
```

## release/src-rt-5.04behnd.4916/bootloaders/u-boot-2024.04/board/freescale/ls1043aqds/Kconfig
```kconfig
if TARGET_LS1043AQDS

config SYS_BOARD
	default "ls1043aqds"

config SYS_VENDOR
	default "freescale"

config SYS_SOC
	default "fsl-layerscape"

config SYS_CONFIG_NAME
	default "ls1043aqds"

endif
```

## release/src-rt-5.04behnd.4916/bootloaders/u-boot-2024.04/board/freescale/ls1043ardb/Kconfig
```kconfig
if TARGET_LS1043ARDB

config SYS_BOARD
	default "ls1043ardb"

config SYS_VENDOR
	default "freescale"

config SYS_SOC
	default "fsl-layerscape"

config SYS_CONFIG_NAME
	default "ls1043ardb"

endif
```

## release/src-rt-5.04behnd.4916/bootloaders/u-boot-2024.04/board/freescale/ls1046aqds/Kconfig
```kconfig
if TARGET_LS1046AQDS

config SYS_BOARD
	default "ls1046aqds"

config SYS_VENDOR
	default "freescale"

config SYS_SOC
	default "fsl-layerscape"

config SYS_CONFIG_NAME
	default "ls1046aqds"

endif
```

## release/src-rt-5.04behnd.4916/bootloaders/u-boot-2024.04/board/freescale/ls1046ardb/Kconfig
```kconfig
if TARGET_LS1046ARDB

config SYS_BOARD
	default "ls1046ardb"

config SYS_VENDOR
	default "freescale"

config SYS_SOC
	default "fsl-layerscape"

config SYS_CONFIG_NAME
	default "ls1046ardb"

endif
```

## release/src-rt-5.04behnd.4916/bootloaders/u-boot-2024.04/board/freescale/ls1088a/Kconfig
```kconfig
if TARGET_LS1088AQDS

config SYS_BOARD
	default "ls1088a"

config SYS_VENDOR
	default "freescale"

config SYS_SOC
	default "fsl-layerscape"

config SYS_CONFIG_NAME
	default "ls1088aqds"

endif

if TARGET_LS1088ARDB

config SYS_BOARD
	default "ls1088a"

config SYS_VENDOR
	default "freescale"

config SYS_SOC
	default "fsl-layerscape"

config SYS_CONFIG_NAME
	default "ls1088ardb"

endif
```
