## release/src-rt-5.04behnd.4916/bootloaders/u-boot-2024.04/board/freescale/ls2080aqds/Kconfig
```kconfig
if TARGET_LS2080AQDS

config SYS_BOARD
	default "ls2080aqds"

config SYS_VENDOR
	default "freescale"

config SYS_SOC
	default "fsl-layerscape"

config SYS_CONFIG_NAME
	default "ls2080aqds"

endif
```

## release/src-rt-5.04behnd.4916/bootloaders/u-boot-2024.04/board/freescale/ls2080ardb/Kconfig
```kconfig
if TARGET_LS2080ARDB || TARGET_LS2081ARDB

config SYS_BOARD
	default "ls2080ardb"

config SYS_VENDOR
	default "freescale"

config SYS_SOC
	default "fsl-layerscape"

config SYS_CONFIG_NAME
	default "ls2080ardb"

endif
```

## release/src-rt-5.04behnd.4916/bootloaders/u-boot-2024.04/board/freescale/lx2160a/Kconfig
```kconfig
if TARGET_LX2160ARDB

config SYS_BOARD
	default "lx2160a"

config SYS_VENDOR
	default "freescale"

config SYS_SOC
	default "fsl-layerscape"

config SYS_CONFIG_NAME
	default "lx2160ardb"

endif

if TARGET_LX2160AQDS

config SYS_BOARD
	default "lx2160a"

config SYS_VENDOR
	default "freescale"

config SYS_SOC
	default "fsl-layerscape"

config SYS_CONFIG_NAME
	default "lx2160aqds"

endif

if TARGET_LX2162AQDS

config SYS_BOARD
	default "lx2160a"

config SYS_VENDOR
	default "freescale"

config SYS_SOC
	default "fsl-layerscape"

config SYS_CONFIG_NAME
	default "lx2162aqds"

endif
```

## release/src-rt-5.04behnd.4916/bootloaders/u-boot-2024.04/board/freescale/m5235evb/Kconfig
```kconfig
if TARGET_M5235EVB

config SYS_CPU
	default "mcf523x"

config SYS_BOARD
	default "m5235evb"

config SYS_VENDOR
	default "freescale"

config SYS_CONFIG_NAME
	default "M5235EVB"

config NORFLASH_PS32BIT
	bool "Board has 32bit CFI flash"

endif
```

## release/src-rt-5.04behnd.4916/bootloaders/u-boot-2024.04/board/freescale/m5253demo/Kconfig
```kconfig
if TARGET_M5253DEMO

config FLASH_CFI_LEGACY
	depends on SYS_FLASH_CFI
	def_bool y

config SYS_CPU
	default "mcf52x2"

config SYS_BOARD
	default "m5253demo"

config SYS_VENDOR
	default "freescale"

config SYS_CONFIG_NAME
	default "M5253DEMO"

endif
```

## release/src-rt-5.04behnd.4916/bootloaders/u-boot-2024.04/board/freescale/m5373evb/Kconfig
```kconfig
if TARGET_M5373EVB

config SYS_CPU
	default "mcf532x"

config SYS_BOARD
	default "m5373evb"

config SYS_VENDOR
	default "freescale"

config SYS_CONFIG_NAME
	default "M5373EVB"

endif
```

## release/src-rt-5.04behnd.4916/bootloaders/u-boot-2024.04/board/freescale/mpc837xerdb/Kconfig
```kconfig
if TARGET_MPC837XERDB

config PCIE
	def_bool y

config SYS_BOARD
	default "mpc837xerdb"

config SYS_VENDOR
	default "freescale"

config SYS_CONFIG_NAME
	default "MPC837XERDB"

endif
```

## release/src-rt-5.04behnd.4916/bootloaders/u-boot-2024.04/board/freescale/mpc8548cds/Kconfig
```kconfig
if TARGET_MPC8548CDS

config PCI1
	def_bool y

config FSL_CADMUS
	def_bool y

config INTERRUPTS
	def_bool y

config SYS_BOARD
	default "mpc8548cds"

config SYS_VENDOR
	default "freescale"

config SYS_CONFIG_NAME
	default "MPC8548CDS"

config TARGET_MPC8548CDS_LEGACY
	bool "Legacy platform support"

endif
```

## release/src-rt-5.04behnd.4916/bootloaders/u-boot-2024.04/board/freescale/mx23evk/Kconfig
```kconfig
if TARGET_MX23EVK

config SYS_BOARD
	default "mx23evk"

config SYS_VENDOR
	default "freescale"

config SYS_SOC
	default "mxs"

config SYS_CONFIG_NAME
	default "mx23evk"

endif
```

## release/src-rt-5.04behnd.4916/bootloaders/u-boot-2024.04/board/freescale/mx51evk/Kconfig
```kconfig
if TARGET_MX51EVK

config SYS_BOARD
	default "mx51evk"

config SYS_VENDOR
	default "freescale"

config SYS_SOC
	default "mx5"

config SYS_CONFIG_NAME
	default "mx51evk"

config IMX_CONFIG
	default "board/freescale/mx51evk/imximage.cfg"

endif
```

## release/src-rt-5.04behnd.4916/bootloaders/u-boot-2024.04/board/freescale/mx53loco/Kconfig
```kconfig
if TARGET_MX53LOCO

config DIALOG_POWER
	def_bool y

config SYS_BOARD
	default "mx53loco"

config SYS_VENDOR
	default "freescale"

config SYS_SOC
	default "mx5"

config SYS_CONFIG_NAME
	default "mx53loco"

config IMX_CONFIG
	default "board/freescale/mx53loco/imximage.cfg"

endif
```

## release/src-rt-5.04behnd.4916/bootloaders/u-boot-2024.04/board/freescale/mx6memcal/Kconfig
```kconfig
if TARGET_MX6MEMCAL

config SYS_BOARD
	default "mx6memcal"

config SYS_VENDOR
	default "freescale"

config SYS_CONFIG_NAME
	default "mx6memcal"

menu "mx6memcal specifics"
choice
	prompt "Serial console"
	help
	  Either UART1 or UART2 will be used as the console for
	  displaying the calibration values or errors.

config SERIAL_CONSOLE_UART1
	bool "UART1"
	help
	  Select this if your board uses UART1 for its' console.

config SERIAL_CONSOLE_UART2
	bool "UART2"
	help
	  Select this if your board uses UART2 for its' console.

endchoice

choice
	prompt "UART pads"
	help
	  Select the RX and TX pads used for your serial console.
	  The choices below reflect the most commonly used options
	  for your UART.

	config UART2_EIM_D26_27
		bool "UART2 on EIM_D26/27 (SabreLite, Nitrogen6x)"
		depends on SERIAL_CONSOLE_UART2
		help
		  Choose this configuration if you're using pads
		  EIM_D26 and D27 for a console on UART2.
		  This is typical for designs that are based on the
		  NXP SABRELite.

	config UART1_CSI0_DAT10_11
		bool "UART1 on CSI0_DAT10/11 (Wand, SabreSD)"
		depends on SERIAL_CONSOLE_UART1
		help
		  Choose this configuration if you're using pads
		  CSI0_DAT10 and DAT11 for a console on UART1 as
		  is done on the i.MX6 Wand board and i.MX6 SabreSD.

	config UART1_UART1
		bool "UART1 on UART1 (i.MX6SL EVK, WaRP)"
		depends on SERIAL_CONSOLE_UART1
		help
		  Choose this configuration if you're using pads
		  UART1_TXD/RXD for a console on UART1 as is done
		  on most i.MX6SL designs.

endchoice

config IMXIMAGE_OUTPUT
	bool "Include output for imximage .cfg files"
	default y
	help
	  Say "Y" if you want output formatted for use in non-SPL
	  (DCD-style) configuration files.

config DDRWIDTH
	int "DDR bus width"
	default 64
	help
	  Select either 32 or 64 to reflect the DDR bus width.

config DDRCS
	int "DDR chip selects"
	default 2
	range 1 2
	help
	  Select the number of chip selects used in your board design

choice
	prompt "Memory type"
	help
	  Select the type of DDR (DDR3 or LPDDR2) used on your design

config DDR3
	bool "DDR3"
	help
	  Select this if your board design uses DDR3.

config LPDDR2
	bool "LPDDR2"
	help
	  Select this if your board design uses LPDDR2.

endchoice

choice
	prompt "Memory device"

config MT41K512M16TNA
	bool "Micron MT41K512M16TNA 512Mx16 (1GiB/chip)"
	depends on DDR3

config MT41K128M16JT
	bool "Micron MT41K128M16JT 128Mx16 (256 MiB/chip)"
	depends on DDR3

config H5TQ4G63AFR
	bool "Hynix H5TQ4G63AFR 256Mx16 (512 MiB/chip)"
	depends on DDR3

config H5TQ2G63DFR
	bool "Hynix H5TQ2G63DFR 128Mx16 (256 MiB/chip)"
	depends on DDR3

config MT42L256M32D2LG
	bool "Micron MT42L256M32D2LG LPDDR2 256Mx32 (1GiB/chip)"
	depends on LPDDR2

config MT29PZZZ4D4BKESK
	bool "Micron MT29PZZZ4D4BKESK multi-chip 512MiB LPDDR2/4GiB eMMC"
	depends on LPDDR2

endchoice

config DDR_ODT
	int "DDR On-die-termination"
	default 2
	range 0 7
	help
	  Enter the on-die termination value as an index defined for
	  IOMUX settings for PAD_DRAM_SDCLK0_P and others.
	  0 == Disabled
	  1 == 120 Ohm
	  2 == 60 Ohm
	  3 == 40 Ohm
	  4 == 30 Ohm
	  5 == 24 Ohm
	  6 == 20 Ohm
	  7 == 17 Ohm
	  Value will be applied to all clock and data lines


config DRAM_DRIVE_STRENGTH
	int "DRAM Drive strength"
	default 6
	range 0 7
	help
	  Enter drive strength as an index defined for IOMUX settings
	  for GRP_B1DS and others.
	  0 == Hi Z
	  6 == 40 Ohm (default)
	  7 == 34 Ohm
	  Value will be applied to all clock and data lines

config RTT_NOM
	int "RTT_NOM"
	default 1
	range 1 2
	help
	  Enter the RTT_NOM selector
	  1 == RZQ/4 (60ohm)
	  2 == RZQ/2 (120ohm)

config RTT_WR
	int "RTT_WR"
	default 1
	range 0 2
	help
	  Enter the RTT_WR selector for MR2
	  0 == Dynamic ODT disabled
	  1 == RZQ/4 (60ohm)
	  2 == RZQ/2 (120ohm)

config RALAT
	int "Read additional latency"
	default 5
	range 0 7
	help
	  Enter a latency in number of cycles. This will be added to
	  CAS and internal delays for which the MMDC will retrieve the
	  read data from the internal FIFO.
	  This is used to compensate for board/chip delays.

config WALAT
	int "Write additional latency"
	default 0
	range 0 7
	help
	  Enter a latency in number of cycles. This will be added to
	  CAS and internal delays for which the MMDC will retrieve the
	  read data from the internal FIFO
	  This is used to compensate for board/chip delays.

config REFSEL
	int "Refresh period"
	range 0 3
	default 1
	help
	  Select the DDR refresh period.
	  See the description of bitfield REF_SEL in the reference manual
	  for details.
	  0 == disabled
	  1 == 32 kHz
	  2 == 64 kHz
	  3 == fast counter

config REFR
	int "Number of refreshes"
	range 0 7
	default 7
	help
	   This selects the number of refreshes (-1) during each period.
	   i.e.:
	   0 == 1 refresh (tRFC)
	   7 == 8 refreshes (tRFC*8)
	   See the description of MDREF[REFR] in the reference manual for
	   details.

endmenu

config IMX_CONFIG
	default "arch/arm/mach-imx/spl_sd.cfg"

endif
```

## release/src-rt-5.04behnd.4916/bootloaders/u-boot-2024.04/board/freescale/mx6slevk/Kconfig
```kconfig
if TARGET_MX6SLEVK

config SYS_BOARD
	default "mx6slevk"

config SYS_VENDOR
	default "freescale"

config SYS_CONFIG_NAME
	default "mx6slevk"

config IMX_CONFIG
	default "board/freescale/mx6slevk/imximage.cfg"

endif
```

## release/src-rt-5.04behnd.4916/bootloaders/u-boot-2024.04/board/freescale/mx6sxsabresd/Kconfig
```kconfig
if TARGET_MX6SXSABRESD

config SYS_BOARD
	default "mx6sxsabresd"

config SYS_VENDOR
	default "freescale"

config SYS_CONFIG_NAME
	default "mx6sxsabresd"

config IMX_CONFIG
	default "board/freescale/mx6sxsabresd/imximage.cfg"

endif
```

## release/src-rt-5.04behnd.4916/bootloaders/u-boot-2024.04/board/freescale/mx6ul_14x14_evk/Kconfig
```kconfig
if TARGET_MX6UL_14X14_EVK || TARGET_MX6UL_9X9_EVK

config SYS_BOARD
	default "mx6ul_14x14_evk"

config SYS_VENDOR
	default "freescale"

config SYS_CONFIG_NAME
	default "mx6ul_14x14_evk"

endif
```

## release/src-rt-5.04behnd.4916/bootloaders/u-boot-2024.04/board/freescale/mx6ullevk/Kconfig
```kconfig
if TARGET_MX6ULL_14X14_EVK

config SYS_BOARD
	default "mx6ullevk"

config SYS_VENDOR
	default "freescale"

config SYS_CONFIG_NAME
	default "mx6ullevk"

config IMX_CONFIG
	default "board/freescale/mx6ullevk/imximage.cfg"

endif
```

## release/src-rt-5.04behnd.4916/bootloaders/u-boot-2024.04/board/freescale/mx7dsabresd/Kconfig
```kconfig
if TARGET_MX7DSABRESD

config SYS_BOARD
	default "mx7dsabresd"

config SYS_VENDOR
	default "freescale"

config SYS_CONFIG_NAME
	default "mx7dsabresd"

config IMX_CONFIG
	default "board/freescale/mx7dsabresd/imximage.cfg"

endif
```

## release/src-rt-5.04behnd.4916/bootloaders/u-boot-2024.04/board/freescale/mx7ulp_evk/Kconfig
```kconfig
if TARGET_MX7ULP_EVK

config SYS_BOARD
	default "mx7ulp_evk"

config SYS_VENDOR
	default "freescale"

config SYS_CONFIG_NAME
	default "mx7ulp_evk"

config IMX_CONFIG
	default "board/freescale/mx7ulp_evk/imximage.cfg"

endif
```

## release/src-rt-5.04behnd.4916/bootloaders/u-boot-2024.04/board/freescale/p1010rdb/Kconfig
```kconfig
if TARGET_P1010RDB_PA || TARGET_P1010RDB_PB

config SYS_BOARD
	default "p1010rdb"

config SYS_VENDOR
	default "freescale"

config SYS_CONFIG_NAME
	default "P1010RDB"

endif
```

## release/src-rt-5.04behnd.4916/bootloaders/u-boot-2024.04/board/freescale/p1_p2_rdb_pc/Kconfig
```kconfig
if	TARGET_P1020RDB_PC	|| \
	TARGET_P1020RDB_PD	|| \
	TARGET_P2020RDB

config SYS_BOARD
	default "p1_p2_rdb_pc"

config SYS_VENDOR
	default "freescale"

config SYS_CONFIG_NAME
	default "p1_p2_rdb_pc"

endif
```

## release/src-rt-5.04behnd.4916/bootloaders/u-boot-2024.04/board/freescale/p2041rdb/Kconfig
```kconfig
if TARGET_P2041RDB

config SYS_BOARD
	default "p2041rdb"

config SYS_VENDOR
	default "freescale"

config SYS_CONFIG_NAME
	default "P2041RDB"

endif
```

## release/src-rt-5.04behnd.4916/bootloaders/u-boot-2024.04/board/freescale/t104xrdb/Kconfig
```kconfig
if TARGET_T1042D4RDB

config SYS_BOARD
	default "t104xrdb"

config SYS_VENDOR
	default "freescale"

config SYS_CONFIG_NAME
	default "T104xRDB"

endif
```

## release/src-rt-5.04behnd.4916/bootloaders/u-boot-2024.04/board/freescale/t208xqds/Kconfig
```kconfig
if TARGET_T2080QDS

config SYS_BOARD
	default "t208xqds"

config SYS_VENDOR
	default "freescale"

config SYS_CONFIG_NAME
	default "T208xQDS"

config SRIO_PCIE_BOOT_SLAVE
	bool "Boot as a SRIO PCIe slave device"

endif
```

## release/src-rt-5.04behnd.4916/bootloaders/u-boot-2024.04/board/freescale/t208xrdb/Kconfig
```kconfig
if TARGET_T2080RDB

config SYS_BOARD
	default "t208xrdb"

config SYS_VENDOR
	default "freescale"

config SYS_CONFIG_NAME
	default "T208xRDB"

config T2080RDB_REV_D
	bool "Support for T2080RDB revisions D and up"

endif
```

## release/src-rt-5.04behnd.4916/bootloaders/u-boot-2024.04/board/freescale/vf610twr/Kconfig
```kconfig
if TARGET_VF610TWR

config SYS_BOARD
	default "vf610twr"

config SYS_VENDOR
	default "freescale"

config SYS_CONFIG_NAME
	default "vf610twr"

config IMX_CONFIG
	default "board/freescale/vf610twr/imximage.cfg"

endif
```
