## release/src-rt-5.04behnd.4916/bootloaders/u-boot-2024.04/board/friendlyarm/Kconfig
```kconfig
choice
	prompt "LCD backlight control"
	optional
	default S5P4418_ONEWIRE

config S5P4418_ONEWIRE
	bool "I2C / 1-Wire"
	help
	  This enables LCD-Backlight control for FriendlyARM LCD-panels.
	  I2C is used if available, otherwise 1-Wire is used.

config PWM_NX
	bool "PWM"
	select PWM_S5P
	help
	  This enables LCD-Backlight control via PWM.
endchoice

config ROOT_DEV
	int "ROOT_DEV"
	help
	  Environment variable rootdev is set to this value if env. var. firstboot
	  does not exist. Otherwise rootdev is set to the MMC boot device. rootdev
	  determines (together with env. var. bootpart) where the OS (linux) is
	  booted from.

config BOOT_PART
	int "BOOT_PART"
	help
	  Environment variable bootpart is set to this value. bootpart determines
	  (together with env. var. rootdev) where the OS (linux) is booted from.

config ROOT_PART
	int "ROOT_PART"
	help
	  Environment variable rootpart is set to this value.

source "board/friendlyarm/nanopi2/Kconfig"
```

## release/src-rt-5.04behnd.4916/bootloaders/u-boot-2024.04/board/friendlyarm/nanopi2/Kconfig
```kconfig
if TARGET_NANOPI2

config SYS_BOARD
	default "nanopi2"

config SYS_VENDOR
	default "friendlyarm"

config SYS_CONFIG_NAME
	default "s5p4418_nanopi2"

endif
```

## release/src-rt-5.04behnd.4916/bootloaders/u-boot-2024.04/board/friendlyelec/nanopc-t6-rk3588/Kconfig
```kconfig
if TARGET_NANOPCT6_RK3588

config SYS_BOARD
	default "nanopc-t6-rk3588"

config SYS_VENDOR
	default "friendlyelec"

config SYS_CONFIG_NAME
	default "nanopc-t6-rk3588"

config BOARD_SPECIFIC_OPTIONS # dummy
	def_bool y

endif
```

## release/src-rt-5.04behnd.4916/bootloaders/u-boot-2024.04/board/gardena/smart-gateway-at91sam/Kconfig
```kconfig
if TARGET_GARDENA_SMART_GATEWAY_AT91SAM

config SYS_BOARD
	default "smart-gateway-at91sam"

config SYS_VENDOR
	default "gardena"

config SYS_CONFIG_NAME
	default "gardena-smart-gateway-at91sam"

endif
```

## release/src-rt-5.04behnd.4916/bootloaders/u-boot-2024.04/board/gateworks/gw_ventana/Kconfig
```kconfig
if TARGET_GW_VENTANA

config DM_GPIO
	default y

config SYS_BOARD
	default "gw_ventana"

config SYS_VENDOR
	default "gateworks"

config SYS_CONFIG_NAME
	default "gw_ventana"

config CMD_EECONFIG
	bool "Enable the 'econfig' command"
	help
	  Provides access to EEPROM configuration on Gateworks Ventana

endif
```

## release/src-rt-5.04behnd.4916/bootloaders/u-boot-2024.04/board/gateworks/venice/Kconfig
```kconfig
if TARGET_IMX8MM_VENICE

config SYS_BOARD
	default "venice"

config SYS_VENDOR
	default "gateworks"

config SYS_CONFIG_NAME
	default "imx8mm_venice"

config IMX_CONFIG
	default "board/gateworks/venice/imximage-8mm-lpddr4.cfg"
endif

if TARGET_IMX8MN_VENICE

config SYS_BOARD
	default "venice"

config SYS_VENDOR
	default "gateworks"

config SYS_CONFIG_NAME
	default "imx8mn_venice"

config IMX_CONFIG
	default "board/gateworks/venice/imximage-8mn-lpddr4.cfg"
endif

if TARGET_IMX8MP_VENICE

config SYS_BOARD
	default "venice"

config SYS_VENDOR
	default "gateworks"

config SYS_CONFIG_NAME
	default "imx8mp_venice"

config IMX_CONFIG
	default "board/gateworks/venice/imximage-8mp-lpddr4.cfg"
endif
```

## release/src-rt-5.04behnd.4916/bootloaders/u-boot-2024.04/board/ge/b1x5v2/Kconfig
```kconfig
if TARGET_GE_B1X5V2

config SYS_BOARD
	default "b1x5v2"

config SYS_VENDOR
	default "ge"

config SYS_CONFIG_NAME
	default "ge_b1x5v2"

source "board/ge/common/Kconfig"

endif
```

## release/src-rt-5.04behnd.4916/bootloaders/u-boot-2024.04/board/ge/common/Kconfig
```kconfig
config GE_VPD
	bool "Enable GE VPD Support"
	default y

config GE_RTC
	bool "Enable GE RTC Support"
	default y
```

## release/src-rt-5.04behnd.4916/bootloaders/u-boot-2024.04/board/geekbuying/geekbox/Kconfig
```kconfig
if TARGET_GEEKBOX

config SYS_BOARD
	default "geekbox"

config SYS_VENDOR
	default "geekbuying"

config SYS_CONFIG_NAME
	default "geekbox"

config BOARD_SPECIFIC_OPTIONS # dummy
	def_bool y

endif
```

## release/src-rt-5.04behnd.4916/bootloaders/u-boot-2024.04/board/google/chameleonv3/fpga.its
```
// SPDX-License-Identifier: GPL-2.0
/*
 * Copyright 2022 Google LLC
 */
/dts-v1/;

/ {
	description = "FIT image with FPGA bistream";
	#address-cells = <1>;

	images {
		fpga-periph-1 {
			description = "FPGA full bitstream";
			data = /incbin/("../../../fpga.rbf");
			type = "fpga";
			arch = "arm";
			compression = "none";
		};
	};

	configurations {
		default = "config-1";
		config-1 {
			description = "Boot with FPGA config";
			fpga = "fpga-periph-1";
		};
	};
};
```

## release/src-rt-5.04behnd.4916/bootloaders/u-boot-2024.04/board/google/chameleonv3/fpga_early_io.its
```
// SPDX-License-Identifier: GPL-2.0
/*
 * Copyright 2022 Google LLC
 */
/dts-v1/;

/ {
	description = "FIT image with FPGA bistream";
	#address-cells = <1>;

	images {
		fpga-periph-1 {
			description = "FPGA peripheral bitstream";
			data = /incbin/("../../../periph.rbf");
			type = "fpga";
			arch = "arm";
			compression = "none";
		};
		fpga-core-1 {
			description = "FPGA core bitstream";
			data = /incbin/("../../../core.rbf");
			type = "fpga";
			arch = "arm";
			compression = "none";
		};
	};

	configurations {
		default = "config-1";
		config-1 {
			description = "Boot with FPGA config";
			fpga = "fpga-periph-1", "fpga-core-1";
		};
	};
};
```

## release/src-rt-5.04behnd.4916/bootloaders/u-boot-2024.04/board/google/chromebook_coral/Kconfig
```kconfig
if TARGET_CHROMEBOOK_CORAL

config SYS_BOARD
	default "chromebook_coral"

config SYS_VENDOR
	default "google"

config SYS_SOC
	default "apollolake"

config SYS_CONFIG_NAME
	default "chromebook_coral"

config TEXT_BASE
	default 0xffe00000

config BOARD_SPECIFIC_OPTIONS # dummy
	def_bool y
	select X86_RESET_VECTOR
	select USE_EARLY_BOARD_INIT
	select INTEL_APOLLOLAKE
	select BOARD_ROMSIZE_KB_16384

config PCIE_ECAM_BASE
	default 0xe0000000

config EARLY_POST_CROS_EC
	bool "Enable early post to Chrome OS EC"
	help
	  Allow post codes to be sent to the Chroem OS EC early during boot,
	  to enable monitoring of the boot and debugging when things go wrong.
	  With this option enabled, the EC console can be used to watch post
	  codes the first part of boot.

config SYS_CAR_ADDR
	hex
	default 0xfef00000

config SYS_CAR_SIZE
	hex
	default 0xc0000

endif
```

## release/src-rt-5.04behnd.4916/bootloaders/u-boot-2024.04/board/google/imx8mq_phanbell/Kconfig
```kconfig
if TARGET_IMX8MQ_PHANBELL

config SYS_BOARD
	default "imx8mq_phanbell"

config SYS_VENDOR
	default "google"

config SYS_CONFIG_NAME
	default "imx8mq_phanbell"

config IMX_CONFIG
	default "arch/arm/mach-imx/imx8m/imximage.cfg"

endif
```

## release/src-rt-5.04behnd.4916/bootloaders/u-boot-2024.04/board/grinn/chiliboard/Kconfig
```kconfig
if TARGET_CHILIBOARD

config SYS_BOARD
	default "chiliboard"

config SYS_VENDOR
	default "grinn"

config SYS_CONFIG_NAME
	default "chiliboard"

config SYS_SOC
	default "am33xx"

endif
```

## release/src-rt-5.04behnd.4916/bootloaders/u-boot-2024.04/board/hardkernel/odroid_go2/Kconfig
```kconfig
if TARGET_ODROID_GO2

config SYS_BOARD
	default "odroid_go2"

config SYS_VENDOR
	default "hardkernel"

config SYS_CONFIG_NAME
	default "odroid_go2"

config BOARD_SPECIFIC_OPTIONS # dummy
	def_bool y

endif
```

## release/src-rt-5.04behnd.4916/bootloaders/u-boot-2024.04/board/hardkernel/odroid_m1/Kconfig
```kconfig
if TARGET_ODROID_M1_RK3568

config SYS_BOARD
	default "odroid_m1"

config SYS_VENDOR
	default "hardkernel"

config SYS_CONFIG_NAME
	default "odroid_m1"

config BOARD_SPECIFIC_OPTIONS # dummy
	def_bool y

endif
```

## release/src-rt-5.04behnd.4916/bootloaders/u-boot-2024.04/board/hisilicon/hikey960/Kconfig
```kconfig
if TARGET_HIKEY960

config SYS_BOARD
	default "hikey960"

config SYS_VENDOR
	default "hisilicon"

config SYS_SOC
	default "hi3660"

config SYS_CONFIG_NAME
	default "hikey960"

endif
```

## release/src-rt-5.04behnd.4916/bootloaders/u-boot-2024.04/board/hisilicon/poplar/Kconfig
```kconfig
if TARGET_POPLAR

config SYS_BOARD
	default "poplar"

config SYS_VENDOR
	default "hisilicon"

config SYS_SOC
	default "hi3798cv200"

config SYS_CONFIG_NAME
	default "poplar"

endif
```

## release/src-rt-5.04behnd.4916/bootloaders/u-boot-2024.04/board/hoperun/hihope-rzg2/Kconfig
```kconfig
if TARGET_HIHOPE_RZG2

config SYS_SOC
	default "renesas"

config SYS_BOARD
	default "hihope-rzg2"

config SYS_VENDOR
	default "hoperun"

config SYS_CONFIG_NAME
	default "hihope-rzg2"

endif
```

## release/src-rt-5.04behnd.4916/bootloaders/u-boot-2024.04/board/hpe/gxp/Kconfig
```kconfig
choice
	prompt "SoC select"

config TARGET_GXP
	bool "GXP"
	select DM
	select SOC_GXP
	imply CMD_DM

config TARGET_GXP2
	bool "GXP2"
	select DM
	select SOC_GXP
	select GXP_ECC
	imply CMD_DM

endchoice

choice
	prompt "GXP VROM size"
	default GXP_VROM_64MB
	optional

config GXP_VROM_64MB
	bool "64MB"

config GXP_VROM_32MB
	bool "32MB"
endchoice

config GXP_ECC
	bool "Enable memory ECC protected"
	help
	  Use half of memory to enable ECC protected

config SYS_BOARD
	default "gxp"

config SYS_VENDOR
	default "hpe"

config SYS_CONFIG_NAME
	default "gxp"

config TEXT_BASE
	default 0x50000000
```

## release/src-rt-5.04behnd.4916/bootloaders/u-boot-2024.04/board/htc/endeavoru/Kconfig
```kconfig
if TARGET_ENDEAVORU

config SYS_BOARD
	default "endeavoru"

config SYS_VENDOR
	default "htc"

config SYS_CONFIG_NAME
	default "endeavoru"

endif
```

## release/src-rt-5.04behnd.4916/bootloaders/u-boot-2024.04/board/huawei/hg556a/Kconfig
```kconfig
if BOARD_HUAWEI_HG556A

config SYS_BOARD
	default "hg556a"

config SYS_VENDOR
	default "huawei"

config SYS_CONFIG_NAME
	default "huawei_hg556a"

endif
```

## release/src-rt-5.04behnd.4916/bootloaders/u-boot-2024.04/board/imgtec/xilfpga/Kconfig
```kconfig
if TARGET_XILFPGA

config SYS_BOARD
	default "xilfpga"

config SYS_VENDOR
	default "imgtec"

config SYS_CONFIG_NAME
	default "imgtec_xilfpga"

config TEXT_BASE
	default 0x80C00000

endif
```

## release/src-rt-5.04behnd.4916/bootloaders/u-boot-2024.04/board/intel/cherryhill/Kconfig
```kconfig
if TARGET_CHERRYHILL

config SYS_BOARD
	default "cherryhill"

config SYS_VENDOR
	default "intel"

config SYS_SOC
	default "braswell"

config SYS_CONFIG_NAME
	default "cherryhill"

config TEXT_BASE
	default 0xffe00000

config BOARD_SPECIFIC_OPTIONS # dummy
	def_bool y
	select X86_RESET_VECTOR
	select INTEL_BRASWELL
	select BOARD_ROMSIZE_KB_8192
	select SPI_FLASH_MACRONIX

endif
```

## release/src-rt-5.04behnd.4916/bootloaders/u-boot-2024.04/board/intel/galileo/Kconfig
```kconfig
if TARGET_GALILEO

config SYS_BOARD
	default "galileo"

config SYS_VENDOR
	default "intel"

config SYS_SOC
	default "quark"

config SYS_CONFIG_NAME
	default "galileo"

config TEXT_BASE
	default 0xfff10000

config BOARD_SPECIFIC_OPTIONS # dummy
	def_bool y
	select X86_RESET_VECTOR
	select INTEL_QUARK
	select BOARD_ROMSIZE_KB_1024
	select SPI_FLASH_WINBOND

endif
```
