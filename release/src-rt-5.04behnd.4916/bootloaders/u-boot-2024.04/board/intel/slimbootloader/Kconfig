## release/src-rt-5.04behnd.4916/bootloaders/u-boot-2024.04/board/intel/slimbootloader/Kconfig
```kconfig
# SPDX-License-Identifier: GPL-2.0+
#
# Copyright (C) 2019 Intel Corporation <www.intel.com>

if TARGET_SLIMBOOTLOADER

config SYS_BOARD
	default "slimbootloader"

config SYS_VENDOR
	default "intel"

config SYS_SOC
	default "slimbootloader"

config SYS_CONFIG_NAME
	default "slimbootloader"

config TEXT_BASE
	default 0x00100000

config BOARD_SPECIFIC_OPTIONS
	def_bool y
	select SYS_SLIMBOOTLOADER
	select USB_STORAGE
	select USB_KEYBOARD

endif
```

## release/src-rt-5.04behnd.4916/bootloaders/u-boot-2024.04/board/inteno/xg6846/Kconfig
```kconfig
if BOARD_INTENO_XG6846

config SYS_BOARD
	default "xg6846"

config SYS_VENDOR
	default "inteno"

config SYS_CONFIG_NAME
	default "inteno_xg6846"

endif
```

## release/src-rt-5.04behnd.4916/bootloaders/u-boot-2024.04/board/inversepath/usbarmory/Kconfig
```kconfig
if TARGET_USBARMORY

config IMX_CONFIG
	default "board/inversepath/usbarmory/imximage.cfg"

config SYS_BOARD
	default "usbarmory"

config SYS_VENDOR
	default "inversepath"

config SYS_CONFIG_NAME
	default "usbarmory"

endif
```

## release/src-rt-5.04behnd.4916/bootloaders/u-boot-2024.04/board/iomega/iconnect/Kconfig
```kconfig
if TARGET_ICONNECT

config SYS_BOARD
	default "iconnect"

config SYS_VENDOR
	default "iomega"

config SYS_CONFIG_NAME
	default "iconnect"

endif
```

## release/src-rt-5.04behnd.4916/bootloaders/u-boot-2024.04/board/itead/sonoff-ihost/Kconfig
```kconfig
if TARGET_RV1126_SONOFF_IHOST

config SYS_BOARD
	default "sonoff-ihost"

config SYS_VENDOR
	default "itead"

config SYS_CONFIG_NAME
	default "sonoff-ihost"

config BOARD_SPECIFIC_OPTIONS # dummy
	def_bool y
	select RAM_ROCKCHIP_DDR4

endif
```

## release/src-rt-5.04behnd.4916/bootloaders/u-boot-2024.04/board/keymile/Kconfig
```kconfig
# SPDX-License-Identifier: GPL-2.0+
#
# Copyright (C) 2019, Pascal Linder <pascal.linder@edu.hefr.ch>

config VENDOR_KM
	bool
	help
	  Selected by any KM board to have additional configurations.

if VENDOR_KM

menu "KM Board Setup"

config SYS_I2C_INIT_BOARD
	def_bool y if ARM

config HUSH_INIT_VAR
	def_bool y

config KM_PNVRAM
	hex "Pseudo RAM"
	default 0x80000
	depends on !ARCH_SOCFPGA
	help
	  Start address of the pseudo non-volatile RAM for application.

config KM_PHRAM
	hex "Physical RAM"
	default 0x17F000 if ARM && !ARCH_LS1021A
	default 0x100000 if PPC || ARCH_LS1021A
	depends on !ARCH_SOCFPGA
	help
	  Start address of the physical RAM, which is the mounted /var folder.

config KM_RESERVED_PRAM
	hex "Reserved RAM"
	default 0x0 if MPC83xx
	default 0x1000 if MPC85xx || ARCH_LS1021A
	depends on !ARCH_SOCFPGA
	help
	  Reserved physical RAM area at the end of memory for special purposes.

config KM_CRAMFS_ADDR
	hex "CRAMFS Address"
	default 0x83000000 if ARCH_LS1021A
	default 0x3000000
	depends on !ARCH_SOCFPGA
	help
	  Start address of the CRAMFS containing the Linux kernel.

config KM_KERNEL_ADDR
	hex "Kernel Load Address"
	default 0x82000000 if ARCH_LS1021A
	default 0x2000000
	help
	  Address where to load Linux kernel in RAM.

config KM_FDT_ADDR
	hex "FDT Load Address"
	default 0x82FC0000 if ARCH_LS1021A
	default 0x2FC0000
	help
	  Address where to load flattened device tree in RAM.

config SYS_PAX_BASE
	hex "PAX IFC Base Address"
	default 0x78000000
	depends on ARCH_LS1021A
	help
	  IFC Base Address for PAXx FPGA.

config SYS_CLIPS_BASE
	hex "CLIPS IFC Base Address"
	default 0x78000000
	depends on ARCH_LS1021A
	help
	  IFC Base Address for CLIPS FPGA.

config KM_COMMON_ETH_INIT
	bool "Common Ethernet Initialization"
	default y if MPC83xx
	default n if MPC85xx || ARCH_SOCFPGA || ARCH_LS1021A
	help
	  Use the Ethernet initialization implemented in common code that
	  detects if a Piggy board is present.

config PIGGY_MAC_ADDRESS_OFFSET
	int "Piggy Address Offset"
	default 0
	help
	  MAC address offset for the Piggy board.

config KM_MVEXTSW_ADDR
	hex "Marvell Switch Address"
	depends on MV88E6352_SWITCH
	default 0x10
	help
	  Address of external Marvell switch.

config KM_IVM_BUS
	int "IVM I2C Bus"
	default 0 if ARCH_SOCFPGA
	default 1 if PPC || ARCH_LS1021A
	help
	  Identifier number of I2C bus, where the inventory EEPROM is connected to.

config SYS_IVM_EEPROM_ADR
	hex "IVM I2C Address"
	default 0x50
	help
	  I2C address of the EEPROM containing the inventory.

config SYS_IVM_EEPROM_MAX_LEN
	hex "IVM Length"
	default 0x400
	help
	  Maximum length of inventory in EEPROM.

config SYS_IVM_EEPROM_PAGE_LEN
	hex "IVM Page Size"
	default 0x100
	help
	  Page size of inventory in EEPROM.

config PG_WCOM_UBOOT_UPDATE_SUPPORTED
	bool "Enable U-Boot Field Fail-Safe Update Functionality"
	select EVENT
	help
	  Indicates that field fail-safe u-boot update is supported.
	  This functionality works only for designs that are booting
	  from parallel NOR flash.

config PG_WCOM_UBOOT_BOOTPACKAGE
	bool "U-Boot Is Part Of Factory Boot-Package Image"
	help
	  Indicates that u-boot will be a part of the factory programmed
	  boot-package image.
	  Has to be set for original u-boot programmed at factory.

config PG_WCOM_UBOOT_UPDATE_TEXT_BASE
	hex "Text Base For U-Boot Programmed Outside Factory"
	default 0xFFFFFFFF
	help
	  Text base of an updated u-boot that is not factory programmed but
	  later when the unit is rolled out on the field.
	  Has to be set for original u-boot programmed at factory.

config PG_WCOM_UBOOT_UPDATE
	bool "U-Boot Is Part Of Factory Boot-Package Image"
	help
	  Indicates that u-boot will be a part of the embedded software and
	  programmed at field.
	  Has to be set for updated u-boot version programmed at field.

source "board/keymile/km83xx/Kconfig"
source "board/keymile/kmcent2/Kconfig"
source "board/keymile/pg-wcom-ls102xa/Kconfig"

endmenu

endif
```

## release/src-rt-5.04behnd.4916/bootloaders/u-boot-2024.04/board/keymile/km83xx/Kconfig
```kconfig
menu "KM 83xx Options"
	depends on MPC83xx

config KM_ENABLE_FULL_DM_DTS_SUPPORT
	bool "enable full DM/DTS support for KM 83xx boards"
	default y
	select CMD_DM
	select DM
	select DM_MDIO
	select DM_SERIAL
	select OF_CONTROL
	select PINCTRL
	select PINCTRL_QE
	select PHYLIB
endmenu

config SYS_MEMTEST_START
	default 0x00100000

config SYS_MEMTEST_END
	default 0x00f00000

if TARGET_KMETER1

config SYS_BOARD
	default "km83xx"

config SYS_VENDOR
	default "keymile"

config SYS_CONFIG_NAME
	default "kmeter1"

config BOARD_SPECIFIC_OPTIONS # dummy
	def_bool y
	select ARCH_MPC8360
	imply CMD_CRAMFS
	imply CMD_DIAG
	imply FS_CRAMFS

endif

if TARGET_KMCOGE5NE

config SYS_BOARD
	default "km83xx"

config SYS_VENDOR
	default "keymile"

config SYS_CONFIG_NAME
	default "kmcoge5ne"

config BOARD_SPECIFIC_OPTIONS # dummy
	def_bool y
	select ARCH_MPC8360
	imply CMD_CRAMFS
	imply CMD_DIAG
	imply FS_CRAMFS

endif

if TARGET_TUXX1

config SYS_BOARD
	default "km83xx"

config SYS_VENDOR
	default "keymile"

config SYS_CONFIG_NAME
	default "km832x"

config BOARD_SPECIFIC_OPTIONS # dummy
	def_bool y
	select ARCH_MPC832X
	imply CMD_CRAMFS
	imply FS_CRAMFS

endif

if TARGET_KMSUPX5

config SYS_BOARD
	default "km83xx"

config SYS_VENDOR
	default "keymile"

config SYS_CONFIG_NAME
	default "km832x"

config BOARD_SPECIFIC_OPTIONS # dummy
	def_bool y
	select ARCH_MPC832X
	imply CMD_CRAMFS
	imply FS_CRAMFS

endif

if TARGET_TUGE1

config SYS_BOARD
	default "km83xx"

config SYS_VENDOR
	default "keymile"

config SYS_CONFIG_NAME
	default "km832x"

config BOARD_SPECIFIC_OPTIONS # dummy
	def_bool y
	select ARCH_MPC832X
	imply CMD_CRAMFS
	imply FS_CRAMFS

endif

if TARGET_KMOPTI2

config SYS_BOARD
	default "km83xx"

config SYS_VENDOR
	default "keymile"

config SYS_CONFIG_NAME
	default "km832x"

config BOARD_SPECIFIC_OPTIONS # dummy
	def_bool y
	select ARCH_MPC832X
	imply CMD_CRAMFS
	imply FS_CRAMFS

endif

if TARGET_KMTEPR2

config SYS_BOARD
	default "km83xx"

config SYS_VENDOR
	default "keymile"

config SYS_CONFIG_NAME
	default "km832x"

config BOARD_SPECIFIC_OPTIONS # dummy
	def_bool y
	select ARCH_MPC832X
	imply CMD_CRAMFS
	imply FS_CRAMFS

endif
```

## release/src-rt-5.04behnd.4916/bootloaders/u-boot-2024.04/board/keymile/kmcent2/Kconfig
```kconfig
if TARGET_KMCENT2

config SYS_BOARD
	default "kmcent2"

config SYS_VENDOR
	default "keymile"

config SYS_CONFIG_NAME
	default "kmcent2"

config BOARD_SPECIFIC_OPTIONS
	def_bool y
	select ARCH_T1040
	select PHYS_64BIT

endif
```

## release/src-rt-5.04behnd.4916/bootloaders/u-boot-2024.04/board/keymile/pg-wcom-ls102xa/Kconfig
```kconfig
if TARGET_PG_WCOM_SELI8

config SYS_BOARD
	default "pg-wcom-ls102xa"

config SYS_VENDOR
	default "keymile"

config SYS_SOC
	default "ls102xa"

config SYS_CONFIG_NAME
	default "pg-wcom-seli8"

config BOARD_SPECIFIC_OPTIONS
	def_bool y
	imply FS_CRAMFS

endif

if TARGET_PG_WCOM_EXPU1

config SYS_BOARD
	default "pg-wcom-ls102xa"

config SYS_VENDOR
	default "keymile"

config SYS_SOC
	default "ls102xa"

config SYS_CONFIG_NAME
	default "pg-wcom-expu1"

config BOARD_SPECIFIC_OPTIONS
	def_bool y
	imply FS_CRAMFS

endif
```

## release/src-rt-5.04behnd.4916/bootloaders/u-boot-2024.04/board/kobol/helios4/Kconfig
```kconfig
menu "Helios4 configuration"
	depends on TARGET_HELIOS4

config ENV_SIZE
	hex "Environment Size"
	default 0x10000

config ENV_OFFSET
	hex "Environment offset"
	default 0xF0000

config ENV_SECT_SIZE
	hex "Environment Sector-Size"
	# Use SPI or SATA flash erase block size of 4 KiB
	default 0x1000 if MVEBU_SPL_BOOT_DEVICE_SPI || MVEBU_SPL_BOOT_DEVICE_SATA
	# Use optimistic 64 KiB erase block, will vary between actual media
	default 0x10000 if MVEBU_SPL_BOOT_DEVICE_MMC || MVEBU_SPL_BOOT_DEVICE_UART

endmenu
```

## release/src-rt-5.04behnd.4916/bootloaders/u-boot-2024.04/board/kontron/pitx_imx8m/Kconfig
```kconfig
if TARGET_KONTRON_PITX_IMX8M

config SYS_BOARD
	default "pitx_imx8m"

config SYS_VENDOR
	default "kontron"

config SYS_CONFIG_NAME
	default "kontron_pitx_imx8m"

config IMX_CONFIG
	default "arch/arm/mach-imx/imx8m/imximage.cfg"

endif
```

## release/src-rt-5.04behnd.4916/bootloaders/u-boot-2024.04/board/kontron/sl-mx6ul/Kconfig
```kconfig
if TARGET_KONTRON_MX6UL

config SYS_BOARD
	string
	default "sl-mx6ul"

config SYS_VENDOR
	string
	default "kontron"

config SYS_CONFIG_NAME
	string
	default "kontron-sl-mx6ul"

endif
```

## release/src-rt-5.04behnd.4916/bootloaders/u-boot-2024.04/board/kontron/sl-mx8mm/Kconfig
```kconfig
if TARGET_KONTRON_MX8MM

config SYS_BOARD
	string
	default "sl-mx8mm"

config SYS_VENDOR
	string
	default "kontron"

config SYS_CONFIG_NAME
	string
	default "kontron-sl-mx8mm"

endif
```

## release/src-rt-5.04behnd.4916/bootloaders/u-boot-2024.04/board/kontron/sl28/Kconfig
```kconfig
if TARGET_SL28

config SYS_BOARD
	default "sl28"

config SYS_VENDOR
	default "kontron"

config SYS_SOC
	default "fsl-layerscape"

config SYS_CONFIG_NAME
	default "kontron_sl28"

config TEXT_BASE
	default 0x96000000

config SL28_SPL_LOADS_ATF_BL31
	bool "SPL loads BL31 of the ARM Trusted Firmware"
	select SPL_ATF
	select SPL_ATF_LOAD_IMAGE_V2
	select ARMV8_SEC_FIRMWARE_SUPPORT
	select SEC_FIRMWARE_ARMV8_PSCI
	help
	  Enable this to load a BL31 image by the SPL. You have to
	  provde a bl31.bin in u-boot's root directory.

if SL28_SPL_LOADS_ATF_BL31

config SL28_BL31_ENTRY_ADDR
	hex "Entry point of the BL31 image"
	default 0xfbe00000

endif

config SL28_SPL_LOADS_OPTEE_BL32
	bool "SPL loads OP-TEE Trusted OS as BL32"
	depends on SL28_SPL_LOADS_ATF_BL31
	help
	  Enable this to load a BL32 image by the SPL. You have to
	  provde a tee.bin in u-boot's root directory.

if SL28_SPL_LOADS_OPTEE_BL32

config SL28_BL32_ENTRY_ADDR
	hex "Entry point of the BL32 image"
	default 0xfc000000

endif

config SL28_ENABLE_SER0_CONSOLE
	bool "Enable console output on SER0"
	select DM_SERIAL
	select SPL_DM_SERIAL
	select FSL_LPUART
	help
	  By default the console output of this board is on the second serial
	  line (SER1). Sometimes it is desirable to enable output on the first
	  serial line (SER0). For example, if you have a carrier which only
	  supports the first serial port.
endif
```

## release/src-rt-5.04behnd.4916/bootloaders/u-boot-2024.04/board/lg/sniper/Kconfig
```kconfig
if TARGET_SNIPER

config SYS_BOARD
	default "sniper"

config SYS_VENDOR
	default "lg"

config SYS_CONFIG_NAME
	default "sniper"

endif
```

## release/src-rt-5.04behnd.4916/bootloaders/u-boot-2024.04/board/lg/x3-t30/Kconfig
```kconfig
if TARGET_X3_T30

config SYS_BOARD
	default "x3-t30"

config SYS_VENDOR
	default "lg"

config SYS_CONFIG_NAME
	default "x3-t30"

endif
```

## release/src-rt-5.04behnd.4916/bootloaders/u-boot-2024.04/board/liebherr/xea/Kconfig
```kconfig
if TARGET_XEA

config SYS_BOARD
	default "xea"

config SYS_VENDOR
	default "liebherr"

config SYS_SOC
	default "mxs"

config SYS_CONFIG_NAME
	default "xea"

config ENV_SIZE
	default 0x2000

config ENV_SECT_SIZE
	default 0x10000 if ENV_IS_IN_SPI_FLASH

config ENV_OFFSET
	default 0x80000 if ENV_IS_IN_SPI_FLASH

endif
```

## release/src-rt-5.04behnd.4916/bootloaders/u-boot-2024.04/board/menlo/m53menlo/Kconfig
```kconfig
if TARGET_M53MENLO

config SYS_BOARD
	default "m53menlo"

config SYS_VENDOR
	default "menlo"

config SYS_SOC
	default "mx5"

config SYS_CONFIG_NAME
	default "m53menlo"

config IMX_CONFIG
	default "board/menlo/m53menlo/imximage.cfg"

endif
```

## release/src-rt-5.04behnd.4916/bootloaders/u-boot-2024.04/board/menlo/mx8menlo/Kconfig
```kconfig
if TARGET_IMX8MM_MX8MENLO

config SYS_BOARD
	default "mx8menlo"

config SYS_VENDOR
	default "menlo"

config SYS_CONFIG_NAME
	default "imx8mm-mx8menlo"

config TDX_CFG_BLOCK
	default y

config TDX_CFG_BLOCK_EXTRA
	default y

config TDX_HAVE_MMC
	default y

config TDX_HAVE_EEPROM_EXTRA
	default y

config TDX_CFG_BLOCK_DEV
	default "0"

config TDX_CFG_BLOCK_PART
	default "1"

# Toradex config block in eMMC, at the end of 1st "boot sector"
config TDX_CFG_BLOCK_OFFSET
	default "-512"

config IMX_CONFIG
	default "board/toradex/verdin-imx8mm/imximage.cfg"

source "board/toradex/common/Kconfig"

endif
```

## release/src-rt-5.04behnd.4916/bootloaders/u-boot-2024.04/board/microchip/mpfs_icicle/Kconfig
```kconfig
if TARGET_MICROCHIP_ICICLE

config SYS_BOARD
	default "mpfs_icicle"

config SYS_VENDOR
	default "microchip"

config SYS_CPU
	default "generic"

config SYS_CONFIG_NAME
	default "microchip_mpfs_icicle"

config TEXT_BASE
	default 0x80000000 if !RISCV_SMODE
	default 0x80200000 if RISCV_SMODE

config BOARD_SPECIFIC_OPTIONS # dummy
	def_bool y
	select GENERIC_RISCV
	select BOARD_EARLY_INIT_F
	select BOARD_LATE_INIT
	imply SMP
	imply CLK_CCF
	imply CLK_MPFS
	imply SYS_NS16550
	imply CMD_DHCP
	imply CMD_EXT2
	imply CMD_EXT4
	imply CMD_FAT
	imply CMD_FS_GENERIC
	imply CMD_NET
	imply CMD_PING
	imply CMD_MMC
	imply DOS_PARTITION
	imply EFI_PARTITION
	imply IP_DYN
	imply ISO_PARTITION
	imply MACB
	imply MII
	imply PHY_LIB
	imply PHY_VITESSE
	imply MMC
	imply MMC_WRITE
	imply MMC_SDHCI
	imply MMC_SDHCI_CADENCE
	imply MMC_SDHCI_ADMA
	imply MMC_HS200_SUPPORT
	imply CMD_I2C
	imply DM_I2C
	imply SYS_I2C_MICROCHIP
	imply MTD
	imply SPI
	imply DM_SPI
	imply MICROCHIP_COREQSPI
	imply MTD_SPI_NAND
	imply CMD_MTD
	imply CMD_MTDPARTS

endif
```

## release/src-rt-5.04behnd.4916/bootloaders/u-boot-2024.04/board/microchip/pic32mzda/Kconfig
```kconfig
if TARGET_PIC32MZDASK

config SYS_BOARD
	default "pic32mzda"

config SYS_VENDOR
	default "microchip"

config SYS_CONFIG_NAME
	default "pic32mzdask"

config TEXT_BASE
	default 0x9d004000

endif
```

## release/src-rt-5.04behnd.4916/bootloaders/u-boot-2024.04/board/mntre/imx8mq_reform2/Kconfig
```kconfig
if TARGET_IMX8MQ_REFORM2

config SYS_BOARD
	default "imx8mq_reform2"

config SYS_VENDOR
	default "mntre"

config SYS_CONFIG_NAME
	default "imx8mq_reform2"

config IMX_CONFIG
	default "arch/arm/mach-imx/imx8m/imximage.cfg"

endif
```
