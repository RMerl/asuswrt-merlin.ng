## release/src-rt-5.04behnd.4916/bootloaders/u-boot-2024.04/board/msc/sm2s_imx8mp/Kconfig
```kconfig
if TARGET_MSC_SM2S_IMX8MP

config SYS_BOARD
	default "sm2s_imx8mp"

config SYS_VENDOR
	default "msc"

config SYS_CONFIG_NAME
	default "msc_sm2s_imx8mp"

config IMX_CONFIG
	default "board/msc/sm2s_imx8mp/imximage-8mp-lpddr4.cfg"

endif
```

## release/src-rt-5.04behnd.4916/bootloaders/u-boot-2024.04/board/mscc/luton/Kconfig
```kconfig
# SPDX-License-Identifier: (GPL-2.0+ OR MIT)

if SOC_LUTON

config SYS_VENDOR
	default "mscc"

config SYS_BOARD
	default "luton"

config SYS_CONFIG_NAME
	default "luton"

endif
```

## release/src-rt-5.04behnd.4916/bootloaders/u-boot-2024.04/board/mscc/serval/Kconfig
```kconfig
# SPDX-License-Identifier: (GPL-2.0+ OR MIT)

config SYS_VENDOR
	default "mscc"

if SOC_SERVAL

config SYS_BOARD
	default "serval"

config SYS_CONFIG_NAME
	default "serval"

endif
```
