## release/src-rt-5.04behnd.4916/bootloaders/u-boot-2024.04/board/mscc/servalt/Kconfig
```kconfig
# SPDX-License-Identifier: (GPL-2.0+ OR MIT)

config SYS_VENDOR
	default "mscc"

if SOC_SERVALT

config SYS_BOARD
	default "servalt"

config SYS_CONFIG_NAME
	default "servalt"

endif
```

## release/src-rt-5.04behnd.4916/bootloaders/u-boot-2024.04/board/myir/mys_6ulx/Kconfig
```kconfig
if TARGET_MYS_6ULX

config SYS_BOARD
	default "mys_6ulx"

config SYS_VENDOR
	default "myir"

config SYS_CONFIG_NAME
	default "mys_6ulx"

endif
```

## release/src-rt-5.04behnd.4916/bootloaders/u-boot-2024.04/board/netgear/dgnd3700v2/Kconfig
```kconfig
if BOARD_NETGEAR_DGND3700V2

config SYS_BOARD
	default "dgnd3700v2"

config SYS_VENDOR
	default "netgear"

config SYS_CONFIG_NAME
	default "netgear_dgnd3700v2"

endif
```

## release/src-rt-5.04behnd.4916/bootloaders/u-boot-2024.04/board/novtech/meerkat96/Kconfig
```kconfig
if TARGET_MEERKAT96

config SYS_BOARD
	default "meerkat96"

config SYS_VENDOR
	default "novtech"

config SYS_CONFIG_NAME
	default "meerkat96"

config IMX_CONFIG
	default "board/novtech/meerkat96/imximage.cfg"

endif
```

## release/src-rt-5.04behnd.4916/bootloaders/u-boot-2024.04/board/nuvoton/arbel_evb/Kconfig
```kconfig
if TARGET_ARBEL_EVB

config SYS_BOARD
	default "arbel_evb"

config SYS_VENDOR
	default "nuvoton"

config SYS_CONFIG_NAME
	default "arbel"

config SYS_MEM_TOP_HIDE
	hex "Reserved TOP memory"
	default 0x0
	help
	  Reserve memory for ECC/GFX/OPTEE/TIP/CP.

source "board/nuvoton/common/Kconfig"
endif
```

## release/src-rt-5.04behnd.4916/bootloaders/u-boot-2024.04/board/nuvoton/common/Kconfig
```kconfig
if ARCH_NPCM

config SYS_SKIP_UART_INIT
	bool "Skip UART initialization"
	depends on NPCM_SERIAL
	help
	  Select this if the UART you want to use is already
	  initialized by the time U-Boot starts its execution.
endif
```

## release/src-rt-5.04behnd.4916/bootloaders/u-boot-2024.04/board/nuvoton/poleg_evb/Kconfig
```kconfig
if TARGET_POLEG

config SYS_BOARD
	default "poleg_evb"

config SYS_VENDOR
	default "nuvoton"

config SYS_CONFIG_NAME
	default "poleg"

choice
	prompt "Target board select"
	default TARGET_POLEG_EVB

config TARGET_POLEG_EVB
	bool "Poleg EVB"
	help
	  poleg EVB is Nuvoton evaluation board for NPCM750 SoC,
	  supports general functions of Basebase Management
	  Controller(BMC).

endchoice

source "board/nuvoton/common/Kconfig"
endif
```

## release/src-rt-5.04behnd.4916/bootloaders/u-boot-2024.04/board/nvidia/dalmore/Kconfig
```kconfig
if TARGET_DALMORE

config SYS_BOARD
	default "dalmore"

config SYS_VENDOR
	default "nvidia"

config SYS_CONFIG_NAME
	default "dalmore"

endif
```

## release/src-rt-5.04behnd.4916/bootloaders/u-boot-2024.04/board/nvidia/harmony/Kconfig
```kconfig
if TARGET_HARMONY

config SYS_BOARD
	default "harmony"

config SYS_VENDOR
	default "nvidia"

config SYS_CONFIG_NAME
	default "harmony"

endif
```

## release/src-rt-5.04behnd.4916/bootloaders/u-boot-2024.04/board/nvidia/p2371-2180/Kconfig
```kconfig
if TARGET_P2371_2180

config SYS_BOARD
	default "p2371-2180"

config SYS_VENDOR
	default "nvidia"

config SYS_CONFIG_NAME
	default "p2371-2180"

endif
```

## release/src-rt-5.04behnd.4916/bootloaders/u-boot-2024.04/board/nvidia/p2571/Kconfig
```kconfig
if TARGET_P2571

config SYS_BOARD
	default "p2571"

config SYS_VENDOR
	default "nvidia"

config SYS_CONFIG_NAME
	default "p2571"

endif
```

## release/src-rt-5.04behnd.4916/bootloaders/u-boot-2024.04/board/nvidia/p3450-0000/Kconfig
```kconfig
if TARGET_P3450_0000

config SYS_BOARD
	default "p3450-0000"

config SYS_VENDOR
	default "nvidia"

config SYS_CONFIG_NAME
	default "p3450-0000"

endif
```

## release/src-rt-5.04behnd.4916/bootloaders/u-boot-2024.04/board/nvidia/ventana/Kconfig
```kconfig
if TARGET_VENTANA

config SYS_BOARD
	default "ventana"

config SYS_VENDOR
	default "nvidia"

config SYS_CONFIG_NAME
	default "ventana"

endif
```

## release/src-rt-5.04behnd.4916/bootloaders/u-boot-2024.04/board/openpiton/riscv64/Kconfig
```kconfig
if TARGET_OPENPITON_RISCV64

config SYS_BOARD
	default "riscv64"

config SYS_VENDOR
	default "openpiton"

config SYS_CPU
	default "generic"

config SYS_CONFIG_NAME
	default "openpiton-riscv64"

config TEXT_BASE
	default 0x81000000 if SPL
	default 0x80000000 if !RISCV_SMODE
	default 0x81000000 if RISCV_SMODE

config SPL_TEXT_BASE
	default 0x82000000

config SPL_OPENSBI_LOAD_ADDR
	default 0x80000000

config BOARD_SPECIFIC_OPTIONS # dummy
	def_bool y
	select ARCH_EARLY_INIT_R
	select SUPPORT_SPL
	imply CPU_RISCV
	imply RISCV_TIMER
	imply SPL_RISCV_ACLINT
	imply CMD_CPU
	imply SPL_CPU_SUPPORT
	imply SPL_SMP
	imply SPL_MMC
	imply SMP
	imply SPL_RISCV_MMODE

endif
```

## release/src-rt-5.04behnd.4916/bootloaders/u-boot-2024.04/board/out4/o4-imx6ull-nano/Kconfig
```kconfig
if TARGET_O4_IMX6ULL_NANO

config SYS_BOARD
	default "o4-imx6ull-nano"

config SYS_VENDOR
	default "out4"

config SYS_CONFIG_NAME
	default "o4-imx6ull-nano"

choice
	prompt "Memory model"
	default K4B4G1646D_BCMA
	help
	    Memory type setup.

	    Please choose correct memory model here.

config K4B4G1646D_BCMA
	bool "K4B4G1646D-BCMA 256Mx16 (512 MiB/chip)"
	help
	    Samsung DDR3 SDRAM
	    K4B4G1646D-BCMA

config MT41K256M16HA_125E
	bool "MT41K256M16HA-125:E 256Mx16 (512 MiB/chip)"
	help
	    Micron DDR3L SDRAM
	    MT41K256M16HA-125:E

endchoice

choice
	prompt "Mainboard model"
	default O4_IMX_NANO
	help
	    Mainboard setup.

	    Please choose correct main board model here.

config O4_IMX_NANO
	bool "O4-iMX-NANO"
	help
	    A baseboard for EV-iMX280-NANO module:
	    https://out4.ru/products/board/18-o4-imx-nano.html

config EV_IMX280_NANO_X_MB
	bool "EV-IMX280-NANO-X-MB"
	help
	    A simple baseboard for EV-iMX280-NANO module:
	    http://evodbg.net/products/mx28-eval-kits/14-ev-imx280-nano-x-mb.html

endchoice

config IMX_CONFIG
	default "board/out4/o4-imx6ull-nano/K4B4G1646D-BCMA.cfg" if K4B4G1646D_BCMA
	default "board/out4/o4-imx6ull-nano/MT41K256M16HA-125E.cfg" if MT41K256M16HA_125E

config DEFAULT_DEVICE_TREE
	default "o4-imx-nano" if O4_IMX_NANO
	default "ev-imx280-nano-x-mb" if EV_IMX280_NANO_X_MB

endif
```

## release/src-rt-5.04behnd.4916/bootloaders/u-boot-2024.04/board/phytec/common/Kconfig
```kconfig
config PHYTEC_SOM_DETECTION
	bool "Support SoM detection for PHYTEC platforms"
	select SPL_CRC8 if SPL
	help
	   Support of I2C EEPROM based SoM detection.

config PHYTEC_IMX8M_SOM_DETECTION
	bool "Support SoM detection for i.MX8M PHYTEC platforms"
	depends on ARCH_IMX8M && PHYTEC_SOM_DETECTION
	default y
	help
	  Support of I2C EEPROM based SoM detection. Supported
	  for PHYTEC i.MX8MM/i.MX8MP boards
```

## release/src-rt-5.04behnd.4916/bootloaders/u-boot-2024.04/board/phytec/phycore_am335x_r2/Kconfig
```kconfig
if TARGET_PCM051 || TARGET_PHYCORE_AM335X_R2

config SYS_BOARD
	default "phycore_am335x_r2"

config SYS_VENDOR
	default "phytec"

config SYS_SOC
	default "am33xx"

config SYS_CONFIG_NAME
	default "phycore_am335x_r2"

endif
```

## release/src-rt-5.04behnd.4916/bootloaders/u-boot-2024.04/board/phytec/phycore_am62x/Kconfig
```kconfig
# SPDX-License-Identifier:     GPL-2.0+
#
# Copyright (C) 2022 - 2023 PHYTEC Messtechnik GmbH
# Author: Wadim Egorov <w.egorov@phytec.de>

if TARGET_PHYCORE_AM62X_A53

config SYS_BOARD
       default "phycore_am62x"

config SYS_VENDOR
       default "phytec"

config SYS_CONFIG_NAME
       default "phycore_am62x"

endif

if TARGET_PHYCORE_AM62X_R5

config SYS_BOARD
       default "phycore_am62x"

config SYS_VENDOR
       default "phytec"

config SYS_CONFIG_NAME
       default "phycore_am62x"

config SPL_LDSCRIPT
	default "arch/arm/mach-omap2/u-boot-spl.lds"

endif
```

## release/src-rt-5.04behnd.4916/bootloaders/u-boot-2024.04/board/phytec/phycore_imx8mm/Kconfig
```kconfig
if TARGET_PHYCORE_IMX8MM

config SYS_BOARD
	default "phycore_imx8mm"

config SYS_VENDOR
	default "phytec"

config SYS_CONFIG_NAME
	default "phycore_imx8mm"

config IMX_CONFIG
	default "board/phytec/phycore_imx8mm/imximage-8mm-sd.cfg"

endif
```

## release/src-rt-5.04behnd.4916/bootloaders/u-boot-2024.04/board/phytec/phycore_imx8mp/Kconfig
```kconfig
if TARGET_PHYCORE_IMX8MP

config SYS_BOARD
	default "phycore_imx8mp"

config SYS_VENDOR
	default "phytec"

config SYS_CONFIG_NAME
	default "phycore_imx8mp"

config IMX_CONFIG
	default "board/phytec/phycore_imx8mp/imximage-8mp-sd.cfg"

source "board/phytec/common/Kconfig"
endif
```

## release/src-rt-5.04behnd.4916/bootloaders/u-boot-2024.04/board/phytec/phycore_imx93/Kconfig
```kconfig
if TARGET_PHYCORE_IMX93

config SYS_BOARD
	default "phycore_imx93"

config SYS_VENDOR
	default "phytec"

config SYS_CONFIG_NAME
	default "phycore_imx93"

endif
```

## release/src-rt-5.04behnd.4916/bootloaders/u-boot-2024.04/board/phytec/phycore_rk3288/Kconfig
```kconfig
if TARGET_PHYCORE_RK3288

config SYS_BOARD
	default "phycore_rk3288"

config SYS_VENDOR
	default "phytec"

config SYS_CONFIG_NAME
	default "phycore_rk3288"

config BOARD_SPECIFIC_OPTIONS # dummy
	def_bool y

endif
```

## release/src-rt-5.04behnd.4916/bootloaders/u-boot-2024.04/board/phytium/durian/Kconfig
```kconfig
if TARGET_DURIAN

config SYS_BOARD
	default "durian"

config SYS_VENDOR
	default "phytium"

config SYS_CONFIG_NAME
	default "durian"

endif
```

## release/src-rt-5.04behnd.4916/bootloaders/u-boot-2024.04/board/phytium/pe2201/Kconfig
```kconfig
if TARGET_PE2201

config SYS_BOARD
	default "pe2201"

config SYS_VENDOR
	default "phytium"

config SYS_CONFIG_NAME
	default "pe2201"

endif
```

## release/src-rt-5.04behnd.4916/bootloaders/u-boot-2024.04/board/phytium/pomelo/Kconfig
```kconfig
if TARGET_POMELO

config SYS_BOARD
	default "pomelo"

config SYS_VENDOR
	default "phytium"

config SYS_CONFIG_NAME
	default "pomelo"

endif
```
