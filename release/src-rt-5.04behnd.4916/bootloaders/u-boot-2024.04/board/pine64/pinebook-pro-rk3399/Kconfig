## release/src-rt-5.04behnd.4916/bootloaders/u-boot-2024.04/board/pine64/pinebook-pro-rk3399/Kconfig
```kconfig
if TARGET_PINEBOOK_PRO_RK3399

config SYS_BOARD
	default "pinebook-pro-rk3399"

config SYS_VENDOR
	default "pine64"

config SYS_CONFIG_NAME
	default "pinebook-pro-rk3399"

config BOARD_SPECIFIC_OPTIONS
	def_bool y

endif
```

## release/src-rt-5.04behnd.4916/bootloaders/u-boot-2024.04/board/pine64/pinephone-pro-rk3399/Kconfig
```kconfig
if TARGET_PINEPHONE_PRO_RK3399

config SYS_BOARD
	default "pinephone-pro-rk3399"

config SYS_VENDOR
	default "pine64"

config SYS_CONFIG_NAME
	default "pinephone-pro-rk3399"

config BOARD_SPECIFIC_OPTIONS
	def_bool y

endif
```

## release/src-rt-5.04behnd.4916/bootloaders/u-boot-2024.04/board/pine64/quartz64_rk3566/Kconfig
```kconfig
if TARGET_QUARTZ64_RK3566

config SYS_BOARD
	default "quartz64_rk3566"

config SYS_VENDOR
	default "pine64"

config SYS_CONFIG_NAME
	default "quartz64_rk3566"

config BOARD_SPECIFIC_OPTIONS # dummy
	def_bool y

endif
```

## release/src-rt-5.04behnd.4916/bootloaders/u-boot-2024.04/board/pine64/quartzpro64-rk3588/Kconfig
```kconfig
if TARGET_QUARTZPRO64_RK3588

config SYS_BOARD
	default "quartzpro64-rk3588"

config SYS_VENDOR
	default "pine64"

config SYS_CONFIG_NAME
	default "quartzpro64-rk3588"

config BOARD_SPECIFIC_OPTIONS # dummy
	def_bool y

endif
```

## release/src-rt-5.04behnd.4916/bootloaders/u-boot-2024.04/board/pine64/rockpro64_rk3399/Kconfig
```kconfig
if TARGET_ROCKPRO64_RK3399

config SYS_BOARD
	default "rockpro64_rk3399"

config SYS_VENDOR
	default "pine64"

config SYS_CONFIG_NAME
	default "rockpro64_rk3399"

config BOARD_SPECIFIC_OPTIONS # dummy
	def_bool y

endif
```

## release/src-rt-5.04behnd.4916/bootloaders/u-boot-2024.04/board/polyhex/imx8mp_debix_model_a/Kconfig
```kconfig
if TARGET_IMX8MP_DEBIX_MODEL_A

config SYS_BOARD
	default "imx8mp_debix_model_a"

config SYS_VENDOR
	default "polyhex"

config SYS_CONFIG_NAME
	default "imx8mp_debix_model_a"

config IMX_CONFIG
	default "board/polyhex/imx8mp_debix_model_a/imximage-8mp-lpddr4.cfg"

endif
```

## release/src-rt-5.04behnd.4916/bootloaders/u-boot-2024.04/board/purism/librem5/Kconfig
```kconfig
if TARGET_LIBREM5

config SYS_BOARD
	default "librem5"

config SYS_VENDOR
	default "purism"

config SYS_CONFIG_NAME
	default "librem5"

config IMX_CONFIG
	default "board/purism/librem5/imximage-8mq-lpddr4.cfg"

endif
```

## release/src-rt-5.04behnd.4916/bootloaders/u-boot-2024.04/board/qualcomm/dragonboard845c/Kconfig
```kconfig
if TARGET_DRAGONBOARD845C

config SYS_BOARD
	default "dragonboard845c"

config SYS_CONFIG_NAME
	default "dragonboard845c"

config SYS_VENDOR
	default "qualcomm"

endif
```

## release/src-rt-5.04behnd.4916/bootloaders/u-boot-2024.04/board/qualcomm/dragonboard845c/db845c.its
```
/*
 * U-Boot uImage source file with multiple kernels, ramdisks and FDT blobs
 */

/dts-v1/;

/ {
	description = "Various kernels, ramdisks and FDT blobs";
	#address-cells = <1>;

	images {
		kernel-1 {
			description = "5.15.0-qcomlt-arm64";
			data = /incbin/("./db845c_imgs/Image.gz--5.15-r0-dragonboard-845c-20211218193034-511.bin");
			type = "kernel";
			arch = "arm64";
			os = "linux";
			compression = "gzip";
			load = <0x80000000>;
			entry = <0x80000000>;
			hash-1 {
				algo = "sha1";
			};
		};

		ramdisk-1 {
			description = "initramfs-test-full-image-dragonboard-845c";
			data = /incbin/("./db845c_imgs/initramfs-test-full-image-dragonboard-845c-20211218193034-511.rootfs.cpio.gz");
			type = "ramdisk";
			arch = "arm64";
			os = "linux";
			compression = "gzip";
			load = <00000000>;
			entry = <00000000>;
			hash-1 {
				algo = "sha1";
			};
		};

		fdt-1 {
			description = "sdm845-db845c-fdt";
			data = /incbin/("./db845c_imgs/sdm845-db845c--5.15-r0-dragonboard-845c-20211218193034.dtb");
			type = "flat_dt";
			arch = "arm64";
			compression = "none";
			hash-1 {
				algo = "sha1";
			};
		};

	};

	configurations {
		default = "config-1";

		config-1 {
			description = "db845c kernel-5.15.0 configuration";
			kernel = "kernel-1";
			ramdisk = "ramdisk-1";
			fdt = "fdt-1";
		};
	};
};
```

## release/src-rt-5.04behnd.4916/bootloaders/u-boot-2024.04/board/qualcomm/qcs404-evb/Kconfig
```kconfig
if TARGET_QCS404EVB

config SYS_BOARD
	default "qcs404-evb"

config SYS_VENDOR
	default "qualcomm"

config SYS_SOC
	default "qcs404"

config SYS_CONFIG_NAME
	default "qcs404-evb"

endif
```

## release/src-rt-5.04behnd.4916/bootloaders/u-boot-2024.04/board/qualcomm/qcs404-evb/qcs404-evb.its
```
/*
 * U-Boot uImage source file with multiple kernels, ramdisks and FDT blobs
 */

/dts-v1/;

/ {
	description = "Various kernels, ramdisks and FDT blobs";
	#address-cells = <1>;

	images {
		kernel-1 {
			description = "5.18.0-rc1";
			data = /incbin/("./qcs404_imgs/Image.gz");
			type = "kernel";
			arch = "arm64";
			os = "linux";
			compression = "gzip";
			load = <0x80000000>;
			entry = <0x80000000>;
			hash-1 {
				algo = "sha1";
			};
		};

		ramdisk-1 {
			description = "Initial ramdisk";
			data = /incbin/("./qcs404_imgs/initramfs-tiny-image-qemuarm64-20220618074058-1169.rootfs.cpio.gz");
			type = "ramdisk";
			arch = "arm64";
			os = "linux";
			compression = "gzip";
			load = <00000000>;
			entry = <00000000>;
			hash-1 {
				algo = "sha1";
			};
		};

		fdt-1 {
			description = "qcs404-evb-fdt";
			data = /incbin/("./qcs404_imgs/qcs404-evb-4000.dtb");
			type = "flat_dt";
			arch = "arm64";
			compression = "none";
			load = <0x83000000>;
			hash-1 {
				algo = "sha1";
			};
		};

	};

	configurations {
		default = "config-1";

		config-1 {
			description = "qcs404-evb kernel-5.18.0-rc1 configuration";
			kernel = "kernel-1";
			ramdisk = "ramdisk-1";
			fdt = "fdt-1";
		};
	};
};
```

## release/src-rt-5.04behnd.4916/bootloaders/u-boot-2024.04/board/radxa/rock5a-rk3588s/Kconfig
```kconfig
if TARGET_ROCK5A_RK3588

config SYS_BOARD
	default "rock5a-rk3588s"

config SYS_VENDOR
	default "radxa"

config SYS_CONFIG_NAME
	default "rock5a-rk3588s"

config BOARD_SPECIFIC_OPTIONS # dummy
	def_bool y

endif
```

## release/src-rt-5.04behnd.4916/bootloaders/u-boot-2024.04/board/radxa/rock5b-rk3588/Kconfig
```kconfig
if TARGET_ROCK5B_RK3588

config SYS_BOARD
	default "rock5b-rk3588"

config SYS_VENDOR
	default "radxa"

config SYS_CONFIG_NAME
	default "rock5b-rk3588"

config BOARD_SPECIFIC_OPTIONS # dummy
	def_bool y

endif
```

## release/src-rt-5.04behnd.4916/bootloaders/u-boot-2024.04/board/raspberrypi/rpi/Kconfig
```kconfig
if SYS_BOARD = "rpi"

config RPI_EFI_NR_SPIN_PAGES
	int "Spin table page count"
	default 1
	help
	  Number of pages to reserve starting at page 0 for spin tables in the EFI
	  memory map

endif
```

## release/src-rt-5.04behnd.4916/bootloaders/u-boot-2024.04/board/renesas/condor/Kconfig
```kconfig
if TARGET_CONDOR

config SYS_SOC
	default "renesas"

config SYS_BOARD
	default "condor"

config SYS_VENDOR
	default "renesas"

config SYS_CONFIG_NAME
	default "condor"

endif
```

## release/src-rt-5.04behnd.4916/bootloaders/u-boot-2024.04/board/renesas/eagle/Kconfig
```kconfig
if TARGET_EAGLE

config SYS_SOC
	default "renesas"

config SYS_BOARD
	default "eagle"

config SYS_VENDOR
	default "renesas"

config SYS_CONFIG_NAME
	default "rcar-gen3-common"

endif
```

## release/src-rt-5.04behnd.4916/bootloaders/u-boot-2024.04/board/renesas/ebisu/Kconfig
```kconfig
if TARGET_EBISU

config SYS_SOC
	default "renesas"

config SYS_BOARD
	default "ebisu"

config SYS_VENDOR
	default "renesas"

config SYS_CONFIG_NAME
	default "ebisu"

endif
```

## release/src-rt-5.04behnd.4916/bootloaders/u-boot-2024.04/board/renesas/falcon/Kconfig
```kconfig
if TARGET_FALCON

config SYS_SOC
	default "renesas"

config SYS_BOARD
	default "falcon"

config SYS_VENDOR
	default "renesas"

config SYS_CONFIG_NAME
	default "falcon"

endif
```

## release/src-rt-5.04behnd.4916/bootloaders/u-boot-2024.04/board/renesas/grayhawk/Kconfig
```kconfig
if TARGET_GRAYHAWK

config SYS_SOC
	default "renesas"

config SYS_BOARD
	default "grayhawk"

config SYS_VENDOR
	default "renesas"

config SYS_CONFIG_NAME
	default "grayhawk"

endif
```

## release/src-rt-5.04behnd.4916/bootloaders/u-boot-2024.04/board/renesas/lager/Kconfig
```kconfig
if TARGET_LAGER

config SYS_BOARD
	default "lager"

config SYS_VENDOR
	default "renesas"

config SYS_CONFIG_NAME
	default "lager"

endif
```

## release/src-rt-5.04behnd.4916/bootloaders/u-boot-2024.04/board/renesas/rzg2l/Kconfig
```kconfig
# Copyright (C) 2023 Renesas Electronics Corporation
# SPDX-License-Identifier: GPL-2.0+

if TARGET_RZG2L_SMARC_EVK

config SYS_SOC
	default "renesas"

config SYS_BOARD
	default "rzg2l"

config SYS_VENDOR
	default "renesas"

config SYS_CONFIG_NAME
	default "rzg2l-smarc"

endif
```

## release/src-rt-5.04behnd.4916/bootloaders/u-boot-2024.04/board/renesas/spider/Kconfig
```kconfig
if TARGET_SPIDER

config SYS_SOC
	default "renesas"

config SYS_BOARD
	default "spider"

config SYS_VENDOR
	default "renesas"

config SYS_CONFIG_NAME
	default "spider"

endif
```

## release/src-rt-5.04behnd.4916/bootloaders/u-boot-2024.04/board/renesas/ulcb/Kconfig
```kconfig
if TARGET_ULCB

config SYS_SOC
	default "renesas"

config SYS_BOARD
	default "ulcb"

config SYS_VENDOR
	default "renesas"

config SYS_CONFIG_NAME
	default "ulcb"

endif
```

## release/src-rt-5.04behnd.4916/bootloaders/u-boot-2024.04/board/renesas/v3hsk/Kconfig
```kconfig
if TARGET_V3HSK

config SYS_SOC
	default "renesas"

config SYS_BOARD
	default "v3hsk"

config SYS_VENDOR
	default "renesas"

config SYS_CONFIG_NAME
	default "v3hsk"

endif
```

## release/src-rt-5.04behnd.4916/bootloaders/u-boot-2024.04/board/renesas/v3msk/Kconfig
```kconfig
if TARGET_V3MSK

config SYS_SOC
	default "renesas"

config SYS_BOARD
	default "v3msk"

config SYS_VENDOR
	default "renesas"

config SYS_CONFIG_NAME
	default "rcar-gen3-common"

endif
```
