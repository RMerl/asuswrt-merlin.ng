## release/src-rt-5.04behnd.4916/bootloaders/u-boot-2024.04/board/renesas/whitehawk/Kconfig
```kconfig
if TARGET_WHITEHAWK

config SYS_SOC
	default "renesas"

config SYS_BOARD
	default "whitehawk"

config SYS_VENDOR
	default "renesas"

config SYS_CONFIG_NAME
	default "whitehawk"

endif
```

## release/src-rt-5.04behnd.4916/bootloaders/u-boot-2024.04/board/rikomagic/mk808/Kconfig
```kconfig
if TARGET_MK808

config SYS_BOARD
	default "mk808"

config SYS_VENDOR
	default "rikomagic"

config SYS_CONFIG_NAME
	default "mk808"

config BOARD_SPECIFIC_OPTIONS # dummy
	def_bool y

endif
```

## release/src-rt-5.04behnd.4916/bootloaders/u-boot-2024.04/board/rockchip/evb_px30/Kconfig
```kconfig
if TARGET_EVB_PX30

config SYS_BOARD
	default "evb_px30"

config SYS_VENDOR
	default "rockchip"

config SYS_CONFIG_NAME
	default "evb_px30"

config BOARD_SPECIFIC_OPTIONS # dummy
	def_bool y

endif
```

## release/src-rt-5.04behnd.4916/bootloaders/u-boot-2024.04/board/rockchip/evb_rk3308/Kconfig
```kconfig
if TARGET_EVB_RK3308

config SYS_BOARD
	default "evb_rk3308"

config SYS_VENDOR
	default "rockchip"

config SYS_CONFIG_NAME
	default "evb_rk3308"

config BOARD_SPECIFIC_OPTIONS # dummy
	def_bool y

endif
```

## release/src-rt-5.04behnd.4916/bootloaders/u-boot-2024.04/board/rockchip/sheep_rk3368/Kconfig
```kconfig
if TARGET_SHEEP

config SYS_BOARD
	default "sheep_rk3368"

config SYS_VENDOR
	default "rockchip"

config SYS_CONFIG_NAME
	default "sheep_rk3368"

config BOARD_SPECIFIC_OPTIONS # dummy
	def_bool y

endif
```

## release/src-rt-5.04behnd.4916/bootloaders/u-boot-2024.04/board/ronetix/imx7-cm/Kconfig
```kconfig
if TARGET_IMX7_CM

config SYS_BOARD
	default "imx7-cm"

config SYS_VENDOR
	default "ronetix"

config SYS_SOC
	default "mx7"

config SYS_CONFIG_NAME
	default "imx7-cm"

endif
```

## release/src-rt-5.04behnd.4916/bootloaders/u-boot-2024.04/board/ronetix/imx8mq-cm/Kconfig
```kconfig
if TARGET_IMX8MQ_CM

config SYS_BOARD
	default "imx8mq-cm"

config SYS_VENDOR
	default "ronetix"

config SYS_CONFIG_NAME
	default "imx8mq_cm"

config IMX_CONFIG
	default "board/ronetix/imx8mq-cm/imximage-8mq-lpddr4.cfg"

endif
```

## release/src-rt-5.04behnd.4916/bootloaders/u-boot-2024.04/board/samsung/axy17lte/Kconfig
```kconfig
if TARGET_A5Y17LTE
config SYS_BOARD
	default "axy17lte"
	help
	  a5y17lte is a production board for SM-A520F phone on Exynos7880 SoC.

config SYS_VENDOR
	default "samsung"

config SYS_CONFIG_NAME
	default "exynos78x0-common"

config EXYNOS7880
    bool "Exynos 7880 SOC support"
    default y
endif

if TARGET_A7Y17LTE
config SYS_BOARD
	default "axy17lte"
	help
	  a7y17lte is a production board for SM-A720F phone on Exynos7880 SoC.

config SYS_VENDOR
	default "samsung"

config SYS_CONFIG_NAME
	default "exynos78x0-common"

config EXYNOS7880
    bool "Exynos 7880 SOC support"
    default y
endif

if TARGET_A3Y17LTE
config SYS_BOARD
	default "axy17lte"
	help
	  a3y17lte is a production board for SM-A320F phone on Exynos7870 SoC.

config SYS_VENDOR
	default "samsung"

config SYS_CONFIG_NAME
	default "exynos78x0-common"

config EXYNOS7870
    bool "Exynos 7870 SOC support"
    default y
endif
```

## release/src-rt-5.04behnd.4916/bootloaders/u-boot-2024.04/board/samsung/e850-96/Kconfig
```kconfig
if TARGET_E850_96

config EXYNOS850
	bool "Exynos850 SoC support"
	default y

config SYS_BOARD
	default "e850-96"

config SYS_VENDOR
	default "samsung"

config SYS_CONFIG_NAME
	default "e850-96"

endif
```

## release/src-rt-5.04behnd.4916/bootloaders/u-boot-2024.04/board/samsung/espresso7420/Kconfig
```kconfig
if TARGET_ESPRESSO7420

config EXYNOS7420
	def_bool y

config SYS_BOARD
	default "espresso7420"
	help
	  Espresso7420 is a development/evaluation board for Exynos7420 SoC.
	  It includes multiple onboard compoments (EMMC/Codec) and various
	  interconnects (USB/HDMI).

config SYS_VENDOR
	default "samsung"

config SYS_CONFIG_NAME
	default "espresso7420"

endif
```

## release/src-rt-5.04behnd.4916/bootloaders/u-boot-2024.04/board/samsung/goni/Kconfig
```kconfig
if TARGET_S5P_GONI

config SYS_BOARD
	default "goni"

config SYS_VENDOR
	default "samsung"

config SYS_SOC
	default "s5pc1xx"

config SYS_CONFIG_NAME
	default "s5p_goni"

endif
```

## release/src-rt-5.04behnd.4916/bootloaders/u-boot-2024.04/board/samsung/origen/Kconfig
```kconfig
if TARGET_ORIGEN

config SYS_BOARD
	default "origen"

config SYS_VENDOR
	default "samsung"

config SYS_CONFIG_NAME
	default "origen"

endif
```

## release/src-rt-5.04behnd.4916/bootloaders/u-boot-2024.04/board/samsung/smdkc100/Kconfig
```kconfig
if TARGET_SMDKC100

config SYS_BOARD
	default "smdkc100"

config SYS_VENDOR
	default "samsung"

config SYS_SOC
	default "s5pc1xx"

config SYS_CONFIG_NAME
	default "smdkc100"

endif
```

## release/src-rt-5.04behnd.4916/bootloaders/u-boot-2024.04/board/samsung/smdkv310/Kconfig
```kconfig
if TARGET_SMDKV310

config MIU_2BIT_INTERLEAVED
	def_bool y

config SYS_BOARD
	default "smdkv310"

config SYS_VENDOR
	default "samsung"

config SYS_CONFIG_NAME
	default "smdkv310"

endif
```

## release/src-rt-5.04behnd.4916/bootloaders/u-boot-2024.04/board/samsung/starqltechn/Kconfig
```kconfig
if TARGET_STARQLTECHN

config SYS_BOARD
	default "starqltechn"
	help
	  starqltechn is a production board for S9 and S9+ phones(SM-G96x0) phones based on SDM845 SoC.

config SYS_CONFIG_NAME
	string "Board configuration name"
	default "sdm845"
	help
	  This option contains information about board configuration name.
	  Based on this option include/configs/<CONFIG_SYS_CONFIG_NAME>.h header
	  will be used for board configuration.

config SYS_VENDOR
	default "samsung"

config SYS_CONFIG_NAME
	default "starqltechn"

endif
```

## release/src-rt-5.04behnd.4916/bootloaders/u-boot-2024.04/board/samsung/universal_c210/Kconfig
```kconfig
if TARGET_S5PC210_UNIVERSAL

config SYS_BOARD
	default "universal_c210"

config SYS_VENDOR
	default "samsung"

config SYS_CONFIG_NAME
	default "s5pc210_universal"

endif
```

## release/src-rt-5.04behnd.4916/bootloaders/u-boot-2024.04/board/schneider/rzn1-snarc/Kconfig
```kconfig
if TARGET_SCHNEIDER_RZN1

config TEXT_BASE
	default 0x20040000

config SYS_MONITOR_LEN
	default 524288

config SYS_BOARD
	default "rzn1-snarc"

config SYS_VENDOR
	default "schneider"

config SYS_CONFIG_NAME
	default "rzn1-snarc"

endif
```

## release/src-rt-5.04behnd.4916/bootloaders/u-boot-2024.04/board/seeed/npi_imx6ull/Kconfig
```kconfig
if TARGET_NPI_IMX6ULL

config SYS_BOARD
	default "npi_imx6ull"

config SYS_VENDOR
	default "seeed"

config SYS_CONFIG_NAME
	default "npi_imx6ull"

endif
```

## release/src-rt-5.04behnd.4916/bootloaders/u-boot-2024.04/board/sielaff/imx6dl-sielaff/Kconfig
```kconfig
if TARGET_MX6S_SIELAFF

config SYS_BOARD
	string
	default "imx6dl-sielaff"

config SYS_VENDOR
	string
	default "sielaff"

config SYS_CONFIG_NAME
	string
	default "imx6dl-sielaff"

endif
```

## release/src-rt-5.04behnd.4916/bootloaders/u-boot-2024.04/board/siemens/capricorn/Kconfig
```kconfig
if TARGET_GIEDI

config SYS_BOARD
	default "capricorn"

config SYS_VENDOR
	default "siemens"

config SYS_CONFIG_NAME
	default "giedi"

config IMX_CONFIG
	default "board/siemens/capricorn/imximage.cfg"
endif

if TARGET_DENEB

config SYS_BOARD
	default "capricorn"

config SYS_VENDOR
	default "siemens"

config SYS_CONFIG_NAME
	default "deneb"

config IMX_CONFIG
	default "board/siemens/capricorn/imximage.cfg"

endif
```

## release/src-rt-5.04behnd.4916/bootloaders/u-boot-2024.04/board/siemens/corvus/Kconfig
```kconfig
if TARGET_CORVUS

config AT91_LED
	def_bool y

config SYS_BOARD
	default "corvus"

config SYS_VENDOR
	default "siemens"

config SYS_CONFIG_NAME
	default "corvus"

endif
```

## release/src-rt-5.04behnd.4916/bootloaders/u-boot-2024.04/board/siemens/draco/Kconfig
```kconfig
if TARGET_THUBAN

config SYS_BOARD
	default "draco"

config SYS_VENDOR
	default "siemens"

config SYS_SOC
	default "am33xx"

config SYS_CONFIG_NAME
	default "draco-thuban"

endif

if TARGET_RASTABAN

config SYS_BOARD
	default "draco"

config SYS_VENDOR
	default "siemens"

config SYS_SOC
	default "am33xx"

config SYS_CONFIG_NAME
	default "draco-rastaban"

endif

if TARGET_ETAMIN

config SYS_BOARD
        default "draco"

config SYS_VENDOR
        default "siemens"

config SYS_SOC
        default "am33xx"

config SYS_CONFIG_NAME
        default "draco-etamin"

endif
```

## release/src-rt-5.04behnd.4916/bootloaders/u-boot-2024.04/board/siemens/iot2050/Kconfig
```kconfig
# SPDX-License-Identifier: GPL-2.0+
#
# Copyright (c) Siemens AG, 2018-2023
#
# Authors:
#   Le Jin <le.jin@siemens.com>
#   Jan Kiszka <jan.kiszka@siemens.com>

if TARGET_IOT2050_A53

config SYS_BOARD
	default "iot2050"

config SYS_VENDOR
	default "siemens"

config SYS_CONFIG_NAME
	default "iot2050"

config IOT2050_BOOT_SWITCH
	bool "Disable eMMC boot via USER button (Advanced version only)"
	default y

config IOT2050_EMBED_OTPCMD
	bool "Embed OTP programming data"
	help
	  Embed signed OTP programming data 'otpcmd.bin' into the firmware
	  image. This data will be evaluated and executed on first boot of the
	  device.

endif
```
