## release/src-rt-5.04behnd.4916/bootloaders/u-boot-2024.04/board/siemens/taurus/Kconfig
```kconfig
if TARGET_TAURUS

config SYS_BOARD
	default "taurus"

config SYS_VENDOR
	default "siemens"

config SYS_CONFIG_NAME
	default "taurus"

choice
	prompt "Board Type AXM/TAURUS"
	default BOARD_AXM

config BOARD_AXM
	bool "AXM board type"
	help
	  Select this, if you want to build for AXM board.

config BOARD_TAURUS
	bool "TAURUS board type"
	help
	  Select this, if you want to build for TAURUS board.

endchoice

endif
```

## release/src-rt-5.04behnd.4916/bootloaders/u-boot-2024.04/board/sifive/unleashed/Kconfig
```kconfig
if TARGET_SIFIVE_UNLEASHED

config SYS_BOARD
	default "unleashed"

config SYS_VENDOR
	default "sifive"

config SYS_CPU
	default "fu540"

config SYS_CONFIG_NAME
	default "sifive-unleashed"

config TEXT_BASE
	default 0x80200000 if SPL
	default 0x80000000 if !RISCV_SMODE
	default 0x80200000 if RISCV_SMODE

config SPL_TEXT_BASE
	default 0x08000000

config SPL_OPENSBI_LOAD_ADDR
	default 0x80000000

config BOARD_SPECIFIC_OPTIONS # dummy
	def_bool y
	select SIFIVE_FU540
	select ENV_IS_IN_SPI_FLASH
	select BINMAN
	select RESET_SIFIVE
	imply CMD_DHCP
	imply CMD_EXT2
	imply CMD_EXT4
	imply CMD_FAT
	imply CMD_FS_GENERIC
	imply CMD_GPT
	imply PARTITION_TYPE_GUID
	imply CMD_NET
	imply CMD_PING
	imply CMD_SF
	imply DOS_PARTITION
	imply EFI_PARTITION
	imply IP_DYN
	imply ISO_PARTITION
	imply PHY_LIB
	imply PHY_MSCC
	imply SPI_FLASH
	imply SPI_FLASH_ISSI
	imply SYSRESET
	imply SYSRESET_GPIO
	imply CMD_I2C

endif
```

## release/src-rt-5.04behnd.4916/bootloaders/u-boot-2024.04/board/sifive/unmatched/Kconfig
```kconfig
if TARGET_SIFIVE_UNMATCHED

config SYS_BOARD
	default "unmatched"

config SYS_VENDOR
	default "sifive"

config SYS_CPU
	default "fu740"

config SYS_CONFIG_NAME
	default "sifive-unmatched"

config TEXT_BASE
	default 0x80200000 if SPL
	default 0x80000000 if !RISCV_SMODE
	default 0x80200000 if RISCV_SMODE

config SPL_TEXT_BASE
	default 0x08000000

config SPL_OPENSBI_LOAD_ADDR
	default 0x80000000

config BOARD_SPECIFIC_OPTIONS # dummy
	def_bool y
	select SIFIVE_FU740
	select ENV_IS_IN_SPI_FLASH
	select SUPPORT_SPL
	select RESET_SIFIVE
	select BINMAN
	imply CMD_DHCP
	imply CMD_EXT2
	imply CMD_EXT4
	imply CMD_FAT
	imply CMD_FS_GENERIC
	imply CMD_GPT
	imply PARTITION_TYPE_GUID
	imply CMD_NET
	imply CMD_PING
	imply CMD_SF
	imply DOS_PARTITION
	imply EFI_PARTITION
	imply IP_DYN
	imply ISO_PARTITION
	imply PHY_LIB
	imply PHY_MSCC
	imply SYSRESET
	imply SYSRESET_GPIO
	imply CMD_I2C

endif
```

## release/src-rt-5.04behnd.4916/bootloaders/u-boot-2024.04/board/silinux/ek874/Kconfig
```kconfig
if TARGET_SILINUX_EK874

config SYS_SOC
	default "renesas"

config SYS_BOARD
	default "ek874"

config SYS_VENDOR
	default "silinux"

config SYS_CONFIG_NAME
	default "silinux-ek874"

endif
```

## release/src-rt-5.04behnd.4916/bootloaders/u-boot-2024.04/board/sipeed/maix/Kconfig
```kconfig
# SPDX-License-Identifier: GPL-2.0+
# Copyright (C) 2019-20 Sean Anderson <seanga2@gmail.com>

if TARGET_SIPEED_MAIX

config SYS_BOARD
	default "maix"

config SYS_VENDOR
	default "sipeed"

config SYS_CPU
	default "generic"

config SYS_CONFIG_NAME
	default "sipeed-maix"

config TEXT_BASE
	default 0x80000000

config DEFAULT_DEVICE_TREE
	default "k210-maix-bit"

config NR_CPUS
	default 2

config NR_DRAM_BANKS
	default 3

config BOARD_SPECIFIC_OPTIONS
	def_bool y
	select GENERIC_RISCV
	select RISCV_PRIV_1_9
	imply SMP
	imply DM_SERIAL
	imply SIFIVE_SERIAL
	imply RISCV_ACLINT
	imply POWER_DOMAIN
	imply SIMPLE_PM_BUS
	imply CLK_K210
	imply DM_RESET
	imply RESET_SYSCON
	imply SYSRESET
	imply SYSRESET_SYSCON
	imply PINCTRL
	imply PINCONF
	imply PINCTRL_K210
	imply DM_GPIO
	imply DWAPB_GPIO
	imply SIFIVE_GPIO
	imply CMD_GPIO
	imply LED
	imply LED_GPIO
	imply SPI
	imply DESIGNWARE_SPI
	imply SPI_FLASH_GIGADEVICE
	imply SPI_FLASH_WINBOND
	imply DM_MTD
	imply SPI_FLASH_MTD
	imply CMD_MTD
	imply ENV_IS_IN_SPI_FLASH
	imply MMC
	imply MMC_BROKEN_CD
	imply MMC_SPI
	imply CMD_MMC
	imply DOS_PARTITION
	imply EFI_PARTITION
	imply CMD_PART
	imply CMD_FS_GENERIC
	imply WDT
	imply DESIGNWARE_WATCHDOG
endif
```

## release/src-rt-5.04behnd.4916/bootloaders/u-boot-2024.04/board/skyworth/hc2910-2aghd05/Kconfig
```kconfig
if TARGET_HC2910_2AGHD05

config SYS_BOARD
	default "hc2910-2aghd05"

config SYS_VENDOR
	default "skyworth"

config SYS_SOC
	default "hi3798mv200"

config SYS_CONFIG_NAME
	default "hc2910-2aghd05"

endif
```

## release/src-rt-5.04behnd.4916/bootloaders/u-boot-2024.04/board/socionext/developerbox/Kconfig
```kconfig
if ARCH_SYNQUACER

choice
	prompt "SC2A11 Cortex-A53 MPCore 24cores"
	optional

config TARGET_DEVELOPERBOX
	bool "Socionext DeveloperBox"
	select PCI
	select PCIE_ECAM_SYNQUACER
	select SYS_DISABLE_DCACHE_OPS
	select OF_BOARD_SETUP
	help
	 Choose this option if you build the U-Boot for the DeveloperBox
	 96boards Enterprise Edition.
	 This board will booted from SCP firmware and it enables SMMU, thus
	 the dcache is updated automatically when DMA operation is executed.
endchoice

config SYS_SOC
	default "sc2a11"

if TARGET_DEVELOPERBOX

config SYS_BOARD
	default "developerbox"

config SYS_VENDOR
	default "socionext"

config SYS_CONFIG_NAME
	default "synquacer"

endif
endif
```

## release/src-rt-5.04behnd.4916/bootloaders/u-boot-2024.04/board/softing/vining_2000/Kconfig
```kconfig
if TARGET_SOFTING_VINING_2000

config SYS_BOARD
	default "vining_2000"

config SYS_VENDOR
	default "softing"

config SYS_CONFIG_NAME
	default "vining_2000"

config IMX_CONFIG
	default "board/softing/vining_2000/imximage.cfg"

endif
```

## release/src-rt-5.04behnd.4916/bootloaders/u-boot-2024.04/board/solidrun/clearfog/Kconfig
```kconfig
menu "ClearFog configuration"
	depends on TARGET_CLEARFOG

config TARGET_CLEARFOG_BASE
	bool "Use ClearFog Base static configuration"
	help
	  Use the ClearFog Base as the static configuration instead of the
	  default which uses the ClearFog Pro.

	  Runtime board detection is always attempted and used if available. The
	  static configuration is used as a fallback in cases where runtime
	  detection is disabled, is not available in hardware, or otherwise fails.

	  Only newer revisions of the ClearFog product line support runtime
	  detection via additional EEPROM hardware. This option enables selecting
	  the Base variant for older hardware revisions.

config CLEARFOG_CON3_SATA
	bool "Use CON3 slot in SATA mode"
	help
	  Use the CON3 port with SATA protocol instead of the default PCIe.
	  The ClearFog port allows usage of either mSATA or miniPCIe
	  modules, but the desired protocol must be configured at build
	  time since it affects the SerDes topology layout.

config CLEARFOG_CON2_SATA
	bool "Use CON2 slot in SATA mode"
	depends on !TARGET_CLEARFOG_BASE
	help
	  Use the CON2 port with SATA protocol instead of the default PCIe.
	  The ClearFog port allows usage of either mSATA or miniPCIe
	  modules, but the desired protocol must be configured at build
	  time since it affects the SerDes topology layout.

config CLEARFOG_SFP_25GB
	bool "Enable 2.5 Gbps mode for SFP"
	help
	  Set the SFP module connection to support 2.5 Gbps transfer speed for the
	  SGMII connection (requires a supporting SFP). By default, transfer speed
	  of 1.25 Gbps is used, suitable for a more common 1 Gbps SFP module.

choice CLEARFOG_GTR_SERDES0
	prompt "Select Clearfog GTR SerDes 0 Function"
	default CLEARFOG_GTR_SERDES0_PCIE
	help
	  Select function for SerDes 0 which is shared between CON3 and CON18
	  for either pci-e or sata.

config CLEARFOG_GTR_SERDES0_PCIE
	bool "PCI-E on CON3"
	help
	  Configure SerDes 0 for PCI-E to enable CON3 mini-PCI-E connector.

config CLEARFOG_GTR_SERDES0_SATA
	bool "SATA on CON18"
	help
	  Configure SerDes 0 for SATA to enable CON18 SATA connector.

endchoice

config ENV_SIZE
	hex "Environment Size"
	default 0x10000

config ENV_OFFSET
	hex "Environment offset"
	default 0xF0000

config ENV_SECT_SIZE
	hex "Environment Sector-Size"
	# Use SPI flash erase block size of 4 KiB
	default 0x1000 if MVEBU_SPL_BOOT_DEVICE_SPI || MVEBU_SPL_BOOT_DEVICE_SATA
	# Use optimistic 64 KiB erase block, will vary between actual media
	default 0x10000 if MVEBU_SPL_BOOT_DEVICE_MMC || MVEBU_SPL_BOOT_DEVICE_UART

endmenu
```

## release/src-rt-5.04behnd.4916/bootloaders/u-boot-2024.04/board/somlabs/visionsom-6ull/Kconfig
```kconfig
if TARGET_SOMLABS_VISIONSOM_6ULL

config SYS_BOARD
	default "visionsom-6ull"

config SYS_VENDOR
	default "somlabs"

config SYS_CONFIG_NAME
	default "somlabs_visionsom_6ull"

config IMX_CONFIG
	default "board/somlabs/visionsom-6ull/imximage.cfg"

endif
```

## release/src-rt-5.04behnd.4916/bootloaders/u-boot-2024.04/board/sophgo/milkv_duo/Kconfig
```kconfig
if TARGET_MILKV_DUO

config SYS_BOARD
	default "milkv_duo"

config SYS_VENDOR
	default "sophgo"

config SYS_CPU
	default "generic"

config SYS_CONFIG_NAME
	default "milkv_duo"

config TEXT_BASE
	default 0x80200000

config ENV_SIZE
	default 0x20000

config ENV_SECT_SIZE
	default 0x40000

config BOARD_SPECIFIC_OPTIONS
	def_bool y
	select GENERIC_RISCV

endif
```

## release/src-rt-5.04behnd.4916/bootloaders/u-boot-2024.04/board/st/common/Kconfig
```kconfig
config CMD_STBOARD
	bool "stboard - command for OTP board information"
	depends on ARCH_STM32MP
	default y if TARGET_ST_STM32MP25X || TARGET_ST_STM32MP15X || TARGET_ST_STM32MP13X
	help
	  This compile the stboard command to
	  read and write the board in the OTP.

config DFU_ALT_RAM0
	string "dfu for ram0"
	default "uImage ram 0xc2000000 0x2000000;devicetree.dtb ram 0xc4000000 0x100000;uramdisk.image.gz ram 0xc4400000 0x10000000"
	depends on ARCH_STM32MP && SET_DFU_ALT_INFO
	help
	  This defines the partitions of ram used to build dfu dynamically.

config TYPEC_STUSB160X
	tristate "STMicroelectronics STUSB160X Type-C controller driver"
	depends on DM_I2C
	help
	  Say Y if your system has STMicroelectronics STUSB160X Type-C port
	  controller.
```

## release/src-rt-5.04behnd.4916/bootloaders/u-boot-2024.04/board/st/stm32f469-discovery/Kconfig
```kconfig
if TARGET_STM32F469_DISCOVERY

config SYS_BOARD
	string
	default "stm32f469-discovery"

config SYS_VENDOR
	string
	default "st"

config SYS_SOC
	string
	default "stm32f4"

config SYS_CONFIG_NAME
	string
	default "stm32f469-discovery"

endif
```

## release/src-rt-5.04behnd.4916/bootloaders/u-boot-2024.04/board/st/stm32h743-disco/Kconfig
```kconfig
if TARGET_STM32H743_DISCO

config SYS_BOARD
	string
	default "stm32h743-disco"

config SYS_VENDOR
	string
	default "st"

config SYS_SOC
	string
	default "stm32h7"

config SYS_CONFIG_NAME
	string
	default "stm32h743-disco"

endif
```

## release/src-rt-5.04behnd.4916/bootloaders/u-boot-2024.04/board/st/stm32h750-art-pi/Kconfig
```kconfig
if TARGET_STM32H750_ART_PI

config SYS_BOARD
	string
	default "stm32h750-art-pi"

config SYS_VENDOR
	string
	default "st"

config SYS_SOC
	string
	default "stm32h7"

config SYS_CONFIG_NAME
	string
	default "stm32h750-art-pi"

endif
```

## release/src-rt-5.04behnd.4916/bootloaders/u-boot-2024.04/board/st/stm32mp1/Kconfig
```kconfig
if TARGET_ST_STM32MP15X

config SYS_BOARD
	default "stm32mp1"

config SYS_VENDOR
	default "st"

config SYS_CONFIG_NAME
	default "stm32mp15_st_common"

source "board/st/common/Kconfig"
endif

if TARGET_ST_STM32MP13X

config SYS_BOARD
	default "stm32mp1"

config SYS_VENDOR
	default "st"

config SYS_CONFIG_NAME
	default "stm32mp13_st_common"

source "board/st/common/Kconfig"

endif
```

## release/src-rt-5.04behnd.4916/bootloaders/u-boot-2024.04/board/st/stm32mp1/fit_copro_kernel_dtb.its
```
/*
 * Compilation:
 * mkimage -f fit_copro_kernel_dtb.its fit_copro_kernel_dtb.itb
 *
 * M4 firmware to load with remoteproc: rproc-m4-fw.elf
 *
 * Files in linux build dir:
 * - arch/arm/boot/zImage
 * - arch/arm/boot/dts/stm32mp157c-dk2.dtb
 * - arch/arm/boot/dts/stm32mp157c-ev1.dtb
 *
 * load mmc 0:4 $kernel_addr_r fit_copro_kernel_dtb.itb
 * bootm $kernel_addr_r
 * bootm $kernel_addr_r#dk2
 * bootm $kernel_addr_r#ev1
 * bootm $kernel_addr_r#dk2-m4
 * bootm $kernel_addr_r#ev1-m4
 */

/dts-v1/;
/ {
	description = "U-Boot fitImage for stm32mp157";
	#address-cells = <1>;

	images {

		copro {
			description = "M4 copro";
			data = /incbin/("rproc-m4-fw.elf");
			type = "copro";
			arch = "arm";
			compression = "none";
			load = <0xC0800000>;
			hash-1 {
				algo = "sha1";
			};
		};

		kernel {
			description = "Linux kernel";
			data = /incbin/("zImage");
			type = "kernel";
			arch = "arm";
			os = "linux";
			compression = "none";
			load = <0xC4000000>;
			entry = <0xC4000000>;
			hash-1 {
				algo = "sha1";
			};
		};

		fdt-dk2 {
			description = "FDT dk2";
			data = /incbin/("stm32mp157c-dk2.dtb");
			type = "flat_dt";
			arch = "arm";
			compression = "none";
			hash-1 {
				algo = "sha1";
			};
		};

		fdt-ev1 {
			description = "FDT ev1";
			data = /incbin/("stm32mp157c-ev1.dtb");
			type = "flat_dt";
			arch = "arm";
			compression = "none";
			hash-1 {
				algo = "sha1";
			};
		};
	};

	configurations {
		default = "dk2-m4";

		dk2-m4 {
			description = "dk2-m4";
			loadables = "copro";
			kernel = "kernel";
			fdt = "fdt-dk2";
			hash-1 {
				algo = "sha1";
			};
		};

		dk2 {
			description = "dk2";
			kernel = "kernel";
			fdt = "fdt-dk2";
			hash-1 {
				algo = "sha1";
			};
		};

		ev1-m4 {
			description = "ev1-m4";
			loadables = "copro";
			kernel = "kernel";
			fdt = "fdt-ev1";
			hash-1 {
				algo = "sha1";
			};
		};

		ev1 {
			description = "ev1";
			kernel = "kernel";
			fdt = "fdt-ev1";
			hash-1 {
				algo = "sha1";
			};
		};
	};
};
```

## release/src-rt-5.04behnd.4916/bootloaders/u-boot-2024.04/board/st/stm32mp1/fit_kernel_dtb.its
```
/*
 * Compilation:
 * mkimage -f fit_kernel_dtb.its fit_kernel_dtb.itb
 *
 * Files in linux build dir:
 * - arch/arm/boot/Image (gzipped in Image.gz)
 * - arch/arm/boot/dts/stm32mp157c-dk2.dtb
 * - arch/arm/boot/dts/stm32mp157c-ev1.dtb
 *
 * load mmc 0:4 $kernel_addr_r fit_kernel_dtb.itb
 * bootm $kernel_addr_r
 * bootm $kernel_addr_r#dk2
 * bootm $kernel_addr_r#ev1
 *
 * or use extlinux.conf in this directory
 */

/dts-v1/;
/ {
	description = "U-Boot fitImage for stm32mp157";
	#address-cells = <1>;

	images {
		kernel {
			description = "Linux kernel";
			data = /incbin/("Image.gz");
			type = "kernel";
			arch = "arm";
			os = "linux";
			compression = "gzip";
			load = <0xC0008000>;
			entry = <0xC0008000>;
			hash-1 {
				algo = "sha1";
			};
		};

		fdt-dk2 {
			description = "FDT dk2";
			data = /incbin/("stm32mp157c-dk2.dtb");
			type = "flat_dt";
			arch = "arm";
			compression = "none";
			hash-1 {
				algo = "sha1";
			};
		};

		fdt-ev1 {
			description = "FDT ev1";
			data = /incbin/("stm32mp157c-ev1.dtb");
			type = "flat_dt";
			arch = "arm";
			compression = "none";
			hash-1 {
				algo = "sha1";
			};
		};
	};

	configurations {
		default = "dk2";

		dk2 {
			description = "dk2";
			kernel = "kernel";
			fdt = "fdt-dk2";
			hash-1 {
				algo = "sha1";
			};
		};

		ev1 {
			description = "ev1";
			kernel = "kernel";
			fdt = "fdt-ev1";
			hash-1 {
				algo = "sha1";
			};
		};
	};
};
```

## release/src-rt-5.04behnd.4916/bootloaders/u-boot-2024.04/board/st/stm32mp2/Kconfig
```kconfig
if TARGET_ST_STM32MP25X

config SYS_BOARD
	default "stm32mp2"

config SYS_VENDOR
	default "st"

config SYS_CONFIG_NAME
	default "stm32mp25_common"

source "board/st/common/Kconfig"
endif
```
