## release/src-rt-5.04behnd.4916/bootloaders/u-boot-2024.04/board/starfive/visionfive2/Kconfig
```kconfig
if TARGET_STARFIVE_VISIONFIVE2

config SYS_CPU
	default "jh7110"

config SYS_BOARD
	default "visionfive2"

config SYS_VENDOR
	default "starfive"

config SYS_CONFIG_NAME
	default "starfive-visionfive2"

config TEXT_BASE
	default 0x40200000 if SPL
	default 0x40000000 if !RISCV_SMODE
	default 0x40200000 if RISCV_SMODE

config SPL_TEXT_BASE
	default 0x08000000

config SPL_OPENSBI_LOAD_ADDR
	default 0x80000000

config BOARD_SPECIFIC_OPTIONS # dummy
	def_bool y
	select STARFIVE_JH7110
	select SUPPORT_SPL
	select BINMAN
	imply CMD_CPU
	imply CMD_DHCP
	imply CMD_EXT2
	imply CMD_EXT4
	imply CMD_FAT
	imply CMD_FS_GENERIC
	imply CMD_GPIO
	imply CMD_GPT
	imply CMD_MMC
	imply CMD_NET
	imply CMD_PING
	imply CMD_SF
	imply DM_GPIO
	imply DOS_PARTITION
	imply EFI_PARTITION
	imply MII
	imply IP_DYN
	imply ISO_PARTITION
	imply PARTITION_TYPE_GUID
	imply PHY_LIB
	imply PHY_MSCC

endif
```

## release/src-rt-5.04behnd.4916/bootloaders/u-boot-2024.04/board/ste/stemmy/Kconfig
```kconfig
if TARGET_STEMMY

config SYS_BOARD
	default "stemmy"

config SYS_VENDOR
	default "ste"

config SYS_CONFIG_NAME
	default "stemmy"

endif
```

## release/src-rt-5.04behnd.4916/bootloaders/u-boot-2024.04/board/storopack/smegw01/Kconfig
```kconfig
if TARGET_SMEGW01

config SYS_BOARD
	default "smegw01"

config SYS_VENDOR
	default "storopack"

config SYS_CONFIG_NAME
	default "smegw01"

config IMX_CONFIG
	default "board/storopack/smegw01/imximage.cfg"

config SYS_BOOT_LOCKED
	bool "Lock boot process to EMMC"
	default y
	help
	  Say N here if you want to boot from eMMC and SD.
	  Say Y to boot from eMMC.

endif
```

## release/src-rt-5.04behnd.4916/bootloaders/u-boot-2024.04/board/sunxi/Kconfig
```kconfig
choice
	prompt "SPL Image Type"
	default SPL_IMAGE_TYPE_SUNXI_EGON

config SPL_IMAGE_TYPE_SUNXI_EGON
	bool "eGON (normal)"
	help
	  Select this option to embed the SPL binary in an eGON.BT0 image,
	  which is compatible with the normal boot ROM (NBROM).

	  This is usually the correct option to choose.

config SPL_IMAGE_TYPE_SUNXI_TOC0
	bool "TOC0 (secure)"
	help
	  Select this option to embed the SPL binary in a TOC0 image,
	  which is compatible with the secure boot ROM (SBROM).

endchoice

config SPL_IMAGE_TYPE
	string
	default "sunxi_egon" if SPL_IMAGE_TYPE_SUNXI_EGON
	default "sunxi_toc0" if SPL_IMAGE_TYPE_SUNXI_TOC0
```

## release/src-rt-5.04behnd.4916/bootloaders/u-boot-2024.04/board/synopsys/axs10x/Kconfig
```kconfig
if TARGET_AXS101 || TARGET_AXS103

config SYS_BOARD
	default "axs10x"

config SYS_VENDOR
	default "synopsys"

config SYS_CONFIG_NAME
	default "axs10x"

endif
```

## release/src-rt-5.04behnd.4916/bootloaders/u-boot-2024.04/board/synopsys/hsdk/Kconfig
```kconfig
if TARGET_HSDK

config SYS_BOARD
	default "hsdk"

config SYS_VENDOR
	default "synopsys"

config SYS_CONFIG_NAME
	default "hsdk" if BOARD_HSDK
	default "hsdk-4xd" if BOARD_HSDK_4XD

choice
	prompt "HSDK board type"
	default BOARD_HSDK

config BOARD_HSDK
	bool "ARC HS Development Kit"
	help
	  ARC HS Development Kit based on quard core ARC HS38 processor

config BOARD_HSDK_4XD
	bool "ARC HS4x/HS4xD Development Kit"
	help
	  ARC HS4x/HS4xD Development Kit based on quard core ARC HS48/HS47D
	  processor

endchoice

endif
```
