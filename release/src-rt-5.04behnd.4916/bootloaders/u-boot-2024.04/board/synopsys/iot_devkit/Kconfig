## release/src-rt-5.04behnd.4916/bootloaders/u-boot-2024.04/board/synopsys/iot_devkit/Kconfig
```kconfig
if TARGET_IOT_DEVKIT

config SYS_BOARD
	default "iot_devkit"

config SYS_VENDOR
	default "synopsys"

config SYS_CONFIG_NAME
	default "iot_devkit"

endif
```

## release/src-rt-5.04behnd.4916/bootloaders/u-boot-2024.04/board/synopsys/nsim/Kconfig
```kconfig
if TARGET_NSIM

config SYS_BOARD
	default "nsim"

config SYS_VENDOR
	default "synopsys"

config SYS_CONFIG_NAME
	default "nsim"

config NSIM_BOARD_CPPFLAGS
	string "board arc-specific compiler options"
	help
	  For nSIM we allow to set custom arc-specific compiler options
	  (like -mcpu=) instead of hardcoding them in its makefile as nSIM
	  target is used for representing targets without fixed CPU version
	  like FPGA-based boards and software simulators.
	  This variable takes space separated compiler options list.

endif
```

## release/src-rt-5.04behnd.4916/bootloaders/u-boot-2024.04/board/sysam/amcore/Kconfig
```kconfig
if TARGET_AMCORE

config SYS_CPU
        string
        default "mcf530x"

config SYS_BOARD
        string
        default "amcore"

config SYS_VENDOR
        string
        default "sysam"

config SYS_CONFIG_NAME
        string
        default "amcore"

endif
```

## release/src-rt-5.04behnd.4916/bootloaders/u-boot-2024.04/board/sysam/stmark2/Kconfig
```kconfig
if TARGET_STMARK2

config CF_SBF
	def_bool y

config EXTRA_CLOCK
	def_bool y

config SERIAL_BOOT
	def_bool y
	depends on CF_SBF

config SYS_INPUT_CLKSRC
	int "External crystal clock"
	default 30000000

config SYS_CPU
	default "mcf5445x"

config SYS_BOARD
	default "stmark2"

config SYS_VENDOR
	default "sysam"

config SYS_CONFIG_NAME
	default "stmark2"

endif
```

## release/src-rt-5.04behnd.4916/bootloaders/u-boot-2024.04/board/tbs/tbs2910/Kconfig
```kconfig
if TARGET_TBS2910

config SYS_BOARD
	default "tbs2910"

config SYS_VENDOR
	default "tbs"

config SYS_CONFIG_NAME
	default "tbs2910"

config IMX_CONFIG
	default "board/tbs/tbs2910/tbs2910.cfg"

endif
```

## release/src-rt-5.04behnd.4916/bootloaders/u-boot-2024.04/board/technexion/pico-imx6/Kconfig
```kconfig
if TARGET_PICO_IMX6

config SYS_BOARD
	default "pico-imx6"

config SYS_VENDOR
	default "technexion"

config SYS_SOC
	default "mx6"

config SYS_CONFIG_NAME
	default "pico-imx6"

endif
```

## release/src-rt-5.04behnd.4916/bootloaders/u-boot-2024.04/board/technexion/pico-imx8mq/Kconfig
```kconfig
if TARGET_PICO_IMX8MQ

config SYS_BOARD
	default "pico-imx8mq"

config SYS_VENDOR
	default "technexion"

config SYS_CONFIG_NAME
	default "pico-imx8mq"

config IMX_CONFIG
	default "arch/arm/mach-imx/imx8m/imximage.cfg"

endif
```

## release/src-rt-5.04behnd.4916/bootloaders/u-boot-2024.04/board/thead/th1520_lpi4a/Kconfig
```kconfig
if TARGET_TH1520_LPI4A

config ARCH_THEAD
	bool
	default y

config SYS_BOARD
	default "th1520_lpi4a"

config SYS_VENDOR
	default "thead"

config SYS_CPU
	default "generic"

config SYS_CONFIG_NAME
	default "th1520_lpi4a"

config TEXT_BASE
	default 0x01b00000 if SPL
	default 0x01c00000 if !RISCV_SMODE
	default 0x01c00000 if RISCV_SMODE

config SPL_TEXT_BASE
	default 0x08000000

config SPL_OPENSBI_LOAD_ADDR
	default 0x80000000

config BOARD_SPECIFIC_OPTIONS
	def_bool y
	select ARCH_EARLY_INIT_R
	imply CPU
	imply CPU_RISCV
	imply RISCV_TIMER if RISCV_SMODE
	imply CMD_CPU
	imply SMP
	imply SUPPORT_OF_CONTROL
	imply OF_CONTROL
	imply OF_REAL

endif
```

## release/src-rt-5.04behnd.4916/bootloaders/u-boot-2024.04/board/theobroma-systems/lion_rk3368/Kconfig
```kconfig
if TARGET_LION_RK3368

config SYS_BOARD
	default "lion_rk3368"

config SYS_VENDOR
	default "theobroma-systems"

config SYS_CONFIG_NAME
	default "lion_rk3368"

config BOARD_SPECIFIC_OPTIONS # dummy
	def_bool y

config ENV_SIZE
	default 0x2000

config ENV_OFFSET
	default 0x3c000 if ENV_IS_IN_SPI_FLASH

endif
```

## release/src-rt-5.04behnd.4916/bootloaders/u-boot-2024.04/board/theobroma-systems/puma_rk3399/Kconfig
```kconfig
if TARGET_PUMA_RK3399

config SYS_BOARD
	default "puma_rk3399"

config SYS_VENDOR
	default "theobroma-systems"

config SYS_CONFIG_NAME
	default "puma_rk3399"

config BOARD_SPECIFIC_OPTIONS # dummy
	def_bool y
	select ENV_IS_NOWHERE

config ENV_SIZE
	default 0x4000

choice
	prompt "Theobroma Systems RK3399-Q7 DDR Option"
	default TARGET_PUMA_RK3399_RAM_DDR3_1333

config TARGET_PUMA_RK3399_RAM_DDR3_1333
	bool "DDR3-1333MHz"

config TARGET_PUMA_RK3399_RAM_DDR3_1600
	bool "DDR3-1600MHz"

config TARGET_PUMA_RK3399_RAM_DDR3_1866
	bool "DDR3-1866MHz"

endchoice

endif
```

## release/src-rt-5.04behnd.4916/bootloaders/u-boot-2024.04/board/theobroma-systems/ringneck_px30/Kconfig
```kconfig
if TARGET_RINGNECK_PX30

config SYS_BOARD
	default "ringneck_px30"

config SYS_VENDOR
	default "theobroma-systems"

config SYS_CONFIG_NAME
	default "ringneck_px30"

config BOARD_SPECIFIC_OPTIONS # dummy
	def_bool y
	select ENV_IS_NOWHERE

config ENV_SIZE
	default 0x3000

endif
```

## release/src-rt-5.04behnd.4916/bootloaders/u-boot-2024.04/board/ti/am57xx/Kconfig
```kconfig
if TARGET_AM57XX_EVM

config SYS_BOARD
	default "am57xx"

config SYS_VENDOR
	default "ti"

config SYS_CONFIG_NAME
	default "am57xx_evm"

source "board/ti/common/Kconfig"

endif
```

## release/src-rt-5.04behnd.4916/bootloaders/u-boot-2024.04/board/ti/am62ax/Kconfig
```kconfig
# SPDX-License-Identifier: GPL-2.0+
#
# Copyright (C) 2022 Texas Instruments Incorporated - https://www.ti.com/
#

if TARGET_AM62A7_R5_EVM || TARGET_AM62A7_A53_EVM

config SYS_BOARD
       default "am62ax"

config SYS_VENDOR
       default "ti"

config SYS_CONFIG_NAME
       default "am62ax_evm"

source "board/ti/common/Kconfig"

endif

if TARGET_AM62A7_R5_EVM

config SPL_LDSCRIPT
	default "arch/arm/mach-omap2/u-boot-spl.lds"

endif
```

## release/src-rt-5.04behnd.4916/bootloaders/u-boot-2024.04/board/ti/am62x/Kconfig
```kconfig
# SPDX-License-Identifier: GPL-2.0+
#
# Copyright (C) 2020-2022 Texas Instruments Incorporated - https://www.ti.com/
#	Suman Anna <s-anna@ti.com>

if TARGET_AM625_A53_EVM

config SYS_BOARD
       default "am62x"

config SYS_VENDOR
       default "ti"

config SYS_CONFIG_NAME
       default "am62x_evm"

source "board/ti/common/Kconfig"

endif

if TARGET_AM625_R5_EVM

config SYS_BOARD
       default "am62x"

config SYS_VENDOR
       default "ti"

config SYS_CONFIG_NAME
       default "am62x_evm"

config SPL_LDSCRIPT
	default "arch/arm/mach-omap2/u-boot-spl.lds"

source "board/ti/common/Kconfig"

endif
```

## release/src-rt-5.04behnd.4916/bootloaders/u-boot-2024.04/board/ti/am64x/Kconfig
```kconfig
# SPDX-License-Identifier: GPL-2.0+
#
# Copyright (C) 2020-2021 Texas Instruments Incorporated - https://www.ti.com/

if TARGET_AM642_A53_EVM

config SYS_BOARD
       default "am64x"

config SYS_VENDOR
       default "ti"

config SYS_CONFIG_NAME
       default "am64x_evm"

source "board/ti/common/Kconfig"

endif

if TARGET_AM642_R5_EVM

config SYS_BOARD
       default "am64x"

config SYS_VENDOR
       default "ti"

config SYS_CONFIG_NAME
       default "am64x_evm"

source "board/ti/common/Kconfig"

endif
```

## release/src-rt-5.04behnd.4916/bootloaders/u-boot-2024.04/board/ti/am65x/Kconfig
```kconfig
# SPDX-License-Identifier: GPL-2.0+
#
# Copyright (C) 2017-2018 Texas Instruments Incorporated - https://www.ti.com/
#	Lokesh Vutla <lokeshvutla@ti.com>

if TARGET_AM654_A53_EVM

config SYS_BOARD
       default "am65x"

config SYS_VENDOR
       default "ti"

config SYS_CONFIG_NAME
       default "am65x_evm"

source "board/ti/common/Kconfig"

endif

if TARGET_AM654_R5_EVM

config SYS_BOARD
       default "am65x"

config SYS_VENDOR
       default "ti"

config SYS_CONFIG_NAME
       default "am65x_evm"

source "board/ti/common/Kconfig"

endif
```

## release/src-rt-5.04behnd.4916/bootloaders/u-boot-2024.04/board/ti/common/Kconfig
```kconfig
config TI_I2C_BOARD_DETECT
	bool "Support for Board detection for TI platforms"
	help
	   Support for detection board information on Texas Instrument's
	   Evaluation Boards which have I2C based EEPROM detection

config EEPROM_BUS_ADDRESS
	int "Board EEPROM's I2C bus address"
	range 0 8
	default 0
	depends on TI_I2C_BOARD_DETECT

config EEPROM_CHIP_ADDRESS
	hex "Board EEPROM's I2C chip address"
	range 0 0xff
	default 0x50
	depends on TI_I2C_BOARD_DETECT

config CAPE_EEPROM_BUS_NUM
	int "Cape EEPROM's I2C bus address"
	range 0 8
	default 2
	depends on CMD_EXTENSION

config TI_COMMON_CMD_OPTIONS
	bool "Enable cmd options on TI platforms"
	imply CMD_ASKENV
	imply CMD_BOOTZ
	imply CRC32_VERIFY if ARCH_KEYSTONE
	imply CMD_DFU if USB_GADGET_DOWNLOAD
	imply CMD_DHCP
	imply CMD_EEPROM
	imply CMD_EXT2
	imply CMD_EXT4
	imply CMD_EXT4_WRITE
	imply CMD_FAT
	imply FAT_WRITE if CMD_FAT
	imply CMD_FS_GENERIC
	imply CMD_GPIO
	imply CMD_GPT
	imply CMD_I2C
	imply CMD_MII
	imply CMD_MMC
	imply CMD_PART
	imply CMD_PING
	imply CMD_PMIC if DM_PMIC
	imply CMD_REGULATOR if DM_REGULATOR
	imply CMD_SF if SPI_FLASH
	imply CMD_SPI
	imply CMD_TIME
	imply CMD_USB if USB

config TI_FDT_FOLDER_PATH
	string "Location of Folder path where dtb is present"
	default "ti/davinci" if ARCH_DAVINCI
	default "ti/keystone" if ARCH_KEYSTONE
	default "ti/omap" if ARCH_OMAP2PLUS
	default "ti" if ARCH_K3
	depends on ARCH_DAVINCI || ARCH_KEYSTONE || ARCH_OMAP2PLUS || ARCH_K3
	help
	   Folder path for kernel device tree default.
	   This is used along with fdtfile path to locate the kernel
	   device tree blob.
```

## release/src-rt-5.04behnd.4916/bootloaders/u-boot-2024.04/board/ti/j721e/Kconfig
```kconfig
# SPDX-License-Identifier: GPL-2.0+
#
# Copyright (C) 2018-2019 Texas Instruments Incorporated - https://www.ti.com/
#	Lokesh Vutla <lokeshvutla@ti.com>

if TARGET_J721E_A72_EVM

config SYS_BOARD
       default "j721e"

config SYS_VENDOR
       default "ti"

config SYS_CONFIG_NAME
       default "j721e_evm"

config ENV_SOURCE_FILE
       default "j721e"

source "board/ti/common/Kconfig"

endif

if TARGET_J721E_R5_EVM

config SYS_BOARD
       default "j721e"

config SYS_VENDOR
       default "ti"

config SYS_CONFIG_NAME
       default "j721e_evm"

config ENV_SOURCE_FILE
       default "j721e"

source "board/ti/common/Kconfig"

endif

if TARGET_J7200_A72_EVM

config SYS_BOARD
       default "j721e"

config SYS_VENDOR
       default "ti"

config SYS_CONFIG_NAME
       default "j721e_evm"

config ENV_SOURCE_FILE
       default "j721e"

source "board/ti/common/Kconfig"

endif

if TARGET_J7200_R5_EVM

config SYS_BOARD
       default "j721e"

config SYS_VENDOR
       default "ti"

config SYS_CONFIG_NAME
       default "j721e_evm"

config ENV_SOURCE_FILE
       default "j721e"

source "board/ti/common/Kconfig"

endif
```

## release/src-rt-5.04behnd.4916/bootloaders/u-boot-2024.04/board/ti/j721s2/Kconfig
```kconfig
# SPDX-License-Identifier: GPL-2.0+
#
# Copyright (C) 2021 Texas Instruments Incorporated - https://www.ti.com/
#	David Huang <d-huang@ti.com>

if TARGET_J721S2_A72_EVM

config SYS_BOARD
       default "j721s2"

config SYS_VENDOR
       default "ti"

config SYS_CONFIG_NAME
       default "j721s2_evm"

config ENV_SOURCE_FILE
       default "j721s2"

source "board/ti/common/Kconfig"

endif

if TARGET_J721S2_R5_EVM

config SYS_BOARD
       default "j721s2"

config SYS_VENDOR
       default "ti"

config SYS_CONFIG_NAME
       default "j721s2_evm"

config ENV_SOURCE_FILE
       default "j721s2"

source "board/ti/common/Kconfig"

endif
```

## release/src-rt-5.04behnd.4916/bootloaders/u-boot-2024.04/board/ti/omap3evm/Kconfig
```kconfig
if TARGET_OMAP3_EVM

config SYS_BOARD
	default "omap3evm"

config SYS_VENDOR
	default "ti"

config SYS_CONFIG_NAME
	default "omap3_evm"

source "board/ti/common/Kconfig"

endif
```

## release/src-rt-5.04behnd.4916/bootloaders/u-boot-2024.04/board/toradex/apalis-imx8/Kconfig
```kconfig
if TARGET_APALIS_IMX8

config SYS_BOARD
	default "apalis-imx8"

config SYS_VENDOR
	default "toradex"

config SYS_CONFIG_NAME
	default "apalis-imx8"

config TDX_CFG_BLOCK
	default y

config TDX_CFG_BLOCK_2ND_ETHADDR
	default y

config TDX_HAVE_MMC
	default y

config TDX_CFG_BLOCK_DEV
	default "0"

config TDX_CFG_BLOCK_PART
	default "1"

# Toradex config block in eMMC, at the end of 1st "boot sector"
config TDX_CFG_BLOCK_OFFSET
	default "-512"

config IMX_CONFIG
	default "board/toradex/apalis-imx8/apalis-imx8-imximage.cfg"

source "board/toradex/common/Kconfig"

endif
```

## release/src-rt-5.04behnd.4916/bootloaders/u-boot-2024.04/board/toradex/colibri-imx6ull/Kconfig
```kconfig
if TARGET_COLIBRI_IMX6ULL

choice
	prompt "Colibri iMX6ULL variant"
	optional

config TARGET_COLIBRI_IMX6ULL_NAND
	bool "Support Colibri iMX6ULL 256MB / 512MB (raw NAND) modules"
	imply NAND_MXS
	help
	  Choose this option if you build for a Toradex Colibri iMX6ULL
	  256MB or 512MB module which do have raw NAND on-module.

config TARGET_COLIBRI_IMX6ULL_EMMC
	bool "Support Colibri iMX6ULL 1GB (eMMC) modules"
	help
	  Choose this option if you build for a Toradex Colibri iMX6ULL
	  1GB module which does have eMMC on-module.

endchoice

config SYS_BOARD
	default "colibri-imx6ull"

config SYS_VENDOR
	default "toradex"

config SYS_CONFIG_NAME
	default "colibri-imx6ull-tezi-recovery" if (!TARGET_COLIBRI_IMX6ULL_NAND && !TARGET_COLIBRI_IMX6ULL_EMMC)

config TDX_CFG_BLOCK
	default y

if TARGET_COLIBRI_IMX6ULL_NAND

config SYS_CONFIG_NAME
	default "colibri-imx6ull"

config TDX_HAVE_NAND
	default y

config TDX_CFG_BLOCK_OFFSET
	default "2048"

config TDX_CFG_BLOCK_OFFSET2
	default "133120"

endif

if TARGET_COLIBRI_IMX6ULL_EMMC

config SYS_CONFIG_NAME
	default "colibri-imx6ull"

config TDX_HAVE_MMC
	default y

config TDX_CFG_BLOCK_DEV
	default "0"

config TDX_CFG_BLOCK_PART
	default "1"

# Toradex config block in eMMC, at the end of 1st "boot sector"
config TDX_CFG_BLOCK_OFFSET
	default "-512"

endif

config TDX_CFG_BLOCK_2ND_ETHADDR
	default y

config IMX_CONFIG
	default "board/toradex/colibri-imx6ull/imximage.cfg"

source "board/toradex/common/Kconfig"

endif
```

## release/src-rt-5.04behnd.4916/bootloaders/u-boot-2024.04/board/toradex/colibri-imx8x/Kconfig
```kconfig
if TARGET_COLIBRI_IMX8X

config SYS_BOARD
	default "colibri-imx8x"

config SYS_VENDOR
	default "toradex"

config SYS_CONFIG_NAME
	default "colibri-imx8x"

config TDX_CFG_BLOCK
	default y

config TDX_CFG_BLOCK_2ND_ETHADDR
	default y

config TDX_HAVE_MMC
	default y

config TDX_CFG_BLOCK_DEV
	default "0"

config TDX_CFG_BLOCK_PART
	default "1"

# Toradex config block in eMMC, at the end of 1st "boot sector"
config TDX_CFG_BLOCK_OFFSET
	default "-512"

config IMX_CONFIG
	default "board/toradex/colibri-imx8x/colibri-imx8x-imximage.cfg"

source "board/toradex/common/Kconfig"

endif
```

## release/src-rt-5.04behnd.4916/bootloaders/u-boot-2024.04/board/toradex/colibri_vf/Kconfig
```kconfig
if TARGET_COLIBRI_VF

config SYS_BOARD
	default "colibri_vf"

config SYS_VENDOR
	default "toradex"

config SYS_CONFIG_NAME
	default "colibri_vf"

config TDX_CFG_BLOCK
	default y

config TDX_HAVE_NAND
	default y

config TDX_CFG_BLOCK_OFFSET
	default "2048"

config TDX_CFG_BLOCK_2ND_ETHADDR
	default y

config IMX_CONFIG
	default "board/toradex/colibri_vf/imximage.cfg"

source "board/toradex/common/Kconfig"

endif
```
