## release/src-rt-5.04behnd.4916/bootloaders/u-boot-2024.04/board/toradex/verdin-am62/Kconfig
```kconfig
# SPDX-License-Identifier: GPL-2.0-or-later
#
# Copyright 2023 Toradex
#

if TARGET_VERDIN_AM62_A53

config SYS_BOARD
	default "verdin-am62"

config SYS_CONFIG_NAME
	default "verdin-am62"

config SYS_VENDOR
	default "toradex"

config TDX_CFG_BLOCK
	default y

config TDX_CFG_BLOCK_2ND_ETHADDR
	default y

config TDX_CFG_BLOCK_DEV
	default "0"

config TDX_CFG_BLOCK_EXTRA
	default y

# Toradex config block in eMMC, at the end of 1st "boot sector"
config TDX_CFG_BLOCK_OFFSET
	default "-512"

config TDX_CFG_BLOCK_PART
	default "1"

config TDX_HAVE_EEPROM_EXTRA
	default y

config TDX_HAVE_MMC
	default y

source "board/toradex/common/Kconfig"

endif

if TARGET_VERDIN_AM62_R5

config SPL_LDSCRIPT
	default "arch/arm/mach-omap2/u-boot-spl.lds"

config SYS_BOARD
	default "verdin-am62"

config SYS_CONFIG_NAME
	default "verdin-am62"

config SYS_VENDOR
	default "toradex"

endif
```

## release/src-rt-5.04behnd.4916/bootloaders/u-boot-2024.04/board/toradex/verdin-imx8mm/Kconfig
```kconfig
if TARGET_VERDIN_IMX8MM

config SYS_BOARD
	default "verdin-imx8mm"

config SYS_VENDOR
	default "toradex"

config SYS_CONFIG_NAME
	default "verdin-imx8mm"

config TDX_CFG_BLOCK
	default y

config TDX_CFG_BLOCK_EXTRA
	default y

config TDX_HAVE_MMC
	default y

config TDX_HAVE_EEPROM_EXTRA
	default y

config TDX_CFG_BLOCK_DEV
	default "0"

config TDX_CFG_BLOCK_PART
	default "1"

# Toradex config block in eMMC, at the end of 1st "boot sector"
config TDX_CFG_BLOCK_OFFSET
	default "-512"

config IMX_CONFIG
	default "board/toradex/verdin-imx8mm/imximage.cfg"

source "board/toradex/common/Kconfig"

endif
```

## release/src-rt-5.04behnd.4916/bootloaders/u-boot-2024.04/board/toradex/verdin-imx8mp/Kconfig
```kconfig
if TARGET_VERDIN_IMX8MP

config IMX_CONFIG
	default "board/toradex/verdin-imx8mp/imximage.cfg"

config SYS_BOARD
	default "verdin-imx8mp"

config SYS_CONFIG_NAME
	default "verdin-imx8mp"

config SYS_VENDOR
	default "toradex"

config TDX_CFG_BLOCK
	default y

config TDX_CFG_BLOCK_2ND_ETHADDR
	default y

config TDX_CFG_BLOCK_DEV
	default "2"

config TDX_CFG_BLOCK_EXTRA
	default y

# Toradex config block in eMMC, at the end of 1st "boot sector"
config TDX_CFG_BLOCK_OFFSET
	default "-512"

config TDX_CFG_BLOCK_PART
	default "1"

config TDX_HAVE_EEPROM_EXTRA
	default y

config TDX_HAVE_MMC
	default y

source "board/toradex/common/Kconfig"

endif
```

## release/src-rt-5.04behnd.4916/bootloaders/u-boot-2024.04/board/tplink/wdr4300/Kconfig
```kconfig
if BOARD_TPLINK_WDR4300

config SYS_VENDOR
	default "tplink"

config SYS_SOC
	default "ath79"

config SYS_BOARD
	default "wdr4300"

config SYS_CONFIG_NAME
	default "tplink_wdr4300"

config TEXT_BASE
	default 0xa1000000

config SYS_DCACHE_SIZE
	default 32768

config SYS_DCACHE_LINE_SIZE
	default 32

config SYS_ICACHE_SIZE
	default 65536

config SYS_ICACHE_LINE_SIZE
	default 32

endif
```

## release/src-rt-5.04behnd.4916/bootloaders/u-boot-2024.04/board/tq/tqma6/Kconfig
```kconfig
if TARGET_TQMA6

config SYS_BOARD
	default "tqma6"

config SYS_VENDOR
	default "tq"

config SYS_CONFIG_NAME
	default "tqma6"

choice
	prompt "TQMa6 SoC variant"
	default TQMA6Q
	help
	  select the TQMa6 module variant. The variants differing in the used
	  i.MX6 CPU type and DRAM

config TQMA6Q
	bool "TQMa6Q / TQMa6D"
	depends on MX6Q
	help
	  select TQMa6Q / TQMa6D with i.MX6Q/D and 1GiB DRAM

config TQMA6DL
	bool "TQMa6DL"
	depends on MX6DL
	help
	  select TQMa6DL with i.MX6DL and 1GiB DRAM

config TQMA6S
	bool "TQMa6S"
	depends on MX6S
	help
	  select TQMa6S with i.MX6S and 512 MiB DRAM

endchoice

choice
	prompt "TQMa6 boot configuration"
	default TQMA6X_MMC_BOOT
	help
	  Configure boot device. This is also used to implement environment
	  location.

config TQMA6X_MMC_BOOT
	bool "MMC / SD Boot"
	help
	  Boot from eMMC / SD Card

config TQMA6X_SPI_BOOT
	bool "SPI NOR Boot"
	help
	  Boot from on board SPI NOR flash

endchoice

choice
	prompt "TQMa6 base board variant"
	default MBA6
	help
	  Select base board for TQMa6

config MBA6
	bool "TQMa6 on MBa6 Starterkit"
	select USB
	select CMD_USB
	select USB_STORAGE
	select USB_HOST_ETHER
	select USB_ETHER_SMSC95XX
	select PHYLIB
	select PHY_MICREL
	select PHY_MICREL_KSZ90X1
	select MXC_UART
	help
	  Select the MBa6 starterkit. This features a GigE Phy, USB, SD-Card
	  etc.

config WRU4
	bool "OHB WRU-IV"
	help
	  Select the OHB Systems AG WRU-IV baseboard.

endchoice

config TEXT_BASE
	default 0x2fc00000 if TQMA6S
	default 0x4fc00000 if TQMA6Q || TQMA6DL

config IMX_CONFIG
	default "board/tq/tqma6/tqma6q.cfg" if TQMA6Q
	default "board/tq/tqma6/tqma6dl.cfg" if TQMA6DL
	default "board/tq/tqma6/tqma6s.cfg" if TQMA6S

endif
```

## release/src-rt-5.04behnd.4916/bootloaders/u-boot-2024.04/board/traverse/common/Kconfig
```kconfig
config TEN64_CONTROLLER
	bool "Enable Ten64 board controller driver"
	depends on TARGET_TEN64
	help
		Support for the board microcontroller on the Traverse
		Ten64 family of boards.
```

## release/src-rt-5.04behnd.4916/bootloaders/u-boot-2024.04/board/traverse/ten64/Kconfig
```kconfig
if TARGET_TEN64

config SYS_BOARD
	default "ten64"

config SYS_VENDOR
	default "traverse"

config SYS_SOC
	default "fsl-layerscape"

config SYS_CONFIG_NAME
	default "ten64"

endif

source "board/traverse/common/Kconfig"
```

## release/src-rt-5.04behnd.4916/bootloaders/u-boot-2024.04/board/turing/turing-rk1-rk3588/Kconfig
```kconfig
if TARGET_TURINGRK1_RK3588

config SYS_BOARD
	default "turing-rk1-rk3588"

config SYS_VENDOR
	default "turing"

config SYS_CONFIG_NAME
	default "turing-rk1-rk3588"

config BOARD_SPECIFIC_OPTIONS # dummy
	def_bool y

endif
```

## release/src-rt-5.04behnd.4916/bootloaders/u-boot-2024.04/board/udoo/Kconfig
```kconfig
if TARGET_UDOO

config SYS_BOARD
	default "udoo"

config SYS_CONFIG_NAME
	default "udoo"

endif
```

## release/src-rt-5.04behnd.4916/bootloaders/u-boot-2024.04/board/variscite/imx8mn_var_som/Kconfig
```kconfig
if TARGET_IMX8MN_VAR_SOM

config SYS_BOARD
	default "imx8mn_var_som"

config SYS_VENDOR
	default "variscite"

config SYS_CONFIG_NAME
	default "imx8mn_var_som"

config IMX_CONFIG
	default "board/variscite/imx8mn_var_som/imximage-8mn-ddr4.cfg"

endif
```

## release/src-rt-5.04behnd.4916/bootloaders/u-boot-2024.04/board/variscite/imx93_var_som/Kconfig
```kconfig
if TARGET_IMX93_VAR_SOM

config SYS_BOARD
	default "imx93_var_som"

config SYS_VENDOR
	default "variscite"

config SYS_CONFIG_NAME
	default "imx93_var_som"

endif
```

## release/src-rt-5.04behnd.4916/bootloaders/u-boot-2024.04/board/vocore/vocore2/Kconfig
```kconfig
if BOARD_VOCORE2

config SYS_BOARD
	default "vocore2"

config SYS_VENDOR
	default "vocore"

config SYS_CONFIG_NAME
	default "vocore2"

endif
```

## release/src-rt-5.04behnd.4916/bootloaders/u-boot-2024.04/board/warp7/Kconfig
```kconfig
if TARGET_WARP7

config SYS_BOARD
	default "warp7"

config SYS_CONFIG_NAME
	default "warp7"

config WARP7_ROOT_PART
	int "Partition number to use for root filesystem"
	default 2
	help
	  The partition number to use for root filesystem this is the
	  partition that is typically specified with root=/dev/sdaX or
	  which gets converted into a root=PARTUUID=some_uuid.

config IMX_CONFIG
	default "board/warp7/imximage.cfg"

endif
```

## release/src-rt-5.04behnd.4916/bootloaders/u-boot-2024.04/board/work-microwave/work_92105/Kconfig
```kconfig
if TARGET_WORK_92105

config SYS_BOARD
	default "work_92105"

config SYS_VENDOR
	default "work-microwave"

config SYS_CONFIG_NAME
	default "work_92105"

config CMD_HD44760
	bool "Enable 'hd44780' LCD-control command"
	help
	  This controls the LCD driver.

config CMD_MAX6957
	bool "Enable 'max6957aax' PMIC command"
	help
	  DEPRECATED: Needs conversion to driver model.

	  This allows PMIC registers to be read and written.

endif
```

## release/src-rt-5.04behnd.4916/bootloaders/u-boot-2024.04/board/xen/xenguest_arm64/Kconfig
```kconfig
if TARGET_XENGUEST_ARM64

config SYS_BOARD
	default "xenguest_arm64"

config SYS_VENDOR
	default "xen"

config SYS_CONFIG_NAME
	default "xenguest_arm64"

config LNX_KRNL_IMG_TEXT_OFFSET_BASE
	default SYS_LOAD_ADDR

endif
```

## release/src-rt-5.04behnd.4916/bootloaders/u-boot-2024.04/board/xilinx/Kconfig
```kconfig
# SPDX-License-Identifier: GPL-2.0
#
# Copyright (c) 2018, Luca Ceresoli <luca@lucaceresoli.net>

if ARCH_ZYNQ || ARCH_ZYNQMP

config XILINX_PS_INIT_FILE
	string "Zynq/ZynqMP PS init file(s) location"
	help
	  On Zynq and ZynqMP U-Boot SPL (or U-Boot proper if
	  ZYNQMP_PSU_INIT_ENABLED is set) is responsible for some
	  basic initializations, such as enabling peripherals and
	  configuring pinmuxes. The PS init file (called
	  psu_init_gpl.c on ZynqMP, ps7_init_gpl.c for Zynq-7000)
	  contains the code for such initializations.

	  U-Boot contains PS init files for some boards, but each of
	  them describes only one specific configuration. Users of a
	  different board, or needing a different configuration, can
	  generate custom files using the Xilinx development tools.

	  There are three ways to give a PS init file to U-Boot:

	  1. Set this variable to the path, either relative to the
	     source tree or absolute, where the psu_init_gpl.c or
	     ps7_init_gpl.c file is located. U-Boot will build this
	     file.

	  2. If you leave an empty string here, U-Boot will use
	     board/xilinx/zynq/$(CONFIG_DEFAULT_DEVICE_TREE)/ps7_init_gpl.c
	     for Zynq-7000, or
	     board/xilinx/zynqmp/$(CONFIG_DEFAULT_DEVICE_TREE)/psu_init_gpl.c
	     for ZynqMP.

	  3. If the above file does not exist, U-Boot will use
	     board/xilinx/zynq/ps7_init_gpl.c for Zynq-7000, or
	     board/xilinx/zynqmp/psu_init_gpl.c for ZynqMP. This file
	     is not provided by U-Boot, you have to copy it there
	     before the build.

endif

config XILINX_OF_BOARD_DTB_ADDR
	hex "Default DTB pickup address"
	default 0x1000 if ARCH_VERSAL || ARCH_VERSAL_NET
	default 0x8000 if MICROBLAZE
	default 0x100000 if ARCH_ZYNQ || ARCH_ZYNQMP
	depends on OF_BOARD || OF_SEPARATE
	help
	  Offset in the memory where the board configuration DTB is placed.

config BOOT_SCRIPT_OFFSET
	hex "Boot script offset"
	depends on ARCH_ZYNQ || ARCH_ZYNQMP || ARCH_VERSAL || ARCH_VERSAL_NET || MICROBLAZE || TARGET_XILINX_MBV
	default 0xFC0000 if ARCH_ZYNQ || MICROBLAZE
	default 0x3E80000 if ARCH_ZYNQMP
	default 0x7F80000 if ARCH_VERSAL || ARCH_VERSAL_NET
	default 0 if TARGET_XILINX_MBV
	help
	   Specifies distro boot script offset in NAND/QSPI/NOR flash.

config CMD_FRU
	bool "FRU information for product"
	help
	  This option enables FRU commands to capture and display FRU
	  information present in the device. The FRU Information is used
	  to primarily to provide "inventory" information about the boards
	  that the FRU Information Device is located on.

config FRU_SC
	bool "FRU system controller decoding"
	help
	  Xilinx System Controller (SC) FRU format is describing boards from two
	  angles. One from DUT and then from SC. DUT is default option for
	  the main CPU. SC behaves more or less as slave and have different ID.
	  If you build U-Boot for SC you should enable this option to get proper
	  MAC address.
```

## release/src-rt-5.04behnd.4916/bootloaders/u-boot-2024.04/board/xilinx/mbv/Kconfig
```kconfig
if TARGET_XILINX_MBV

config SYS_BOARD
	default "mbv"

config SYS_VENDOR
	default "xilinx"

config SYS_CPU
	default "generic"

config SYS_CONFIG_NAME
	default "xilinx_mbv"

config TEXT_BASE
	default 0x80000000 if !RISCV_SMODE
	default 0x80400000 if RISCV_SMODE && ARCH_RV32I

config BOARD_SPECIFIC_OPTIONS
	def_bool y
	select GENERIC_RISCV
	imply BOARD_LATE_INIT
	imply CMD_SBI
	imply CMD_PING

source "board/xilinx/Kconfig"

endif
```

## release/src-rt-5.04behnd.4916/bootloaders/u-boot-2024.04/board/xilinx/microblaze-generic/Kconfig
```kconfig
if TARGET_MICROBLAZE_GENERIC

config SYS_BOARD
	default "microblaze-generic"

config SYS_VENDOR
	default "xilinx"

config SYS_CONFIG_NAME
	string "Board configuration name"
	default "microblaze-generic"
	help
	  This option contains information about board configuration name.
	  Based on this option include/configs/<CONFIG_SYS_CONFIG_NAME>.h header
	  will be used for board configuration.

config XILINX_MICROBLAZE0_USE_MSR_INSTR
	int "USE_MSR_INSTR range (0:1)"
	default 0

config XILINX_MICROBLAZE0_USE_PCMP_INSTR
	int "USE_PCMP_INSTR range (0:1)"
	default 0

config XILINX_MICROBLAZE0_USE_BARREL
	int "USE_BARREL range (0:1)"
	default 0

config XILINX_MICROBLAZE0_USE_DIV
	int "USE_DIV range (0:1)"
	default 0

config XILINX_MICROBLAZE0_USE_HW_MUL
	int "USE_HW_MUL values (0=NONE, 1=MUL32, 2=MUL64)"
	default 0

config XILINX_MICROBLAZE0_HW_VER
	string "Core version number"
	default "7.10.d"

config XILINX_MICROBLAZE0_FPGA_FAMILY
	string "Targeted FPGA family"
	default "virtex5"
	help
	  This option contains info about the target FPGA architecture
	  (Zynq-7000, UltraScale+ Kintex, etc) that the MicroBlaze soft core is
	  implemented on. It corresponds to the C_FAMILY hdl parameter.

config XILINX_MICROBLAZE0_USR_EXCEP
	bool "MicroBlaze user exception support"
	default y
	help
	  Enable this option in order to install the user exception handler
	  (_exception_handler routine from arch/microblaze/cpu/exception.c) in
	  the exception vector table. The user exception vector is located at
	  C_BASE_VECTORS + 0x8 address.

config XILINX_MICROBLAZE0_DELAY_SLOT_EXCEP
	bool "MicroBlaze delay slot exception support"
	default y
	help
	  Enable this option if the MicroBlaze processor supports exceptions
	  caused by delay slot instructions (processor version >= v5.00). When
	  enabled, the hw exception handler will print a message indicating
	  whether the exception was triggered by a delay slot instruction.

config XILINX_MICROBLAZE0_VECTOR_BASE_ADDR
	hex "Location of MicroBlaze vectors"
	default 0x0
	help
	  Memory address location of the exception vector table. It is
	  configurable via the C_BASE_VECTORS hdl parameter.

config XILINX_MICROBLAZE0_USE_WDC
	bool "MicroBlaze wdc instruction support"
	default y
	help
	  Enable this option if the MicroBlaze processor is configured with
	  support for the "wdc" (Write to Data Cache) instruction.

config SPL_XILINX_MICROBLAZE0_USE_WDC
	bool
	default XILINX_MICROBLAZE0_USE_WDC

config XILINX_MICROBLAZE0_USE_WIC
	bool "MicroBlaze wic instruction support"
	default y
	help
	  Enable this option if the MicroBlaze processor is configured with
	  support for the "wic" (Write to Instruction Cache) instruction.

config SPL_XILINX_MICROBLAZE0_USE_WIC
	bool
	default XILINX_MICROBLAZE0_USE_WIC

config XILINX_MICROBLAZE0_DCACHE_SIZE
	int "Default data cache size"
	default 32768
	help
	  This fallback size will be used when no dcache info can be found in
	  the device tree, or when the data cache is flushed very early in the
	  boot process, before device tree is available.

config XILINX_MICROBLAZE0_ICACHE_SIZE
	int "Default instruction cache size"
	default 32768
	help
	  This fallback size will be used when no icache info can be found in
	  the device tree, or when the instruction cache is flushed very early
	  in the boot process, before device tree is available.

config XILINX_MICROBLAZE0_PVR
	bool "MicroBlaze PVR support"
	help
	  Enables helper functions and macros needed to manipulate PVR
	  (Processor Version Register) data. Currently, only the microblaze
	  UCLASS_CPU driver makes use of this feature to retrieve CPU info at
	  runtime.

endif
```

## release/src-rt-5.04behnd.4916/bootloaders/u-boot-2024.04/board/xilinx/versal-net/Kconfig
```kconfig
# SPDX-License-Identifier: GPL-2.0
#
# Copyright (C) 2020 - 2022, Xilinx, Inc.
# Copyright (C) 2022, Advanced Micro Devices, Inc.
#

if ARCH_VERSAL_NET

config CMD_VERSAL_NET
	bool "Enable Versal NET specific commands"
	default y
	depends on ZYNQMP_FIRMWARE
	help
	  Select this to enable Versal NET specific commands.
	  Commands like versalnet loadpdi are enabled by this.

endif
```
