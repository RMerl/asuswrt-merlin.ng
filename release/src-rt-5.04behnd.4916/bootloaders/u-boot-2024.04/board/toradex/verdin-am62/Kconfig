## release/src-rt-5.04behnd.4916/bootloaders/u-boot-2024.04/board/xilinx/versal/Kconfig
```kconfig
# Copyright (c) 2020, Xilinx, Inc.
#
# SPDX-License-Identifier: GPL-2.0

if ARCH_VERSAL

config CMD_VERSAL
	bool "Enable Versal specific commands"
	default y
	depends on ZYNQMP_FIRMWARE
	help
	  Enable Versal specific commands.

endif
```

## release/src-rt-5.04behnd.4916/bootloaders/u-boot-2024.04/board/zyxel/nsa325/Kconfig
```kconfig
if TARGET_NSA325

config SYS_BOARD
	default "nsa325"

config SYS_VENDOR
	default "zyxel"

config SYS_CONFIG_NAME
	default "nsa325"

endif
```

## release/src-rt-5.04behnd.4916/bootloaders/u-boot-2024.04/cmd/mvebu/Kconfig
```kconfig
menu "MVEBU commands"
depends on ARCH_MVEBU

config CMD_MVEBU_BUBT
	bool "bubt"
	default y
	select SHA256 if ARMADA_3700
	select SHA512 if ARMADA_3700
	select DOS_PARTITION if ARMADA_3700
	select EFI_PARTITION if ARMADA_3700
	select PARTITION_TYPE_GUID if ARMADA_3700
	select MVEBU_EFUSE if ARMADA_38X || ARMADA_3700
	help
	  bubt - Burn a u-boot image to flash
	  For details about bubt command please see the documentation
	  in doc/mvebu/cmd/bubt.txt

if CMD_MVEBU_BUBT

choice
	prompt "Flash for image"
	default MVEBU_SPI_BOOT if MVEBU_SPL_BOOT_DEVICE_SPI
	default MVEBU_NAND_BOOT if MVEBU_SPL_BOOT_DEVICE_NAND
	default MVEBU_MMC_BOOT if MVEBU_SPL_BOOT_DEVICE_MMC
	default MVEBU_SATA_BOOT if MVEBU_SPL_BOOT_DEVICE_SATA
	default MVEBU_SPI_BOOT

config MVEBU_NAND_BOOT
	bool "NAND flash boot"
	depends on NAND_PXA3XX
	help
	  Enable boot from NAND flash.
	  Allow usage of NAND flash as a target for "bubt" command
	  For details about bubt command please see the documentation
	  in doc/mvebu/cmd/bubt.txt

config MVEBU_SPI_BOOT
	bool "SPI flash boot"
	depends on SPI_FLASH
	help
	  Enable boot from SPI flash.
	  Allow usage of SPI flash as a target for "bubt" command
	  For details about bubt command please see the documentation
	  in doc/mvebu/cmd/bubt.txt

config MVEBU_MMC_BOOT
	bool "eMMC flash boot"
	depends on MVEBU_MMC || MMC_SDHCI_XENON
	help
	  Enable boot from eMMC boot partition
	  Allow usage of eMMC/SD device as a target for "bubt" command
	  For details about bubt command please see the documentation
	  in doc/mvebu/cmd/bubt.txt

config MVEBU_SATA_BOOT
	bool "SATA flash boot"
	depends on SCSI
	help
	  Enable boot from SATA disk.
	  Allow usage of SATA disk as a target for "bubt" command
	  For details about bubt command please see the documentation
	  in doc/mvebu/cmd/bubt.txt

endchoice

config MVEBU_UBOOT_DFLT_NAME
	string "Default image name for bubt command"
	default BUILD_TARGET if ARMADA_32BIT && BUILD_TARGET != ""
	default "flash-image.bin"
	help
	  This option should contain a default file name to be used with
	  MVEBU "bubt" command if the source file name is omitted

endif

config CMD_MVEBU_COMPHY_RX_TRAINING
	bool "mvebu_comphy_rx_training"
	depends on ARMADA_8K
	help
	  Perform COMPHY RX training sequence

endmenu
```

## release/src-rt-5.04behnd.4916/bootloaders/u-boot-2024.04/cmd/ti/Kconfig
```kconfig
menu "TI specific command line interface"

config CMD_DDR3
	bool "command for verifying DDR features"
	depends on ARCH_KEYSTONE || DRA7XX
	help
	   Support for testing ddr3 on TI platforms. This command
	   supports memory verification, memory comapre and ecc
	   verification if supported.

config CMD_PD
	bool "command for verifying power domains"
	depends on TI_POWER_DOMAIN
	help
	   Debug command for K3 power domains. For this to work, the
	   K3 power domain driver must be enabled for the u-boot; by
	   default it is only enabled for SPL.

endmenu
```
