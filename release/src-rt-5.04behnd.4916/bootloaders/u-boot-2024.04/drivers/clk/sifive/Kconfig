## release/src-rt-5.04behnd.4916/bootloaders/u-boot-2024.04/drivers/ddr/imx/imx8m/Kconfig
```kconfig
menu "i.MX8M DDR controllers"
	depends on ARCH_IMX8M

config IMX8M_DRAM
	bool "imx8m dram"
	select IMX_SNPS_DDR_PHY

config IMX8M_LPDDR4
	bool "imx8m lpddr4"
	select IMX8M_DRAM
	help
	  Select the i.MX8M LPDDR4 driver support on i.MX8M SOC.

config IMX8M_DDR4
	bool "imx8m ddr4"
	select IMX8M_DRAM
	help
	  Select the i.MX8M DDR4 driver support on i.MX8M SOC.

config IMX8M_DDR3L
	bool "imx8m ddr3l"
	select IMX8M_DRAM
	help
	  Select the i.MX8M DDR3L driver support on i.MX8M SOC.

config SAVED_DRAM_TIMING_BASE
	hex "Define the base address for saved dram timing"
	help
	  after DRAM is trained, need to save the dram related timming
	  info into memory for low power use. OCRAM_S is used for this
	  purpose on i.MX8MM.
	default 0x180000

config IMX8M_DRAM_INLINE_ECC
	bool "imx8mp inline ECC"
	depends on IMX8MP && IMX8M_LPDDR4
	help
	  Select this config if you want to use inline ecc feature for
	  imx8mp-evk board.

config IMX8M_VDD_SOC_850MV
	bool "imx8mp change the vdd_soc voltage to 850mv"
	depends on IMX8MP

config IMX8M_LPDDR4_FREQ0_2400MTS
	bool "imx8m PDDR4 freq0 change from 4000MTS to 2400MTS"

endmenu
```

## release/src-rt-5.04behnd.4916/bootloaders/u-boot-2024.04/drivers/ddr/imx/imx8ulp/Kconfig
```kconfig
menu "i.MX8ULP DDR controllers"
	depends on ARCH_IMX8ULP

config IMX8ULP_DRAM
	bool "imx8m dram"

config IMX8ULP_DRAM_PHY_PLL_BYPASS
	bool "Enable the DDR PHY PLL bypass mode, so PHY clock is from DDR_CLK "
	depends on IMX8ULP_DRAM

config SAVED_DRAM_TIMING_BASE
	hex "Define the base address for saved dram timing"
	help
	  The DRAM config timing data need to be saved into sram
	  for low power use.
	default 0x20055000

endmenu
```

## release/src-rt-5.04behnd.4916/bootloaders/u-boot-2024.04/drivers/ddr/imx/imx9/Kconfig
```kconfig
menu "i.MX9 DDR controllers"
	depends on ARCH_IMX9

config IMX9_DRAM
	bool "imx9 dram"
	select IMX_SNPS_DDR_PHY

config IMX9_LPDDR4X
	bool "imx9 lpddr4 and lpddr4x"
	select IMX9_DRAM
	help
	  Select the i.MX9 LPDDR4/4X driver support on i.MX9 SOC.

config IMX9_DRAM_PM_COUNTER
	bool "imx9 DDRC performance monitor counter"
	default y
	help
	  Enable DDR controller performance monitor counter for reference events.

config SAVED_DRAM_TIMING_BASE
	hex "Define the base address for saved dram timing"
	help
	  after DRAM is trained, need to save the dram related timming
	  info into memory for low power use.
	default 0x2051C000

endmenu
```

## release/src-rt-5.04behnd.4916/bootloaders/u-boot-2024.04/drivers/ddr/imx/phy/Kconfig
```kconfig
config IMX_SNPS_DDR_PHY
	bool "i.MX Snopsys DDR PHY"
	help
	  Select the DDR PHY driver support on i.MX8M and i.MX9 SOC.
```

## release/src-rt-5.04behnd.4916/bootloaders/u-boot-2024.04/drivers/dfu/Kconfig
```kconfig
menu "DFU support"

config DFU
	bool
	imply DFU_OVER_USB if USB_GADGET

config DFU_OVER_USB
	bool
	select HASH
	depends on USB_GADGET

config DFU_OVER_TFTP
	bool
	depends on NET

if DFU
config DFU_WRITE_ALT
	bool

config DFU_TFTP
	bool "DFU via TFTP"
	depends on NETDEVICES
	select UPDATE_COMMON
	select DFU_OVER_TFTP
	help
	  This option allows performing update of DFU-managed medium with data
	  sent via TFTP boot.

	  Detailed description of this feature can be found at ./doc/README.dfutftp

config DFU_TIMEOUT
	bool "Timeout waiting for DFU"
	help
	  This option adds an optional timeout parameter for DFU which, if set,
	  will cause DFU to only wait for that many seconds before exiting.

config DFU_MMC
	bool "MMC back end for DFU"
	depends on MMC
	help
	  This option enables using DFU to read and write to MMC based storage.

config DFU_MTD
	bool "MTD back end for DFU"
	depends on DM_MTD
	help
	  This option enables using DFU to read and write to on any MTD device.

config DFU_NAND
	bool "NAND back end for DFU"
	depends on CMD_MTDPARTS
	depends on MTD_RAW_NAND
	help
	  This option enables using DFU to read and write to NAND based
	  storage.

config DFU_NAND_TRIMFFS
	bool "Skip empty pages when flashing UBI images to NAND"
	depends on DFU_NAND
	help
	  When flashing UBI images to NAND, enable the DROP_FFS flag to drop
	  trailing all-0xff pages.

config DFU_RAM
	bool "RAM back end for DFU"
	help
	  This option enables using DFU to read and write RAM on the target.

config DFU_SF
	bool "SPI flash back end for DFU"
	help
	  This option enables using DFU to read and write to SPI flash based
	  storage.

config DFU_SF_PART
	bool "MTD partition support for SPI flash back end"
	depends on DFU_SF && CMD_MTDPARTS
	default y
	help
	  This option enables the support of "part" and "partubi" target in
	  SPI flash DFU back end.

config DFU_VIRT
	bool "VIRTUAL flash back end for DFU"
	help
	  This option enables using DFU to read and write to VIRTUAL device
	  used at board level to manage specific behavior
	  (OTP update for example).

config SET_DFU_ALT_INFO
	bool "Dynamic set of DFU alternate information"
	help
	  This option allows to call the function set_dfu_alt_info to
	  dynamically build dfu_alt_info in board.

config SYS_DFU_DATA_BUF_SIZE
	hex "Size of buffer to be allocated for transfer to raw storage device"
	default 0x800000
	help
	  DFU transfer uses a buffer before writing data to the
	  raw storage device. This value can be used for setting the
	  size of this buffer. The size of the buffer is also configurable
	  through the "dfu_bufsiz" environment variable. If both are
	  given the size of the buffer is set to "dfu_bufsize".

config SYS_DFU_MAX_FILE_SIZE
	hex "Size of the buffer to be allocated for transferring files"
	default SYS_DFU_DATA_BUF_SIZE
	help
	  When updating files rather than the raw storage device,
	  we use a static buffer to copy the file into and then write
	  the buffer once we've been given the whole file.  Define
	  this to the maximum filesize (in bytes) for the buffer.
	  If undefined it defaults to the CONFIG_SYS_DFU_DATA_BUF_SIZE.

config DFU_NAME_MAX_SIZE
	int "Size of the name to be added in dfu entity"
	default 32
	depends on DFU
	help
	  This value is used to maximum size. If name is longer than default size,
	  we need to change the proper maximum size.

endif
endmenu
```

## release/src-rt-5.04behnd.4916/bootloaders/u-boot-2024.04/drivers/dma/Kconfig
```kconfig
menu "DMA Support"

config DMA
	bool "Enable Driver Model for DMA drivers"
	depends on DM
	help
	  Enable driver model for DMA. DMA engines can do
	  asynchronous data transfers without involving the host
	  CPU. Currently, this framework can be used to offload
	  memory copies to and from devices like qspi, ethernet
	  etc Drivers provide methods to access the DMA devices
	  buses that is used to transfer data to and from memory.
	  The uclass interface is defined in include/dma.h.

config DMA_CHANNELS
	bool "Enable DMA channels support"
	depends on DMA
	help
	  Enable channels support for DMA. Some DMA controllers have multiple
	  channels which can either transfer data to/from different devices.

config SANDBOX_DMA
	bool "Enable the sandbox DMA test driver"
	depends on DMA && DMA_CHANNELS && SANDBOX
	help
	  Enable support for a test DMA uclass implementation. It stimulates
	  DMA transfer by simple copying data between channels.

config BCM6348_IUDMA
	bool "BCM6348 IUDMA driver"
	depends on ARCH_BMIPS
	select DMA_CHANNELS
	help
	  Enable the BCM6348 IUDMA driver.
	  This driver support data transfer from devices to
	  memory and from memory to devices.

config DMA_LPC32XX
	bool "LPC32XX DMA driver"
	select DMA_LEGACY
	help
	  Enable some legacy DMA code for lpc32xx. It provides some direct
	  functions likes lpc32xx_dma_wait_status() which can be called from
	  other code.

	  This should be converted to use driver model and UCLASS_DMA.

config TI_EDMA3
	bool "TI EDMA3 driver"
	select DMA_LEGACY
	help
	  Enable the TI EDMA3 driver for DRA7xx and AM43xx evms.
	  This driver support data transfer between memory
	  regions.

config TI_KSNAV
	bool "TI Keystone Navigator DMA driver"
	depends on ARCH_KEYSTONE
	default y
	select DMA_LEGACY
	help
	  Enable the Keystone Navigator driver for Keystone 2 platforms.

config APBH_DMA
	bool "Support APBH DMA"
	depends on MX23 || MX28 || MX6 || MX7 || IMX8 || IMX8M
	select DMA_LEGACY
	help
	  Enable APBH DMA driver.

config XILINX_DPDMA
	bool "Enable ZynqMP Display Port DMA driver"
	depends on DMA && ZYNQMP_POWER_DOMAIN
	help
	  Enable support for Xilinx ZynqMP Display DMA driver. Currently
	  this file is used as placeholder for driver. The main reason is
	  to record compatible string and calling power domain driver.

if APBH_DMA
config APBH_DMA_BURST
	bool "Enable DMA BURST"

config APBH_DMA_BURST8
	bool "Enable DMA BURST8"

endif

config DMA_LEGACY
	bool "Legacy DMA support"
	help
	  Enable legacy DMA support. This does not use driver model and should
	  be migrated to the new API.

	  It is required for some PowerPC boards.

source "drivers/dma/ti/Kconfig"

endmenu # menu "DMA Support"
```

## release/src-rt-5.04behnd.4916/bootloaders/u-boot-2024.04/drivers/extcon/Kconfig
```kconfig
menu "Extcon Support"

config EXTCON
	bool "External Connector Class (extcon) support"
	depends on DM
	help
	  Say Y here to enable external connector class (extcon) support.
	  This allows monitoring external connectors and supports external
	  connectors with multiple states; i.e., an extcon that may have
	  multiple cables attached. For example, an external connector
	  of a device may be used to connect an HDMI cable and a AC adaptor,
	  and to host USB ports. Many of 30-pin connectors including PDMI
	  are also good examples.

config EXTCON_SANDBOX
	bool "Sandbox extcon"
	depends on EXTCON
	help
	  Enable extcon support for sandbox. This is an emulation of a real
	  extcon. Currectly all configuration is done in the probe.

config EXTCON_MAX14526
	bool "Maxim MAX14526 EXTCON Support"
	depends on DM_I2C
	depends on EXTCON
	help
	  If you say yes here you get support for the MUIC device of
	  Maxim MAX14526. The MAX14526 MUIC is a USB port accessory
	  detector and switch.

endmenu
```
