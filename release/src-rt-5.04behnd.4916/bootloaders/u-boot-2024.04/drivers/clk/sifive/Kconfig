## release/src-rt-5.04behnd.4916/bootloaders/u-boot-2024.04/drivers/cpu/Kconfig
```kconfig
config CPU
	bool "Enable CPU drivers using Driver Model"
	help
	  This allows drivers to be provided for CPUs and their type to be
	  specified in the board's device tree. For boards which support
	  multiple CPUs, then normally have to be set up in U-Boot so that
	  they can work correctly in the OS. This provides a framework for
	  finding out information about available CPUs and making changes.

config CPU_IMX
	bool "Enable i.MX CPU driver"
	depends on CPU && ARM64
	help
	  Support CPU cores for SoCs of the i.MX series.

config CPU_MPC83XX
	bool "Enable MPC83xx CPU driver"
	depends on CPU && MPC83xx
	select CLK_MPC83XX
	help
	  Support CPU cores for SoCs of the MPC83xx series.

config CPU_RISCV
	bool "Enable RISC-V CPU driver"
	depends on CPU && RISCV
	help
	  Support CPU cores for RISC-V architecture.

config CPU_MICROBLAZE
	bool "Enable Microblaze CPU driver"
	depends on CPU && MICROBLAZE
	select DM_EVENT
	select XILINX_MICROBLAZE0_PVR
	help
	  Support CPU cores for Microblaze architecture.
```

## release/src-rt-5.04behnd.4916/bootloaders/u-boot-2024.04/drivers/crypto/Kconfig
```kconfig
menu "Hardware crypto devices"

source drivers/crypto/hash/Kconfig

source drivers/crypto/fsl/Kconfig

source drivers/crypto/aspeed/Kconfig

source drivers/crypto/nuvoton/Kconfig

endmenu
```

## release/src-rt-5.04behnd.4916/bootloaders/u-boot-2024.04/drivers/crypto/aspeed/Kconfig
```kconfig
config ASPEED_HACE
	bool "ASPEED Hash and Crypto Engine"
	depends on DM_HASH
	help
	  Select this option to enable a driver for using the SHA engine in
	  the ASPEED BMC SoCs.

	  Enabling this allows the use of SHA operations in hardware without
	  requiring the SHA software implementations. It also improves performance
	  and saves code size.

config ASPEED_ACRY
	bool "ASPEED RSA and ECC Engine"
	depends on ASPEED_AST2600
	help
	 Select this option to enable a driver for using the RSA/ECC engine in
	 the ASPEED BMC SoCs.

	 Enabling this allows the use of RSA/ECC operations in hardware without requiring the
	 software implementations. It also improves performance and saves code size.
```

## release/src-rt-5.04behnd.4916/bootloaders/u-boot-2024.04/drivers/crypto/fsl/Kconfig
```kconfig
config FSL_CAAM
	bool "Freescale Crypto Driver Support"
	select SHA_HW_ACCEL
	# hw_sha1() under drivers/crypto, and needed with SHA_HW_ACCEL
	select MISC if DM
	imply SPL_CRYPTO if (ARM && SPL)
	imply CMD_HASH
	help
	  Enables the Freescale's Cryptographic Accelerator and Assurance
	  Module (CAAM), also known as the SEC version 4 (SEC4). The driver uses
	  Job Ring as interface to communicate with CAAM.

config SYS_FSL_MAX_NUM_OF_SEC
	int "Number of job rings in the CAAM"
	depends on FSL_CAAM
	default 1

config CAAM_64BIT
	bool
	default y if PHYS_64BIT && !ARCH_IMX8M && !ARCH_IMX8
	help
	  Select Crypto driver for 64 bits CAAM version

config SYS_FSL_HAS_SEC
	bool
	help
		Enable Freescale Secure Boot and Trusted Architecture

config SYS_FSL_SEC_COMPAT_2
	bool
	help
		Secure boot and trust architecture compatible version 2

config SYS_FSL_SEC_COMPAT_4
	bool
	help
		Secure boot and trust architecture compatible version 4

config SYS_FSL_SEC_COMPAT_5
	bool
	help
		Secure boot and trust architecture compatible version 5

config SYS_FSL_SEC_COMPAT_6
	bool
	help
		Secure boot and trust architecture compatible version 6

config SYS_FSL_SEC_BE
	bool "Big-endian access to Freescale Secure Boot"

config SYS_FSL_SEC_COMPAT
	int "Freescale Secure Boot compatibility"
	depends on SYS_FSL_HAS_SEC
	default 2 if SYS_FSL_SEC_COMPAT_2
	default 4 if SYS_FSL_SEC_COMPAT_4
	default 5 if SYS_FSL_SEC_COMPAT_5
	default 6 if SYS_FSL_SEC_COMPAT_6

config SYS_FSL_SEC_LE
	bool "Little-endian access to Freescale Secure Boot"

if FSL_CAAM

config FSL_CAAM_RNG
	bool "Enable Random Number Generator support"
	depends on DM_RNG
	default y
	help
	  Enable support for the hardware based random number generator
	  module of the CAAM. The random data is fetched from the DRGB
	  using the prediction resistance flag which means the DRGB is
	  reseeded from the TRNG every time random data is generated.

endif

config FSL_DCP_RNG
	bool "Enable Random Number Generator support"
	depends on DM_RNG
	help
	  Enable support for the hardware based random number generator
	  module of the DCP. It uses the True Random Number Generator (TRNG)
	  and a Pseudo-Random Number Generator (PRNG) to achieve a true
	  randomness and cryptographic strength.
```

## release/src-rt-5.04behnd.4916/bootloaders/u-boot-2024.04/drivers/crypto/hash/Kconfig
```kconfig
config DM_HASH
	bool "Enable Driver Model for Hash"
	depends on DM
	help
	  If you want to use driver model for Hash, say Y.

config HASH_SOFTWARE
	bool "Enable driver for Hash in software"
	depends on DM_HASH
	depends on MD5
	depends on SHA1
	depends on SHA256
	depends on SHA384
	depends on SHA512
	help
	  Enable driver for hashing operations in software. Currently
	  it support multiple hash algorithm including CRC/MD5/SHA.

config HASH_ASPEED
	bool "Enable Hash with ASPEED hash accelerator"
	depends on DM_HASH
	select ASPEED_HACE
	help
	  Enable this to support HW-assisted hashing operations using ASPEED Hash
	  and Crypto engine - HACE
```

## release/src-rt-5.04behnd.4916/bootloaders/u-boot-2024.04/drivers/crypto/nuvoton/Kconfig
```kconfig
config NPCM_AES
	bool "Support the NPCM AES algorithm"
	select NPCM_OTP
	help
	  This provides a means to encrypt and decrypt data using the NPCM
	  AES (Advanced Encryption Standard). This algorithm uses a symmetric
	  key and is widely used as a streaming cipher. This command only
	  supports AES256-CBC.

config NPCM_SHA
	bool "Enable NPCM cryptographic HW SHA accelerator"
	help
	  This option enables support of NPCM cryptographic HW SHA accelerator.
	  It supports SHA1 and SHA256 hashing algorithms.
```

## release/src-rt-5.04behnd.4916/bootloaders/u-boot-2024.04/drivers/ddr/Kconfig
```kconfig
choice
	prompt "Method to determine DDR clock frequency"
	default STATIC_DDR_CLK_FREQ
	depends on ARCH_P1010 || ARCH_P1020 || ARCH_P2020 || ARCH_T1024 \
		|| ARCH_T1042 || ARCH_T2080 || ARCH_T4240 || ARCH_LS1021A \
		|| FSL_LSCH2 || FSL_LSCH3 || TARGET_KMCENT2
	help
	  The DDR clock frequency can either be defined statically now at
	  build time, or can be determined at run-time via the
	  get_board_ddr_clk function.

config DYNAMIC_DDR_CLK_FREQ
	bool "Run-time DDR clock frequency"

config STATIC_DDR_CLK_FREQ
	bool "Build-time static DDR clock frequency"

endchoice

config DDR_CLK_FREQ
	int "DDR clock frequency in Hz"
	depends on STATIC_DDR_CLK_FREQ
	default 100000000
	help
	  The DDR clock frequency, specified in Hz.

config DDR_SPD
	bool "JEDEC Serial Presence Detect (SPD) support"
	help
	  For memory controllers that can utilize it, add enable support for
	  using the JEDEC SDP standard.

config SYS_SPD_BUS_NUM
	int "I2C bus number for DDR SPD"
	depends on DDR_SPD || SYS_I2C_LEGACY || SPL_SYS_I2C_LEGACY
	default 0

source "drivers/ddr/altera/Kconfig"
source "drivers/ddr/imx/Kconfig"

config SPD_EEPROM
	bool "DDR controller makes use of an SPD EEPROM for JEDEC information"
	depends on SYS_FSL_DDR || SYS_FSL_MMDC || CONFIG_ARMADA_XP
	help
	  Get DDR timing information from an I2C EEPROM. Common with pluggable
	  memory modules such as SODIMMs. You must define SPD_EEPROM_ADDRESS
	  to the I2C address of the SPD EEPROM.
```

## release/src-rt-5.04behnd.4916/bootloaders/u-boot-2024.04/drivers/ddr/altera/Kconfig
```kconfig
config SPL_ALTERA_SDRAM
	bool "SoCFPGA DDR SDRAM driver in SPL"
	depends on SPL
	depends on TARGET_SOCFPGA_GEN5 || TARGET_SOCFPGA_ARRIA10 || TARGET_SOCFPGA_SOC64
	select RAM if TARGET_SOCFPGA_GEN5 || TARGET_SOCFPGA_SOC64
	select SPL_RAM if TARGET_SOCFPGA_GEN5 || TARGET_SOCFPGA_SOC64
	help
	  Enable DDR SDRAM controller for the SoCFPGA devices.
```

## release/src-rt-5.04behnd.4916/bootloaders/u-boot-2024.04/drivers/ddr/fsl/Kconfig
```kconfig
config SYS_FSL_DDR
	bool
	help
	  Select Freescale General DDR driver, shared between most Freescale
	  PowerPC- based SoCs (such as mpc83xx, mpc85xx and ARM- based
	  Layerscape SoCs (such as ls2080a).

config SYS_FSL_MMDC
	bool
	help
	  Select Freescale Multi Mode DDR controller (MMDC).

config SYS_FSL_DDR_EMU
	bool
	help
	  Specify emulator support for DDR. Some DDR features such as deskew
	  training are not available.

if SYS_FSL_DDR || SYS_FSL_MMDC

config SYS_FSL_DDR_BE
	bool
	help
		Access DDR registers in big-endian

config SYS_FSL_DDR_LE
	bool
	help
		Access DDR registers in little-endian

config FSL_DDR_BIST
	bool

config FSL_DDR_INTERACTIVE
	bool

config FSL_DDR_SYNC_REFRESH
	bool

config FSL_DDR_FIRST_SLOT_QUAD_CAPABLE
	bool

config SYS_FSL_OTHER_DDR_NUM_CTRLS
	bool

menu "Freescale DDR controllers"
	depends on SYS_FSL_DDR

config SYS_NUM_DDR_CTLRS
	int "Maximum DDR controllers"
	default 3 if	ARCH_LS2080A	|| \
			ARCH_T4240
	default 2 if	ARCH_B4860	|| \
			ARCH_BSC9132	|| \
			ARCH_P4080	|| \
			ARCH_P5040	|| \
			ARCH_LX2160A	|| \
			ARCH_LX2162A
	default 1

config CHIP_SELECTS_PER_CTRL
	int "Number of chip selects per controller"
	default 4

config DIMM_SLOTS_PER_CTLR
	int "Number of DIMM slots per controller"
	default 1

config SYS_FSL_DDR_MAIN_NUM_CTRLS
	int "Number of controllers used as main memory"
	default SYS_NUM_DDR_CTLRS

config SYS_FSL_DDR_VER
	int
	default 50 if SYS_FSL_DDR_VER_50
	default 47 if SYS_FSL_DDR_VER_47
	default 46 if SYS_FSL_DDR_VER_46
	default 44 if SYS_FSL_DDR_VER_44

config SYS_FSL_DDR_VER_50
	bool

config SYS_FSL_DDR_VER_47
	bool

config SYS_FSL_DDR_VER_46
	bool

config SYS_FSL_DDR_VER_44
	bool

config SYS_FSL_DDRC_GEN1
	bool
	help
	  Enable Freescale DDR controller.

config SYS_FSL_DDRC_GEN2
	bool
	depends on !MPC86xx
	help
	  Enable Freescale DDR2 controller.

config SYS_FSL_DDRC_GEN3
	bool
	depends on PPC
	help
	  Enable Freescale DDR3 controller for PowerPC SoCs.

config SYS_FSL_DDRC_ARM_GEN3
	bool
	depends on ARM
	help
	  Enable Freescale DDR3 controller for ARM SoCs.

config SYS_FSL_DDRC_GEN4
	bool
	help
	  Enable Freescale DDR4 controller.

config SYS_FSL_HAS_DDR4
	bool

config SYS_FSL_HAS_DDR3
	bool

config SYS_FSL_HAS_DDR2
	bool

config SYS_FSL_HAS_DDR1
	bool

choice
	prompt "DDR technology"
	default SYS_FSL_DDR4 if SYS_FSL_HAS_DDR4
	default SYS_FSL_DDR3 if SYS_FSL_HAS_DDR3
	default SYS_FSL_DDR2 if SYS_FSL_HAS_DDR2
	default SYS_FSL_DDR1 if SYS_FSL_HAS_DDR1

config SYS_FSL_DDR4
	bool "Freescale DDR4 controller"
	depends on SYS_FSL_HAS_DDR4
	imply DDR_SPD
	select SYS_FSL_DDRC_GEN4

config SYS_FSL_DDR3
	bool "Freescale DDR3 controller"
	depends on SYS_FSL_HAS_DDR3
	imply DDR_SPD
	select SYS_FSL_DDRC_GEN3 if PPC
	select SYS_FSL_DDRC_ARM_GEN3 if ARM

config SYS_FSL_DDR2
	bool "Freescale DDR2 controller"
	depends on SYS_FSL_HAS_DDR2
	imply DDR_SPD
	select SYS_FSL_DDRC_GEN2 if (!MPC86xx && !SYS_FSL_DDRC_GEN3)

config SYS_FSL_DDR1
	bool "Freescale DDR1 controller"
	depends on SYS_FSL_HAS_DDR1
	imply DDR_SPD
	select SYS_FSL_DDRC_GEN1

endchoice

endmenu

config FSL_DMA
	def_bool y if DDR_ECC && MPC85xx && !ECC_INIT_VIA_DDRCONTROLLER

config DDR_ECC
	bool "ECC DDR memory support"

config DDR_ECC_CMD
	bool "Access the ECC features of the memory controller"
	depends on DDR_ECC && MPC83xx
	default y

config ECC_INIT_VIA_DDRCONTROLLER
	bool "DDR Memory controller initializes memory."
	help
	  Use the DDR controller to auto initialize memory.  If not enabled,
	  the DMA controller is responsible for doing this.

config SYS_DDR_RAW_TIMING
	bool "Get DDR timing information from something other than SPD"
	help
	  This is common with soldered DDR chips onboard without SPD. DDR raw
	  timing parameters are extracted from datasheet and hard-coded into
	  header files or board specific files.

config SYS_FSL_DDR_INTLV_256B
	bool "Enforce 256-byte interleave"
	help
	  DDR controller interleaving on 256-byte. This is a special
	  interleaving mode, handled by Dickens for Freescale layerscape SoCs
	  with ARM core.

endif

menu "PowerPC / M68K initial memory controller definitions (FLASH, SDRAM, etc)"
	depends on MCF52x2 || MPC8xx || MPC83xx || MPC85xx

config SYS_BR0_PRELIM_BOOL
	bool "Define Bank 0"

config SYS_BR0_PRELIM
	hex "Preliminary value for BR0"
	depends on SYS_BR0_PRELIM_BOOL

config SYS_OR0_PRELIM
	hex "Preliminary value for OR0"
	depends on SYS_BR0_PRELIM_BOOL

config SYS_BR1_PRELIM_BOOL
	bool "Define Bank 1"

config SYS_BR1_PRELIM
	hex "Preliminary value for BR1"
	depends on SYS_BR1_PRELIM_BOOL

config SYS_OR1_PRELIM
	hex "Preliminary value for OR1"
	depends on SYS_BR1_PRELIM_BOOL

config SYS_BR2_PRELIM_BOOL
	bool "Define Bank 2"

config SYS_BR2_PRELIM
	hex "Preliminary value for BR2"
	depends on SYS_BR2_PRELIM_BOOL

config SYS_OR2_PRELIM
	hex "Preliminary value for OR2"
	depends on SYS_BR2_PRELIM_BOOL

config SYS_BR3_PRELIM_BOOL
	bool "Define Bank 3"

config SYS_BR3_PRELIM
	hex "Preliminary value for BR3"
	depends on SYS_BR3_PRELIM_BOOL

config SYS_OR3_PRELIM
	hex "Preliminary value for OR3"
	depends on SYS_BR3_PRELIM_BOOL

config SYS_BR4_PRELIM_BOOL
	bool "Define Bank 4"

config SYS_BR4_PRELIM
	hex "Preliminary value for BR4"
	depends on SYS_BR4_PRELIM_BOOL

config SYS_OR4_PRELIM
	hex "Preliminary value for OR4"
	depends on SYS_BR4_PRELIM_BOOL

config SYS_BR5_PRELIM_BOOL
	bool "Define Bank 5"

config SYS_BR5_PRELIM
	hex "Preliminary value for BR5"
	depends on SYS_BR5_PRELIM_BOOL

config SYS_OR5_PRELIM
	hex "Preliminary value for OR5"
	depends on SYS_BR5_PRELIM_BOOL

config SYS_BR6_PRELIM_BOOL
	bool "Define Bank 6"

config SYS_BR6_PRELIM
	hex "Preliminary value for BR6"
	depends on SYS_BR6_PRELIM_BOOL

config SYS_OR6_PRELIM
	hex "Preliminary value for OR6"
	depends on SYS_BR6_PRELIM_BOOL

config SYS_BR7_PRELIM_BOOL
	bool "Define Bank 7"

config SYS_BR7_PRELIM
	hex "Preliminary value for BR7"
	depends on SYS_BR7_PRELIM_BOOL

config SYS_OR7_PRELIM
	hex "Preliminary value for OR7"
	depends on SYS_BR7_PRELIM_BOOL
endmenu

if TARGET_P1010RDB_PA || TARGET_P1010RDB_PB || TARGET_P1020RDB_PC || \
	TARGET_P1020RDB_PD || TARGET_P2020RDB

config COMMON_INIT_DDR
	bool "Do not have a TLB entry to cover common DDR init with serial presence detect (SPD)"

config SPL_COMMON_INIT_DDR
	bool "Do not have a TLB entry to cover common DDR init with SPD in SPL"

config TPL_COMMON_INIT_DDR
	bool "Do not have a TLB entry to cover common DDR init with SPD in TPL"

endif

config SYS_FSL_ERRATUM_A008378
	bool

config SYS_FSL_ERRATUM_A008109
	bool

config SYS_FSL_ERRATUM_A008511
	bool

config SYS_FSL_ERRATUM_A009663
	bool

config SYS_FSL_ERRATUM_A009801
	bool

config SYS_FSL_ERRATUM_A009803
	bool

config SYS_FSL_ERRATUM_A009942
	bool

config SYS_FSL_ERRATUM_A010165
	bool

config SYS_FSL_ERRATUM_NMG_DDR120
	bool

config SYS_FSL_ERRATUM_DDR_115
	bool

config SYS_FSL_ERRATUM_DDR111_DDR134
	bool

config SYS_FSL_ERRATUM_DDR_A003
	bool

config SYS_FSL_ERRATUM_DDR_A003474
	bool
```

## release/src-rt-5.04behnd.4916/bootloaders/u-boot-2024.04/drivers/ddr/imx/Kconfig
```kconfig
source "drivers/ddr/imx/imx8m/Kconfig"
source "drivers/ddr/imx/imx8ulp/Kconfig"
source "drivers/ddr/imx/imx9/Kconfig"
source "drivers/ddr/imx/phy/Kconfig"
```
