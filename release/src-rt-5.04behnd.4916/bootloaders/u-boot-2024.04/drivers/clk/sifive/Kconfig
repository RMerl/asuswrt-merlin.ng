## release/src-rt-5.04behnd.4916/bootloaders/u-boot-2024.04/drivers/clk/sifive/Kconfig
```kconfig
# SPDX-License-Identifier: GPL-2.0

config CLK_SIFIVE
	bool "SiFive SoC driver support"
	depends on CLK
	help
	  SoC drivers for SiFive Linux-capable SoCs.

config CLK_SIFIVE_PRCI
	bool "PRCI driver for SiFive SoCs"
	depends on CLK_SIFIVE
	select CLK_ANALOGBITS_WRPLL_CLN28HPC
	help
	  Supports the Power Reset Clock interface (PRCI) IP block found in
	  FU540/FU740 SoCs. If this kernel is meant to run on a SiFive FU540/
	  FU740 SoCs, enable this driver.
```

## release/src-rt-5.04behnd.4916/bootloaders/u-boot-2024.04/drivers/clk/starfive/Kconfig
```kconfig
# SPDX-License-Identifier: GPL-2.0+

config SPL_CLK_JH7110
	bool "SPL clock support for JH7110"
	depends on STARFIVE_JH7110 && SPL
	select SPL_CLK
	select SPL_CLK_CCF
	help
	  This enables SPL DM support for clock driver in JH7110.

config CLK_JH7110
	bool "StarFive JH7110 clock support"
	depends on STARFIVE_JH7110
	select CLK
	select CLK_CCF
	help
	  This enables support clock driver for StarFive JH7110 SoC platform.
```

## release/src-rt-5.04behnd.4916/bootloaders/u-boot-2024.04/drivers/clk/stm32/Kconfig
```kconfig
config CLK_STM32F
	bool "Enable clock driver support for STM32F family"
	depends on CLK && (STM32F7 || STM32F4)
	default y
	help
	  This clock driver adds support for RCC clock management
	  for STM32F4 and STM32F7 SoCs.

config CLK_STM32H7
	bool "Enable clock driver support for STM32H7 family"
	depends on CLK && STM32H7
	default y
	help
	  This clock driver adds support for RCC clock management
	  for STM32H7 SoCs.

config CLK_STM32_CORE
	bool "Enable RCC clock core driver for STM32MP"
	depends on ARCH_STM32MP && CLK
	select CLK_CCF
	select CLK_COMPOSITE_CCF

config CLK_STM32MP1
	bool "Enable RCC clock driver for STM32MP15"
	depends on ARCH_STM32MP && CLK
	default y if STM32MP15X
	help
	  Enable the STM32 clock (RCC) driver. Enable support for
	  manipulating STM32MP15's on-SoC clocks.

config CLK_STM32MP13
	bool "Enable RCC clock driver for STM32MP13"
	depends on ARCH_STM32MP && CLK
	default y if STM32MP13X
	select CLK_STM32_CORE
	help
	  Enable the STM32 clock (RCC) driver. Enable support for
	  manipulating STM32MP13's on-SoC clocks.
```

## release/src-rt-5.04behnd.4916/bootloaders/u-boot-2024.04/drivers/clk/tegra/Kconfig
```kconfig
config TEGRA_CAR_CLOCK
	bool "Enable Tegra CAR-based clock driver"
	depends on TEGRA_CAR
	help
	  Enable support for manipulating Tegra's on-SoC clocks via direct
	  register access to the Tegra CAR (Clock And Reset controller).

config TEGRA186_CLOCK
	bool "Enable Tegra186 BPMP-based clock driver"
	depends on TEGRA186_BPMP
	help
	  Enable support for manipulating Tegra's on-SoC clocks via IPC
	  requests to the BPMP (Boot and Power Management Processor).
```

## release/src-rt-5.04behnd.4916/bootloaders/u-boot-2024.04/drivers/clk/ti/Kconfig
```kconfig
# SPDX-License-Identifier: GPL-2.0+
#
# Copyright (C) 2020 Dario Binacchi <dariobin@libero.it>
#

config CLK_TI_AM3_DPLL
	bool "TI AM33XX Digital Phase-Locked Loop (DPLL) clock drivers"
	depends on CLK && OF_CONTROL
	help
	  This enables the DPLL clock drivers support on AM33XX SoCs. The DPLL
	  provides all interface clocks and functional clocks to the processor.

config CLK_TI_CTRL
	bool "TI OMAP4 clock controller"
	depends on CLK && OF_CONTROL
	help
	  This enables the clock controller driver support on TI's SoCs.

config CLK_TI_DIVIDER
	bool "TI divider clock driver"
	depends on CLK && OF_CONTROL && CLK_CCF
	help
	  This enables the divider clock driver support on TI's SoCs.

config CLK_TI_GATE
	bool "TI gate clock driver"
	depends on CLK && OF_CONTROL
	help
	  This enables the gate clock driver support on TI's SoCs.

config CLK_TI_MUX
	bool "TI mux clock driver"
	depends on CLK && OF_CONTROL && CLK_CCF
	help
	  This enables the mux clock driver support on TI's SoCs.

config CLK_TI_SCI
	bool "TI System Control Interface (TI SCI) clock driver"
	depends on CLK && TI_SCI_PROTOCOL && OF_CONTROL
	help
	  This enables the clock driver support over TI System Control Interface
	  available on some new TI's SoCs. If you wish to use clock resources
	  managed by the TI System Controller, say Y here. Otherwise, say N.

config CLK_K3_PLL
	bool "PLL clock support for K3 SoC family of devices"
	depends on CLK && LIB_RATIONAL
	help
	  Enables PLL clock support for K3 SoC family of devices.

config SPL_CLK_K3_PLL
	bool "PLL clock support for K3 SoC family of devices"
	depends on CLK && LIB_RATIONAL && SPL
	help
	  Enables PLL clock support for K3 SoC family of devices.

config CLK_K3
	bool "Clock support for K3 SoC family of devices"
	depends on CLK
	help
	  Enables the clock translation layer from DT to device clocks.

config SPL_CLK_K3
	bool "Clock support for K3 SoC family of devices"
	depends on CLK && SPL
	help
	  Enables the clock translation layer from DT to device clocks.
```
