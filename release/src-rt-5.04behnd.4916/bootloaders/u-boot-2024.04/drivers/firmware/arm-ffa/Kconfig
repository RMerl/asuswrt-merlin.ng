## release/src-rt-5.04behnd.4916/bootloaders/u-boot-2024.04/drivers/firmware/arm-ffa/Kconfig
```kconfig
# SPDX-License-Identifier: GPL-2.0

config ARM_FFA_TRANSPORT
	bool "Enable Arm Firmware Framework for Armv8-A driver"
	depends on DM && (ARM64 || SANDBOX)
	select ARM_SMCCC if !SANDBOX
	select ARM_SMCCC_FEATURES if !SANDBOX
	imply CMD_ARMFFA
	select LIB_UUID
	select DEVRES
	help
	  The Firmware Framework for Arm A-profile processors (FF-A)
	  describes interfaces (ABIs) that standardize communication
	  between the Secure World and Normal World leveraging TrustZone
	  technology.

	  The FF-A support in U-Boot is based on FF-A specification v1.0 and uses SMC32
	  calling convention.

	  FF-A specification:

	  https://developer.arm.com/documentation/den0077/a/?lang=en

	  In U-Boot FF-A design, FF-A is considered as a discoverable bus.
	  FF-A bus is discovered using ARM_SMCCC_FEATURES mechanism performed
	  by the PSCI driver.
	  The Secure World is considered as one entity to communicate with
	  using the FF-A bus.
	  FF-A communication is handled by one device and one instance (the bus).
	  The FF-A support on U-Boot  takes care of all the interactions between Normal
	  world and Secure World.

	  Generic FF-A methods are implemented in the Uclass (arm-ffa-uclass.c).
	  Arm specific methods are implemented in the Arm driver (arm-ffa.c).

	  FF-A sandbox is provided to run FF-A under sandbox and allows to test the FF-A Uclass.
	  Sandbox support includes an emulator for Arm FF-A which emulates the FF-A side of
	  the Secure World and provides FF-A ABIs inspection methods (ffa-emul-uclass.c).
	  An FF-A sandbox driver is also provided for FF-A communication with the emulated
	  Secure World (sandbox_ffa.c).

	  For more details about the FF-A support, please refer to doc/arch/arm64.ffa.rst
```

## release/src-rt-5.04behnd.4916/bootloaders/u-boot-2024.04/drivers/firmware/scmi/Kconfig
```kconfig
config SCMI_FIRMWARE
	bool "Enable SCMI support"
	select FIRMWARE
	select OF_TRANSLATE
	depends on SANDBOX || DM_MAILBOX || ARM_SMCCC || OPTEE
	help
	  System Control and Management Interface (SCMI) is a communication
	  protocol that defines standard interfaces for power, performance
	  and system management. The SCMI specification is available at
	  https://developer.arm.com/architectures/system-architectures/software-standards/scmi

	  An SCMI agent communicates with a related SCMI server firmware
	  located in another sub-system, as a companion micro controller
	  or a companion host in the CPU system.

	  Communications between agent (client) and the SCMI server are
	  based on message exchange. Messages can be exchanged over transport
	  channels as a mailbox device or an Arm SMCCC service with some
	  piece of identified shared memory.

config SCMI_AGENT_MAILBOX
	bool "Enable SCMI agent mailbox"
	depends on SCMI_FIRMWARE && DM_MAILBOX
	default y
	help
	  Enable the SCMI communication channel based on mailbox
	  for compatible "arm,scmi".

config SCMI_AGENT_SMCCC
	bool "Enable SCMI agent SMCCC"
	depends on SCMI_FIRMWARE && ARM_SMCCC
	default y
	help
	  Enable the SCMI communication channel based on Arm SMCCC service for
	  compatible "arm,scmi-smc".

config SCMI_AGENT_OPTEE
	bool "Enable SCMI agent OP-TEE"
	depends on SCMI_FIRMWARE && OPTEE
	default y
	help
	  Enable the SCMI communication channel based on OP-TEE transport
	  for compatible "linaro,scmi-optee".
```

## release/src-rt-5.04behnd.4916/bootloaders/u-boot-2024.04/drivers/fpga/Kconfig
```kconfig
menu "FPGA support"

config FPGA
	bool

config FPGA_ALTERA
	bool "Enable Altera FPGA drivers"
	select FPGA
	help
	  Say Y here to enable the Altera FPGA driver

	  This provides basic infrastructure to support Altera FPGA devices.
	  Enable Altera FPGA specific functions which includes bitstream
	  (in BIT format), fpga and device validation.

config FPGA_SOCFPGA
	bool "Enable Gen5 and Arria10 common FPGA drivers"
	select FPGA_ALTERA
	help
	  Say Y here to enable the Gen5 and Arria10 common FPGA driver

	  This provides common functionality for Gen5 and Arria10 devices.

config FPGA_STRATIX_II
	bool "Enable Stratix II FPGA drivers"
	depends on FPGA_ALTERA
	help
	  Say Y here to enable the Altera Stratix II FPGA-specific driver.

config FPGA_STRATIX_V
	bool "Enable Stratix V FPGA drivers"
	depends on FPGA_ALTERA
	help
	  Say Y here to enable the Altera Stratix V FPGA specific driver.

config FPGA_ACEX1K
	bool "Enable Altera ACEX 1K driver"
	depends on FPGA_ALTERA
	help
	  Say Y here to enable the Altera ACEX 1K FPGA specific driver.

config FPGA_CYCLON2
	bool "Enable Altera FPGA driver for Cyclone II"
	depends on FPGA_ALTERA
	help
	  Say Y here to enable the Altera Cyclone II FPGA specific driver

	  This provides common functionality for Altera Cyclone II devices.
	  Enable FPGA driver for loading bitstream in BIT and BIN format
	  on Altera Cyclone II device.

config FPGA_INTEL_SDM_MAILBOX
	bool "Enable Intel FPGA Full Reconfiguration SDM Mailbox driver"
	depends on TARGET_SOCFPGA_SOC64
	select FPGA_ALTERA
	help
	  Say Y here to enable the Intel FPGA Full Reconfig SDM Mailbox driver

	  This provides common functionality for Intel FPGA devices.
	  Enable FPGA driver for writing full bitstream into Intel FPGA
	  devices through SDM (Secure Device Manager) Mailbox.

config FPGA_LATTICE
	bool "Enable Lattice FPGA driver"
	help
	  This is used for the lattice FPGAs. Please check the source code as
	  there is no documentation for this at present.

config FPGA_XILINX
	bool "Enable Xilinx FPGA drivers"
	select FPGA
	help
	  Enable Xilinx FPGA specific functions which includes bitstream
	  (in BIT format), fpga and device validation.

config FPGA_ZYNQMPPL
	bool "Enable Xilinx FPGA driver for ZynqMP"
	depends on FPGA_XILINX && ZYNQMP_FIRMWARE
	help
	  Enable FPGA driver for loading bitstream in BIT and BIN format
	  on Xilinx Zynq UltraScale+ (ZynqMP) device.

config FPGA_VERSALPL
	bool "Enable Xilinx FPGA driver for Versal"
	depends on FPGA_XILINX
	help
	  Enable FPGA driver for loading bitstream in PDI format on Xilinx
	  Versal device. PDI is a new programmable device image format for
	  Versal. The bitstream will only be generated as PDI for Versal
	  platform.

config FPGA_SPARTAN2
	bool "Enable Spartan2 FPGA driver"
	depends on FPGA_XILINX
	help
	  Enable Spartan2 FPGA driver.

config FPGA_SPARTAN3
	bool "Enable Spartan3 FPGA driver"
	depends on FPGA_XILINX
	help
	  Enable Spartan3 FPGA driver for loading in BIT format.

config FPGA_VIRTEX2
	bool "Enable Xilinx Virtex-II and later FPGA driver"
	depends on FPGA_XILINX
	help
	  Enable Virtex-II FPGA driver for loading in BIT format. This driver
	  also supports many newer Xilinx FPGA families.

config SYS_FPGA_CHECK_BUSY
	bool "Perform busy check during load from FPGA"
	depends on FPGA_SPARTAN2 || FPGA_SPARTAN3 || FPGA_VIRTEX2

config FPGA_ZYNQPL
	bool "Enable Xilinx FPGA for Zynq"
	depends on ARCH_ZYNQ
	help
	  Enable FPGA driver for loading bitstream in BIT and BIN format
	  on Xilinx Zynq devices.

config SYS_FPGA_CHECK_CTRLC
	bool "Allow Control-C to interrupt FPGA configuration"
	depends on FPGA
	help
	  User can interrupt FPGA configuration by pressing CTRL+C.

config SYS_FPGA_PROG_FEEDBACK
	bool "Progress output during FPGA configuration"
	depends on FPGA
	default y if FPGA_VIRTEX2
	help
	  Enable printing of hash marks during FPGA configuration.

config FPGA_LOAD_SECURE
	bool "Enable loading secure bitstreams"
	depends on FPGA
	help
	  Enables the fpga loads() functions that are used to load secure
	  (authenticated or encrypted or both) bitstreams on to FPGA.

config SPL_FPGA_LOAD_SECURE
	bool "Enable loading secure bitstreams for SPL"
	depends on SPL_FPGA
	help
	  Enables the fpga loads() functions that are used to load secure
	  (authenticated or encrypted or both) bitstreams on to FPGA.

config DM_FPGA
	bool "Enable Driver Model for FPGA drivers"
	depends on DM
	select FPGA
	help
	  Enable driver model for Field-Programmable Gate Array (FPGA) devices.
	  The devices cover a wide range of applications and are configured at
	  runtime by loading a bitstream into the FPGA device.
	  Loading a bitstream from any kind of storage is the main task of the
	  FPGA drivers.
	  For now this uclass has no methods yet.

config SANDBOX_FPGA
	bool "Enable sandbox FPGA driver"
	depends on SANDBOX && DM_FPGA
	help
	  This is a driver model based FPGA driver for sandbox.
	  Currently it is a stub only, as there are no usable uclass methods yet.

config MAX_FPGA_DEVICES
	int "Maximum number of FPGA devices"
	depends on FPGA
	default 5

endmenu
```

## release/src-rt-5.04behnd.4916/bootloaders/u-boot-2024.04/drivers/fuzz/Kconfig
```kconfig
config DM_FUZZING_ENGINE
	bool "Driver support for fuzzing engine devices"
	depends on DM
	help
	  Enable driver model for fuzzing engine devices. This interface is
	  used to get fuzzing inputs from a fuzzing engine.

if DM_FUZZING_ENGINE

config FUZZING_ENGINE_SANDBOX
	bool "Sanbox fuzzing engine"
	depends on SANDBOX
	default y
	help
	  Enable fuzzing engine for sandbox.

endif
```

## release/src-rt-5.04behnd.4916/bootloaders/u-boot-2024.04/drivers/fwu-mdata/Kconfig
```kconfig
config FWU_MDATA
	bool "Driver support for accessing FWU Metadata"
	depends on DM
	help
	  Enable support for accessing FWU Metadata partitions. The
	  FWU Metadata partitions reside on the same storage device
	  which contains the other FWU updatable firmware images.

choice
	prompt "Storage Layout Scheme"
	depends on FWU_MDATA
	default FWU_MDATA_GPT_BLK

config FWU_MDATA_GPT_BLK
	bool "FWU Metadata access for GPT partitioned Block devices"
	select PARTITION_TYPE_GUID
	select PARTITION_UUIDS
	depends on FWU_MDATA && BLK && EFI_PARTITION
	help
	  Enable support for accessing FWU Metadata on GPT partitioned
	  block devices.

config FWU_MDATA_MTD
	bool "Raw MTD devices"
	depends on MTD
	help
	  Enable support for accessing FWU Metadata on non-partitioned
	  (or non-GPT partitioned, e.g. partition nodes in devicetree)
	  MTD devices.

endchoice
```

## release/src-rt-5.04behnd.4916/bootloaders/u-boot-2024.04/drivers/iommu/Kconfig
```kconfig
#
# IOMMU devices
#

menu "IOMMU device drivers"

config IOMMU
	bool "Enable Driver Model for IOMMU drivers"
	depends on DM
	help
	  Enable driver model for IOMMU devices. An IOMMU maps device
	  virtiual memory addresses to physical addresses. Devices
	  that sit behind an IOMMU can typically only access physical
	  memory if the IOMMU has been programmed to allow access to
	  that memory.

config APPLE_DART
	bool "Apple DART support"
	depends on IOMMU && ARCH_APPLE
	default y
	help
	  Enable support for the DART on Apple SoCs.  The DART is Apple's
	  IOMMU implementation.  The driver performs the necessary
	  configuration to put the DART into bypass mode such that it can
	  be used transparently by U-Boot.

config QCOM_HYP_SMMU
	bool "Qualcomm quirky SMMU support"
	depends on IOMMU && ARCH_SNAPDRAGON
	help
	  Enable support for the Qualcomm variant of the Arm System MMU-500.
	  Qualcomm boards have a non-standard SMMU where some registers are
	  emulated by the hypervisor. It is initialised early in the boot
	  process and can't be turned off.

	  The main caveat with this hardware is that it doesn't support BYPASS
	  streams, attempting to configure once will instead wind up with a
	  FAULT stream, and the device will crash when DMA is attempted.

	  Say Y here to enable support for non-boot peripherals like USB by
	  configuring identity mapped streams for them.

endmenu
```

## release/src-rt-5.04behnd.4916/bootloaders/u-boot-2024.04/drivers/mailbox/Kconfig
```kconfig
menu "Mailbox Controller Support"

config DM_MAILBOX
	bool "Enable mailbox controllers using Driver Model"
	depends on DM && OF_CONTROL
	help
	  Enable support for the mailbox driver class. Mailboxes provide the
	  ability to transfer small messages and/or notifications from one
	  CPU to another CPU, or sometimes to dedicated HW modules. They form
	  the basis of a variety of inter-process/inter-CPU communication
	  protocols.

config APPLE_MBOX
	bool "Enable Apple IOP controller support"
	depends on DM_MAILBOX && ARCH_APPLE
	default y
	help
	  Enable support for the mailboxes that provide a comminucation
	  channel with Apple IOP controllers integrated on Apple SoCs.
	  These IOP controllers are used to implement various functions
	  such as the System Management Controller (SMC) and NVMe and this
	  driver is required to get that functionality up and running.

config SANDBOX_MBOX
	bool "Enable the sandbox mailbox test driver"
	depends on DM_MAILBOX && SANDBOX
	help
	  Enable support for a test mailbox implementation, which simply echos
	  back a modified version of any message that is sent.

config TEGRA_HSP
	bool "Enable Tegra HSP controller support"
	depends on DM_MAILBOX && ARCH_TEGRA
	help
	  This enables support for the NVIDIA Tegra HSP Hw module, which
	  implements doorbells, mailboxes, semaphores, and shared interrupts.

config STM32_IPCC
	bool "Enable STM32 IPCC controller support"
	depends on DM_MAILBOX && ARCH_STM32MP
	help
	  This enables support for the STM32MP IPCC Hw module, which
	  implements doorbells between 2 processors.

config K3_SEC_PROXY
	bool "Texas Instruments K3 Secure Proxy Driver"
	depends on DM_MAILBOX && ARCH_K3
	help
	  An implementation of Secure proxy slave driver for K3 SoCs from
	  Texas Instruments. Secure proxy is a communication entity mainly
	  used for communication between multiple processors with the SoC.
	  Select this driver if your platform has support for this hardware
	  block.

config ZYNQMP_IPI
	bool "Xilinx ZynqMP IPI controller support"
	depends on DM_MAILBOX && (ARCH_ZYNQMP || ARCH_VERSAL || ARCH_VERSAL_NET)
	help
	  This enables support for the Xilinx ZynqMP Inter Processor Interrupt
	  communication controller.
endmenu
```
