## release/src-rt-5.04behnd.4916/bootloaders/u-boot-2024.04/lib/rsa/Kconfig
```kconfig
config RSA
	bool "Use RSA Library"
	select RSA_FREESCALE_EXP if FSL_CAAM && !ARCH_MX7 && !ARCH_MX7ULP && !ARCH_MX6 && !ARCH_MX5
	select RSA_ASPEED_EXP if ASPEED_ACRY
	select RSA_SOFTWARE_EXP if !RSA_FREESCALE_EXP && !RSA_ASPEED_EXP
	help
	  RSA support. This enables the RSA algorithm used for FIT image
	  verification in U-Boot.
	  See doc/uImage.FIT/signature.txt for more details.
	  The Modular Exponentiation algorithm in RSA is implemented using
	  driver model. So CONFIG_DM needs to be enabled by default for this
	  library to function.
	  The signing part is build into mkimage regardless of this
	  option. The software based modular exponentiation is built into
	  mkimage irrespective of this option.

if RSA

config SPL_RSA
	bool "Use RSA Library within SPL"
	depends on SPL

config TPL_RSA
	bool "Use RSA Library within TPL"
	depends on TPL

config SPL_RSA_VERIFY
	bool
	depends on SPL_RSA
	help
	  Add RSA signature verification support in SPL.

config TPL_RSA_VERIFY
	bool
	depends on TPL_RSA
	help
	  Add RSA signature verification support in TPL.

config RSA_VERIFY
	bool
	help
	  Add RSA signature verification support.

config RSA_VERIFY_WITH_PKEY
	bool "Execute RSA verification without key parameters from FDT"
	select RSA_VERIFY
	select ASYMMETRIC_KEY_TYPE
	select ASYMMETRIC_PUBLIC_KEY_SUBTYPE
	select RSA_PUBLIC_KEY_PARSER
	help
	  The standard RSA-signature verification code (FIT_SIGNATURE) uses
	  pre-calculated key properties, that are stored in fdt blob, in
	  decrypting a signature.
	  This does not suit the use case where there is no way defined to
	  provide such additional key properties in standardized form,
	  particularly UEFI secure boot.
	  This options enables RSA signature verification with a public key
	  directly specified in image_sign_info, where all the necessary
	  key properties will be calculated on the fly in verification code.

config SPL_RSA_VERIFY_WITH_PKEY
	bool "Execute RSA verification without key parameters from FDT within SPL"
	depends on SPL
	select SPL_RSA_VERIFY
	select SPL_ASYMMETRIC_KEY_TYPE
	select SPL_ASYMMETRIC_PUBLIC_KEY_SUBTYPE
	select SPL_RSA_PUBLIC_KEY_PARSER
	help
	  The standard RSA-signature verification code (FIT_SIGNATURE) uses
	  pre-calculated key properties, that are stored in fdt blob, in
	  decrypting a signature.
	  This does not suit the use case where there is no way defined to
	  provide such additional key properties in standardized form,
	  particularly UEFI secure boot.
	  This options enables RSA signature verification with a public key
	  directly specified in image_sign_info, where all the necessary
	  key properties will be calculated on the fly in verification code
	  in the SPL.

config RSA_SOFTWARE_EXP
	bool "Enable driver for RSA Modular Exponentiation in software"
	depends on DM
	help
	  Enables driver for modular exponentiation in software. This is a RSA
	  algorithm used in FIT image verification. It required RSA Key as
	  input.
	  See doc/uImage.FIT/signature.txt for more details.

config RSA_FREESCALE_EXP
	bool "Enable RSA Modular Exponentiation with FSL crypto accelerator"
	depends on DM && FSL_CAAM && !ARCH_MX7 && !ARCH_MX7ULP && !ARCH_MX6 && !ARCH_MX5
	help
	Enables driver for RSA modular exponentiation using Freescale cryptographic
	accelerator - CAAM.

config RSA_ASPEED_EXP
	bool "Enable RSA Modular Exponentiation with ASPEED crypto accelerator"
	depends on DM && ASPEED_ACRY
	help
	Enables driver for RSA modular exponentiation using ASPEED cryptographic
	accelerator - ACRY

endif
```

## release/src-rt-5.04behnd.4916/kernel/linux-5.15/Documentation/devicetree/bindings/iommu/brcmstb,iommu.yaml
```yaml
# SPDX-License-Identifier: GPL-2.0-only or BSD-2-Clause
%YAML 1.2
---
$id: http://devicetree.org/schemas/iommu/brcmstb,iommu.yaml#
$schema: http://devicetree.org/meta-schemas/core.yaml#

title: Broadcom STB IOMMU

maintainers:
  - Jim Quinlan <jim2101024@gmail.com>

description: |+
  A generic IOMMU that can be used for almost any device.

properties:
  compatible:
    enum:
      - brcm,m3u
      - brcm,bcm7712-m3u

  reg:
    minItems: 1
    maxItems: 5

  reg-names:
    items:
      - const: mmu
      - const: mmuc
      - const: mic

  interrupts:
    maxItems: 1

  interrupt-names:
    description: The IOMMU interrupt asserted on violations
    items:
      - const: mmu

  "#iommu-cells":
    const: 0

  brcm,type:
    description: Specifies the category of usage of the IOMMU
    enum:
      - pci
      - nexus

required:
  - compatible
  - reg
  - interrupts
  - interrupt-names
  - brcm,type
  - "#iommu-cells"

additionalProperties: false

examples:
  - |
    #include <dt-bindings/interrupt-controller/irq.h>
    #include <dt-bindings/interrupt-controller/arm-gic.h>

    m3u-mmu@5200 {
      #iommu-cells = <0x0>;
      compatible = "brcm,bcm7712-m3u";
      reg = <0x5200 0x4c 0x5b00 0x28 0x5b80 0x24>;
      reg-names = "mmu", "mmuc", "mic";
      interrupts = <0x0 0x34 0x4>;
      interrupt-names = "mmu";
      brcm,type = "pci";
    };
```

## release/src-rt-5.04behnd.4916/kernel/linux-5.15/Documentation/devicetree/bindings/mmc/brcm,sdhci-bcmbca.yaml
```yaml
# SPDX-License-Identifier: (GPL-2.0-only OR BSD-2-Clause)
%YAML 1.2
---
$id: http://devicetree.org/schemas/mmc/brcm,sdhci-bcmbca.yaml#
$schema: http://devicetree.org/meta-schemas/core.yaml#

title: BROADCOM BCA MMC Controller

maintainers:
  - Farhan Ali <farhan.ali@broadcom.com>

allOf:
  - $ref: mmc-controller.yaml#

properties:
  compatible:
    oneOf:
      - items:
          - enum:
              - brcm,sdhci-bcm63138
              - brcm,sdhci-bcm6813
              - brcm,sdhci-bcm6766

  reg:
    minItems: 4
    items:
      - description: core mmc SDHCI register interface
      - description: toplevel mmc controller config register
      - description: mmc boot controller config registers
      - description: mmc ahb bus config controllers
      - description: Command queuing registers

  reg-names:
    items:
      - const: sdhci-base
      - const: sdhci-topcfg
      - const: sdhci-boot
      - const: sdhci-ahbss-ctrl
      - const: cqhci_mem

  interrupts:
    maxItems: 1

  brcm,sdhci-pll-baseclk-mhz:
    description:
      when present, indicates the input clock frquency to the PLL providing the baseclock to
      the mmc controller. Units are in Mhz and are fixed for each specific Soc
    minimum: 3400
    maximum: 9000

  brcm,sdhci-pll-valid-op-mhz:
    description:
      when present, indicates the range of possible output frequncies of the
      the PLL providing the base clock for the mmc controller. Multiple frequencies
      can be listed in 1Mhz units. These values are fixed for each specific Soc

  clock-frequency:
    description:
      when present, should be the frequency (in Hz) of required baseclock for the mmc controller.
      This value should match one of the values in brcm,sdhci-pll-valid-op-mhz array and is
      determined after benchmarking the most stable clock for a specific board. Should only be
      used if the required baseclock is different from the default supplied clock to mmc controller
    $ref: /schemas/types.yaml#/definitions/uint32

required:
  - compatible
  - reg
  - reg-names
  - interrupts

unevaluatedProperties: false

examples:
  - |
    #include <dt-bindings/interrupt-controller/irq.h>
    #include <dt-bindings/interrupt-controller/arm-gic.h>

    sdhci: mmc@20000 {
      compatible = "brcm,sdhci-bcm63138";
      reg-names = "sdhci-base", "sdhci-topcfg", "sdhci-boot", "sdhci-ahbss-ctrl", "cqhci_mem";
      reg = <0x20000 0x100 0x20300 0x200 0x20500 0x40 0x10300 0x100 0x20200 0x100>;
      interrupts = <0x0 0x27 0x4>;
      bus-width = <0x8>;
      brcm,sdhci-pll-baseclk-mhz = <5000>;
      brcm,sdhci-pll-valid-op-mhz = <100 125 156 185 200>;
      sd-uhs-sdr50;
      sd-uhs-sdr104;
      sd-uhs-ddr50;
      mmc-ddr-1_8v;
      mmc-hs200-1_8v;
      clock-frequency = <200000000>;
    };
```

## release/src-rt-5.04behnd.4916/kernel/linux-5.15/Documentation/devicetree/bindings/net/brcm,asp-v2.0.txt
```
Broadcom ASP 2.0 Ethernet controller

Required properties:
- compatible: must be one of:
	"brcm,bcm72165-asp-v2.0"
	"brcm,asp-v2.0"
	"brcm,asp-v2.1"
	"brcm,asp-v2.2"

- reg: base address and length of the register set for the entire ASP block
- interrupts: first interrupt specifier should be the main interrupt that
  connects the ASP block. Second and third interrupt specifiers are optional
  and denote the per-port Wake-on-LAN side band interrupts.
- #address-cells: must be 1
- #size-cells: must be 0

Optional properties:
- clocks: When provided must be a single phandle to the clock controller
  followed by the unique number for the ASP clocks
- clock-names: When provided the names of the function clock must be "sw_asp"
- brcm,reserved-net-filters-mask: When provided the network filter correlated
  with the bitmap will not be used by the driver.

Required child nodes:

- ethernet-ports: container node describing the Ethernet port(s) within the
  ASP block

- mdio bus node: this node should always be present regarless of the PHY
  configuration of the ASP Ethernet port(s)

MDIO bus node required properties:

- compatible: must be "brcm,asp-v2.[0-1]-mdio"
- reg: address and length relative to the parent node base register address
- #address-cells: address cell for MDIO bus addressing, should be 1
- #size-cells: size of the cells for MDIO bus addressing, should be 0

Ethernet ports subnode required properties:

- reg: numeric identifier for the port number
- channel: ASP channel number for the Ethernet port
- phy-mode: see ethernet.txt file in the same directory

Ethernet ports subnode optional properties:

- phy-handle: See ethernet.txt file in the same directory; used to describe
  configurations where a PHY (internal or external) is used.

- fixed-link: When the ASP Ethernet port interface is connected to a MoCA
  hardware block or when operating in a RGMII to RGMII type of connection, or
  when the MDIO bus is voluntarily disabled, this property should be used to
  describe the "fixed link".  See
  Documentation/devicetree/bindings/net/fixed-link.txt for information on the
  property specifics

Example:

asp@9c00000 {
	compatible = "brcm,asp-v2.0";
	reg = <0x9c00000 0x101010>;
	interrupts = <0 51 4>;
	ranges;
	clocks = <&scmi 14>;
	brcm,reserved-net-filters-mask = <0xff>;

	mdio@c614 {
		compatible = "brcm,asp-v2.0-mdio";
		reg = <0xc614 0x8>;
		#address-cells = <1>;
		#size-cells = <0>;

		phy0: ethernet-phy@1 {
			reg = <1>;
		};
	};

	mdio@ce14 {
		compatible = "brcm,asp-v2.0-mdio";
		reg = <0xce14 0x8>;
		#address-cells = <1>;
		#size-cells = <0>;

		phy1: ethernet-phy@1 {
			reg = <1>;
		};
	}

	ethernet-ports {
		#address-cells = <1>;
		#size-cells = <0>;

		port@0 {
			reg = <0>;
			channel = <8>;
			phy-mode  "rgmii";
			phy-handle = <&phy0>;
		};

		port@1 {
			reg = <1>;
			channel = <9>;
			phy-mode  "rgmii";
			phy-handle = <&phy1>;
		};
	};
};
```

## release/src-rt-5.04behnd.4916/kernel/linux-5.15/Documentation/devicetree/bindings/rng/brcm,bcmbca-trng.yaml
```yaml
# SPDX-License-Identifier: (GPL-2.0-only OR BSD-2-Clause)
%YAML 1.2
---
$id: http://devicetree.org/schemas/rng/brcm,bcmbca-trng.yaml#
$schema: http://devicetree.org/meta-schemas/core.yaml#

title: Broadcom BCA bcmbca-trng bindings

maintainers:
  - Farhan Ali <farhan.ali@broadcom.com>

description: |
  Broadcom True Random Number Generator core for BCA SOCs

properties:
  compatible:
    const: brcm,bcmbca-trng

  reg:
    maxItems: 1

required:
  - compatible
  - reg

additionalProperties: false

examples:
  - |
    trng@ff803800 {
        compatible = "brcm,bcmbca-trng";
        reg = <0xff803800 0x800>;
    };
```

## release/src-rt-5.04behnd.4916/kernel/linux-5.15/Kconfig.bcmconfig
```kconfig
menu "Broadcom Specific Configurations"
if "$(BCM_KF)" = "y"
source "$(KCONFIG_BCM_KF_PATH)Kconfig.bcm_kf"
source "$(KCONFIG_BCMDRIVER_PATH)Kconfig.bcm"
endif
endmenu
```
