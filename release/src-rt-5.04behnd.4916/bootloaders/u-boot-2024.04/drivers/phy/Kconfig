## release/src-rt-5.04behnd.4916/bootloaders/u-boot-2024.04/drivers/pinctrl/intel/Kconfig
```kconfig
#
# Intel PINCTRL drivers
#

if PINCTRL_INTEL

config INTEL_PINCTRL_DUAL_ROUTE_SUPPORT
	bool
	default y

config INTEL_PINCTRL_PADCFG_PADTOL
	bool n

config INTEL_PINCTRL_IOSTANDBY
	bool
	default y

config INTEL_PINCTRL_MULTI_ACPI_DEVICES
	bool
	default y
	help
	  Enable this if the pinctrl devices are modelled as multiple,
	  separate ACPI devices in the ACPI tables. If enabled, the ACPI
	  devices match the U-Boot pinctrl devices and the pin 'offset' is
	  relative to a particular pinctrl device. If disabled, there is a
	  single ACPI pinctrl device which includes all U-Boot pinctrl devices
	  and the pin 'offset' is in effect a global pin number.


config PINCTRL_INTEL_APL
	bool "Support Intel Apollo Lake (APL)"
	help
	  Add support for Intel Apollo Lake pin-control and pin-mux settings.
	  These are mostly read from the device tree, with the early-pads
	  property in the host bridge and the pads property in the fsp-s
	  subnode of the host bridge.

endif
```

## release/src-rt-5.04behnd.4916/bootloaders/u-boot-2024.04/drivers/pinctrl/mediatek/Kconfig
```kconfig
if ARCH_MEDIATEK

config PINCTRL_MTK
	depends on PINCTRL_GENERIC
	bool

config PINCTRL_MT7622
	bool "MT7622 SoC pinctrl driver"
	select PINCTRL_MTK

config PINCTRL_MT7623
	bool "MT7623 SoC pinctrl driver"
	select PINCTRL_MTK

config PINCTRL_MT7629
	bool "MT7629 SoC pinctrl driver"
	select PINCTRL_MTK

config PINCTRL_MT7981
	bool "MT7981 SoC pinctrl driver"
	select PINCTRL_MTK

config PINCTRL_MT7986
	bool "MT7986 SoC pinctrl driver"
	select PINCTRL_MTK

config PINCTRL_MT7988
	bool "MT7988 SoC pinctrl driver"
	select PINCTRL_MTK

config PINCTRL_MT8512
	bool "MT8512 SoC pinctrl driver"
	select PINCTRL_MTK

config PINCTRL_MT8516
	bool "MT8516 SoC pinctrl driver"
	select PINCTRL_MTK

config PINCTRL_MT8518
        bool "MT8518 SoC pinctrl driver"
	select PINCTRL_MTK

endif
```

## release/src-rt-5.04behnd.4916/bootloaders/u-boot-2024.04/drivers/pinctrl/mtmips/Kconfig
```kconfig
config PINCTRL_MTMIPS
	depends on ARCH_MTMIPS
	bool

config PINCTRL_MT7620
	bool "MediaTek MT7620 pin control driver"
	select PINCTRL_MTMIPS
	depends on SOC_MT7620 && PINCTRL_GENERIC
	help
	  Support pin multiplexing control on MediaTek MT7620.
	  The driver is controlled by a device tree node which contains
	  the pin mux functions for each available pin groups.

config PINCTRL_MT7621
	bool "MediaTek MT7621 pin control driver"
	select PINCTRL_MTMIPS
	depends on SOC_MT7621 && PINCTRL_GENERIC
	help
	  Support pin multiplexing control on MediaTek MT7621.
	  The driver is controlled by a device tree node which contains
	  the pin mux functions for each available pin groups.

config PINCTRL_MT7628
	bool "MediaTek MT7628 pin control driver"
	select PINCTRL_MTMIPS
	depends on SOC_MT7628 && PINCTRL_GENERIC
	help
	  Support pin multiplexing control on MediaTek MT7628.
	  The driver is controlled by a device tree node which contains
	  the pin mux functions for each available pin groups.
```

## release/src-rt-5.04behnd.4916/bootloaders/u-boot-2024.04/drivers/pinctrl/mvebu/Kconfig
```kconfig
if ARCH_MVEBU

config PINCTRL_ARMADA_38X
	depends on ARMADA_38X && PINCTRL_FULL
	bool "Armada 38x pin control driver"
	help
	   Support pin multiplexing and pin configuration control on
	   Marvell's Armada-38x SoC.

config PINCTRL_ARMADA_37XX
	depends on ARMADA_3700 && PINCTRL_FULL
	bool "Armada 37xx pin control driver"
	help
	   Support pin multiplexing and pin configuration control on
	   Marvell's Armada-37xx SoC.

config PINCTRL_ARMADA_8K
	depends on (ARMADA_8K || ALLEYCAT_5) && PINCTRL_FULL
	bool "Armada 7k/8k pin control driver"
	help
	   Support pin multiplexing and pin configuration control on
	   Marvell's Armada-8K SoC.

endif
```

## release/src-rt-5.04behnd.4916/bootloaders/u-boot-2024.04/drivers/pinctrl/nexell/Kconfig
```kconfig
if ARCH_NEXELL

config PINCTRL_NEXELL
	bool "Nexell pinctrl driver"
	help
	  Support of pin multiplexing and pin configuration for Nexell
	  SoCs.

config PINCTRL_NEXELL_S5PXX18
	bool "Nexell s5pxx18 SoC pinctrl driver"
	default y if ARCH_S5P4418 || ARCH_S5P6818
	depends on ARCH_NEXELL && PINCTRL_FULL
	select PINCTRL_NEXELL
	help
	  Support of pin multiplexing and pin configuration for S5P4418
	  and S5P6818 SoC.

endif
```

## release/src-rt-5.04behnd.4916/bootloaders/u-boot-2024.04/drivers/pinctrl/nuvoton/Kconfig
```kconfig
# SPDX-License-Identifier: GPL-2.0-only
config PINCTRL_NPCM7XX
	bool "Pinctrl and GPIO driver for Nuvoton NPCM7XX"
	depends on DM && PINCTRL_GENERIC && ARCH_NPCM7xx
	help
	  Say Y here to enable pin controller and GPIO support
	  for Nuvoton NPCM750/730/715/705 SoCs.

config PINCTRL_NPCM8XX
	bool "Pinctrl driver for Nuvoton NPCM8XX"
	depends on DM && PINCTRL_GENERIC && ARCH_NPCM8XX
	help
	  Support pin muxing and pin configuration on
	  Nuvoton NPCM8XX SoC.

	  The NPCM8XX contains 256 GPIO pins. Most of them are
	  multiplexed with other system functions. These pins can
	  be configured as either GPIO pin or alternate function.
	  It also supports basic configurations such as pull up/down,
	  drive-strength, and slew rate control for some of the pins.
```

## release/src-rt-5.04behnd.4916/bootloaders/u-boot-2024.04/drivers/pinctrl/qcom/Kconfig
```kconfig
if ARCH_SNAPDRAGON

config PINCTRL_QCOM
	depends on PINCTRL_GENERIC
	def_bool n

menu "Qualcomm pinctrl drivers"

config PINCTRL_QCOM_APQ8016
	bool "Qualcomm APQ8016 GCC"
	select PINCTRL_QCOM
	help
	  Say Y here to enable support for pinctrl on the MSM8916 / APQ8016
	  Snapdragon 410 SoC, as well as the associated GPIO driver.

config PINCTRL_QCOM_APQ8096
	bool "Qualcomm APQ8096 GCC"
	select PINCTRL_QCOM
	help
	  Say Y here to enable support for pinctrl on the MSM8996 / APQ8096
	  Snapdragon 820 SoC, as well as the associated GPIO driver.

config PINCTRL_QCOM_IPQ4019
	bool "Qualcomm IPQ4019 GCC"
	select PINCTRL_QCOM
	help
	  Say Y here to enable support for pinctrl on the IPQ4019 SoC,
	  as well as the associated GPIO driver.

config PINCTRL_QCOM_QCS404
	bool "Qualcomm QCS404 GCC"
	select PINCTRL_QCOM
	help
	  Say Y here to enable support for pinctrl on the Snapdragon QCS404 SoC,
	  as well as the associated GPIO driver.

config PINCTRL_QCOM_SDM845
	bool "Qualcomm SDM845 GCC"
	select PINCTRL_QCOM
	help
	  Say Y here to enable support for pinctrl on the Snapdragon 845 SoC,
	  as well as the associated GPIO driver.

endmenu

endif
```

## release/src-rt-5.04behnd.4916/bootloaders/u-boot-2024.04/drivers/pinctrl/renesas/Kconfig
```kconfig
if ARCH_RENESAS

config PINCTRL_PFC
	bool "Renesas pin control drivers"
	depends on DM && ARCH_RENESAS
	default n if CPU_RZA1
	help
	  Support pin multiplexing control on Renesas SoCs.

	  These drivers are controlled by a device tree node which contains
	  both the GPIO definitions and pin control functions for each
	  available multiplex function.

config PINCTRL_PFC_R8A7790
	bool "Renesas RCar Gen2 R8A7790 pin control driver"
	depends on PINCTRL_PFC
	help
	  Support pin multiplexing control on Renesas RCar Gen2 R8A7790 SoCs.

config PINCTRL_PFC_R8A7791
	bool "Renesas RCar Gen2 R8A7791 pin control driver"
	depends on PINCTRL_PFC
	help
	  Support pin multiplexing control on Renesas RCar Gen2 R8A7791 SoCs.

config PINCTRL_PFC_R8A7792
	bool "Renesas RCar Gen2 R8A7792 pin control driver"
	depends on PINCTRL_PFC
	help
	  Support pin multiplexing control on Renesas RCar Gen2 R8A7792 SoCs.

config PINCTRL_PFC_R8A7793
	bool "Renesas RCar Gen2 R8A7793 pin control driver"
	depends on PINCTRL_PFC
	help
	  Support pin multiplexing control on Renesas RCar Gen2 R8A7793 SoCs.

config PINCTRL_PFC_R8A7794
	bool "Renesas RCar Gen2 R8A7794 pin control driver"
	depends on PINCTRL_PFC
	help
	  Support pin multiplexing control on Renesas RCar Gen2 R8A7794 SoCs.

config PINCTRL_PFC_R8A774A1
        bool "Renesas RZ/G2 R8A774A1 pin control driver"
        depends on PINCTRL_PFC
        help
          Support pin multiplexing control on Renesas RZ/G2M R8A774A1 SoCs.

config PINCTRL_PFC_R8A774B1
        bool "Renesas RZ/G2 R8A774B1 pin control driver"
        depends on PINCTRL_PFC
        help
          Support pin multiplexing control on Renesas RZ/G2N R8A774B1 SoCs.

config PINCTRL_PFC_R8A774C0
        bool "Renesas RZ/G2 R8A774C0 pin control driver"
        depends on PINCTRL_PFC
        help
          Support pin multiplexing control on Renesas RZ/G2E R8A774C0 SoCs.

config PINCTRL_PFC_R8A774E1
        bool "Renesas RZ/G2 R8A774E1 pin control driver"
        depends on PINCTRL_PFC
        help
          Support pin multiplexing control on Renesas RZ/G2H R8A774E1 SoCs.

config PINCTRL_PFC_R8A77951
	bool "Renesas RCar Gen3 R8A7795 pin control driver"
	depends on PINCTRL_PFC
	help
	  Support pin multiplexing control on Renesas RCar Gen3 R8A7795 SoCs.

config PINCTRL_PFC_R8A77960
	bool "Renesas RCar Gen3 R8A77960 pin control driver"
	depends on PINCTRL_PFC
	help
	  Support pin multiplexing control on Renesas RCar Gen3 R8A77960 SoCs.

config PINCTRL_PFC_R8A77961
	bool "Renesas RCar Gen3 R8A77961 pin control driver"
	depends on PINCTRL_PFC
	help
	  Support pin multiplexing control on Renesas RCar Gen3 R8A77961 SoCs.

config PINCTRL_PFC_R8A77965
	bool "Renesas RCar Gen3 R8A77965 pin control driver"
	depends on PINCTRL_PFC
	help
	  Support pin multiplexing control on Renesas RCar Gen3 R8A77965 SoCs.

config PINCTRL_PFC_R8A77970
	bool "Renesas RCar Gen3 R8A77970 pin control driver"
	depends on PINCTRL_PFC
	help
	  Support pin multiplexing control on Renesas RCar Gen3 R8A77970 SoCs.

config PINCTRL_PFC_R8A77980
	bool "Renesas RCar Gen3 R8A77980 pin control driver"
	depends on PINCTRL_PFC
	help
	  Support pin multiplexing control on Renesas RCar Gen3 R8A77980 SoCs.

config PINCTRL_PFC_R8A77990
	bool "Renesas RCar Gen3 R8A77990 pin control driver"
	depends on PINCTRL_PFC
	help
	  Support pin multiplexing control on Renesas RCar Gen3 R8A77990 SoCs.

config PINCTRL_PFC_R8A77995
	bool "Renesas RCar Gen3 R8A77995 pin control driver"
	depends on PINCTRL_PFC
	help
	  Support pin multiplexing control on Renesas RCar Gen3 R8A77995 SoCs.

config PINCTRL_PFC_R8A779A0
	bool "Renesas RCar Gen3 R8A779A0 pin control driver"
	depends on PINCTRL_PFC
	help
	  Support pin multiplexing control on Renesas RCar Gen3 R8A779A0 SoCs.

config PINCTRL_PFC_R8A779F0
	bool "Renesas RCar Gen4 R8A779F0 pin control driver"
	depends on PINCTRL_PFC
	help
	  Support pin multiplexing control on Renesas RCar Gen4 R8A779F0 SoCs.

config PINCTRL_PFC_R8A779G0
	bool "Renesas RCar Gen4 R8A779G0 pin control driver"
	depends on PINCTRL_PFC
	help
	  Support pin multiplexing control on Renesas RCar Gen4 R8A779G0 SoCs.

config PINCTRL_PFC_R8A779H0
	bool "Renesas RCar Gen4 R8A779H0 pin control driver"
	depends on PINCTRL_PFC
	help
	  Support pin multiplexing control on Renesas RCar Gen4 R8A779H0 SoCs.

config PINCTRL_RZA1
	bool "Renesas RZ/A1 R7S72100 pin control driver"
	depends on CPU_RZA1
	default y if CPU_RZA1
	help
	  Support pin multiplexing control on Renesas RZ/A1 R7S72100 SoCs.

config PINCTRL_RZG2L
	bool "Renesas RZ/G2L family pin control driver"
	depends on PINCTRL
	depends on PINCTRL_GENERIC
	depends on PINCONF
	help
	  Support the pinctrl functionality of the pin function controller (PFC)
	  on the Renesas RZ/G2L SoC family.

endif

config PINCTRL_RZN1
	bool "Renesas RZ/N1 R906G032 pin control driver"
	depends on RZN1
	default y if RZN1
	help
	  Support pin multiplexing control on Renesas RZ/N1 R906G032 SoCs.
```

## release/src-rt-5.04behnd.4916/bootloaders/u-boot-2024.04/drivers/pinctrl/starfive/Kconfig
```kconfig
# SPDX-License-Identifier: GPL-2.0-only

config SPL_PINCTRL_STARFIVE
	bool "Support Pinctrl driver for StarFive SoC in SPL"
	depends on SPL_PINCTRL_FULL && STARFIVE_JH7110
	help
	  Enable support pin control driver for StarFive SoC.

config SPL_PINCTRL_STARFIVE_JH7110
	bool "Support Pinctrl and GPIO driver for StarFive JH7110 SoC in SPL"
	depends on  SPL_PINCTRL_STARFIVE
	help
	  Enable support pinctrl and gpio driver for StarFive JH7110 in SPL.

config PINCTRL_STARFIVE
	bool "Pinctrl driver for StarFive SoC"
	depends on PINCTRL_FULL && STARFIVE_JH7110
	help
	  Say yes here to support pin control on the StarFive RISC-V SoC.
	  This also provides an interface to the GPIO pins not used by other
	  peripherals supporting inputs, outputs, configuring pull-up/pull-down
	  and interrupts on input changes.

config PINCTRL_STARFIVE_JH7110
	bool "Pinctrl and GPIO driver for StarFive JH7110 SoC"
	depends on  PINCTRL_STARFIVE
	help
	  This selects the pinctrl driver for JH7110 starfive.
```

## release/src-rt-5.04behnd.4916/bootloaders/u-boot-2024.04/drivers/pinctrl/sunxi/Kconfig
```kconfig
# SPDX-License-Identifier: GPL-2.0

if ARCH_SUNXI

config PINCTRL_SUNXI
	select PINCTRL_FULL
	select PINCTRL_GENERIC
	select PINCONF
	select PINMUX
	bool

config PINCTRL_SUNIV_F1C100S
	bool "Support for the Allwinner F1C100s PIO"
	default MACH_SUNIV
	select PINCTRL_SUNXI

config PINCTRL_SUN4I_A10
	bool "Support for the Allwinner A10 PIO"
	default MACH_SUN4I
	select PINCTRL_SUNXI

config PINCTRL_SUN5I_A13
	bool "Support for the Allwinner A10s/A13 PIO"
	default MACH_SUN5I
	select PINCTRL_SUNXI

config PINCTRL_SUN6I_A31
	bool "Support for the Allwinner A31 PIO"
	default MACH_SUN6I
	select PINCTRL_SUNXI

config PINCTRL_SUN6I_A31_R
	bool "Support for the Allwinner A31 R-PIO"
	default MACH_SUN6I
	select PINCTRL_SUNXI

config PINCTRL_SUN7I_A20
	bool "Support for the Allwinner A20/R40 PIO"
	default MACH_SUN7I || MACH_SUN8I_R40
	select PINCTRL_SUNXI

config PINCTRL_SUN8I_A23
	bool "Support for the Allwinner A23 PIO"
	default MACH_SUN8I_A23
	select PINCTRL_SUNXI

config PINCTRL_SUN8I_A23_R
	bool "Support for the Allwinner A23/A33 R-PIO"
	default MACH_SUN8I_A23 || MACH_SUN8I_A33
	select PINCTRL_SUNXI

config PINCTRL_SUN8I_A33
	bool "Support for the Allwinner A33 PIO"
	default MACH_SUN8I_A33
	select PINCTRL_SUNXI

config PINCTRL_SUN8I_A83T
	bool "Support for the Allwinner A83T PIO"
	default MACH_SUN8I_A83T
	select PINCTRL_SUNXI

config PINCTRL_SUN8I_A83T_R
	bool "Support for the Allwinner A83T R-PIO"
	default MACH_SUN8I_A83T
	select PINCTRL_SUNXI

config PINCTRL_SUN8I_H3
	bool "Support for the Allwinner H3 PIO"
	default MACH_SUN8I_H3
	select PINCTRL_SUNXI

config PINCTRL_SUN8I_H3_R
	bool "Support for the Allwinner H3/H5 R-PIO"
	default MACH_SUN8I_H3 || MACH_SUN50I_H5
	select PINCTRL_SUNXI

config PINCTRL_SUN8I_V3S
	bool "Support for the Allwinner V3s PIO"
	default MACH_SUN8I_V3S
	select PINCTRL_SUNXI

config PINCTRL_SUN9I_A80
	bool "Support for the Allwinner A80 PIO"
	default MACH_SUN9I
	select PINCTRL_SUNXI

config PINCTRL_SUN9I_A80_R
	bool "Support for the Allwinner A80 R-PIO"
	default MACH_SUN9I
	select PINCTRL_SUNXI

config PINCTRL_SUN50I_A64
	bool "Support for the Allwinner A64 PIO"
	default MACH_SUN50I
	select PINCTRL_SUNXI

config PINCTRL_SUN50I_A64_R
	bool "Support for the Allwinner A64 R-PIO"
	default MACH_SUN50I
	select PINCTRL_SUNXI

config PINCTRL_SUN50I_H5
	bool "Support for the Allwinner H5 PIO"
	default MACH_SUN50I_H5
	select PINCTRL_SUNXI

config PINCTRL_SUN50I_H6
	bool "Support for the Allwinner H6 PIO"
	default MACH_SUN50I_H6
	select PINCTRL_SUNXI

config PINCTRL_SUN50I_H6_R
	bool "Support for the Allwinner H6 R-PIO"
	default MACH_SUN50I_H6
	select PINCTRL_SUNXI

config PINCTRL_SUN50I_H616
	bool "Support for the Allwinner H616 PIO"
	default MACH_SUN50I_H616
	select PINCTRL_SUNXI

config PINCTRL_SUN50I_H616_R
	bool "Support for the Allwinner H616 R-PIO"
	default MACH_SUN50I_H616
	select PINCTRL_SUNXI

config PINCTRL_SUN20I_D1
	bool "Support for the Allwinner D1/R528 PIO"
	default MACH_SUN8I_R528
	select PINCTRL_SUNXI

endif
```
