## release/src-rt-5.04behnd.4916/bootloaders/u-boot-2024.04/drivers/qe/Kconfig
```kconfig
#
# QUICC Engine Drivers
#
config QE
	bool "Enable support for QUICC Engine"
	depends on PPC
	default y if ARCH_T1040 || ARCH_T1042 || ARCH_T1024 || ARCH_P1021 \
		|| ARCH_P1025
	help
	  Chose this option to add support for the QUICC Engine.

config U_QE
	bool "Enable support for U QUICC Engine"
	default y if (ARCH_LS1021A && !SD_BOOT && !NAND_BOOT && !QSPI_BOOT) \
		|| (TARGET_T1024QDS) \
		|| (TARGET_T1024RDB) \
		|| (TARGET_LS1043ARDB && !SPL_NO_QE && !NAND_BOOT && !QSPI_BOOT)
	help
	  Choose this option to add support for U QUICC Engine.

config SYS_QE_FW_ADDR
	hex "QE Firmware Address"
	depends on FMAN_ENET || QE || U_QE
	default 0x0
choice
	prompt "QUICC Engine FMan ethernet firmware location"
	depends on FMAN_ENET || QE
	default SYS_QE_FMAN_FW_IN_ROM

config SYS_QE_FMAN_FW_IN_FS
	depends on FS_LOADER && FMAN_ENET
	bool "Filesystem"

config SYS_QE_FMAN_FW_IN_NOR
	bool "NOR flash"

config SYS_QE_FMAN_FW_IN_NAND
	bool "NAND flash"

config SYS_QE_FMAN_FW_IN_SPIFLASH
	bool "SPI flash"

config SYS_QE_FMAN_FW_IN_MMC
	bool "MMC"

config SYS_QE_FMAN_FW_IN_REMOTE
	bool "Remote memory location (PCI)"

config SYS_QE_FMAN_FW_IN_ROM
	bool "Firmware is already in ROM"

endchoice
```

## release/src-rt-5.04behnd.4916/bootloaders/u-boot-2024.04/drivers/ram/Kconfig
```kconfig
config RAM
	bool "Enable RAM drivers using Driver Model"
	depends on DM
	help
	  This allows drivers to be provided for SDRAM and other RAM
	  controllers and their type to be specified in the board's device
	  tree. Generally some parameters are required to set up the RAM and
	  the RAM size can either be statically defined or dynamically
	  detected.

config SPL_RAM
	bool "Enable RAM support in SPL"
	depends on RAM && SPL_DM
	help
	  The RAM subsystem adds a small amount of overhead to the image.
	  If this is acceptable and you have a need to use RAM drivers in
	  SPL, enable this option. It might provide a cleaner interface to
	  setting up RAM (e.g. SDRAM / DDR) within SPL.

config TPL_RAM
	bool "Enable RAM support in TPL"
	depends on RAM && TPL
	help
	  The RAM subsystem adds a small amount of overhead to the image.
	  If this is acceptable and you have a need to use RAM drivers in
	  TPL, enable this option. It might provide a cleaner interface to
	  setting up RAM (e.g. SDRAM / DDR) within TPL.

config STM32_SDRAM
	bool "Enable STM32 SDRAM support"
	depends on RAM
	help
	  STM32F7 family devices support flexible memory controller(FMC) to
	  support external memories like sdram, psram & nand.
	  This driver is for the sdram memory interface with the FMC.

config MPC83XX_SDRAM
	bool "Enable MPC83XX SDRAM support"
	depends on RAM
	help
	  Enable support for the internal DDR Memory Controller of the MPC83xx
	  family of SoCs. Both static configurations, as well as configuring
	  the RAM through the use of SPD (Serial Presence Detect) is supported
	  via device tree settings.

config K3_AM654_DDRSS
	bool "Enable AM654 DDRSS support"
	depends on RAM && SOC_K3_AM654
	help
	  K3 based AM654 devices has DDR memory subsystem that comprises
	  Synopys DDR controller, Synopsis DDR phy and wrapper logic to
	  intergrate these blocks into the device. This DDR subsystem
	  provides an interface to external SDRAM devices. Enabling this
	  config add support for the initialization of the external
	  SDRAM devices connected to DDR subsystem.

config K3_DDRSS
	bool "Enable K3 DDRSS support"
	depends on RAM

choice
	depends on K3_DDRSS
	prompt "K3 DDRSS Arch Support"

	default K3_J721E_DDRSS if SOC_K3_J721E || SOC_K3_J721S2
	default K3_AM64_DDRSS if SOC_K3_AM642
	default K3_AM64_DDRSS if SOC_K3_AM625
	default K3_AM62A_DDRSS if SOC_K3_AM62A7

config K3_J721E_DDRSS
	bool "Enable J721E DDRSS support"
	help
	  The J721E DDR subsystem comprises DDR controller, DDR PHY and
	  wrapper logic to integrate these blocks in the device. The DDR
	  subsystem is used to provide an interface to external SDRAM
	  devices which can be utilized for storing program or data.
	  Enabling this config adds support for the DDR memory controller
	  on J721E family of SoCs.

config K3_AM64_DDRSS
	bool "Enable AM64 DDRSS support"
	help
	  The AM64 DDR subsystem comprises DDR controller, DDR PHY and
	  wrapper logic to integrate these blocks in the device. The DDR
	  subsystem is used to provide an interface to external SDRAM
	  devices which can be utilized for storing program or data.
	  Enabling this config adds support for the DDR memory controller
	  on AM642 family of SoCs.

config K3_AM62A_DDRSS
	bool "Enable AM62A DDRSS support"
	help
	  The AM62A DDR subsystem comprises of a DDR controller, DDR PHY and
	  wrapper logic to integrate these blocks into once device. The DDR
	  subsystem is used to provide an interface to external SDRAM devices
	  which can be utilized for storing programs or any other data.
	  Enabling this option adds support for the DDR memory controller for
	  the AM62A family of SoCs.

endchoice

config IMXRT_SDRAM
	bool "Enable i.MXRT SDRAM support"
	depends on RAM
	help
	  i.MXRT family devices support smart external memory controller(SEMC)
	  to support external memories like sdram, psram & nand.
	  This driver is for the sdram memory interface with the SEMC.

source "drivers/ram/aspeed/Kconfig"
source "drivers/ram/cadence/Kconfig"
source "drivers/ram/octeon/Kconfig"
source "drivers/ram/rockchip/Kconfig"
source "drivers/ram/sifive/Kconfig"
source "drivers/ram/stm32mp1/Kconfig"
source "drivers/ram/starfive/Kconfig"
source "drivers/ram/sunxi/Kconfig"
```

## release/src-rt-5.04behnd.4916/bootloaders/u-boot-2024.04/drivers/ram/aspeed/Kconfig
```kconfig
menuconfig ASPEED_RAM
	bool "ASPEED SDRAM configuration"
	depends on RAM && ARCH_ASPEED
	default ARCH_ASPEED
	help
	 Configuration options for DDR SDRAM on ASPEED systems.

	 RAM initialisation is always built in for the platform. This menu
	 allows customisation of the configuration used.

if ASPEED_RAM

config ASPEED_DDR4_DUALX8
	bool "Enable Dual X8 DDR4 die"
	depends on ASPEED_RAM
	help
	 Say Y if dual X8 DDR4 die is used on the board. The ASPEED DDRM
	 SRAM controller needs to know if the memory chip mounted on the
	 board is dual x8 die or not, otherwise it may get the wrong
	 size of the memory space.

config ASPEED_BYPASS_SELFTEST
	depends on ASPEED_RAM
	depends on ASPEED_AST2600
	bool "Bypass self test during initialization"
	help
	  Say Y here to bypass DRAM self test to speed up the boot time.

config ASPEED_ECC
	bool "ASPEED SDRAM ECC"
	depends on ASPEED_RAM
	depends on ASPEED_AST2600
	help
	  Enable SDRAM ECC function. This configures the SDRAM controller to
	  perform error detection and correction, sacrificing 1/9th of the
	  installed RAM to do so.


config ASPEED_ECC_SIZE
	int "ECC size: 0=driver auto-caluated"
	depends on ASPEED_ECC
	default 0
	help
	  SDRAM size with the error correcting code enabled. The unit is
	  in Megabytes.  Noted that only the 8/9 of the configured size
	  can be used by the system.  The remaining 1/9 will be used by
	  the ECC engine.  If the size is set to 0, the sdram driver will
	  calculate the SDRAM size and set the whole range be ECC enabled.

choice
	prompt "AST2600 DDR4 target date rate"
	default ASPEED_DDR4_1600
	depends on ASPEED_RAM
	depends on ASPEED_AST2600

config ASPEED_DDR4_400
	bool "400Mbps"
	help
	  select DDR4 target data rate at 400M

config ASPEED_DDR4_800
	bool "800Mbps"
	help
	  select DDR4 target data rate at 800M

config ASPEED_DDR4_1333
	bool "1333Mbps"
	help
	  select DDR4 target data rate at 1333M

config ASPEED_DDR4_1600
	bool "1600Mbps"
	help
	  select DDR4 target data rate at 1600M
endchoice

endif # End of ASPEED_RAM
```

## release/src-rt-5.04behnd.4916/bootloaders/u-boot-2024.04/drivers/ram/cadence/Kconfig
```kconfig
if RAM || SPL_RAM

config CADENCE_DDR_CTRL
	bool "Enable Cadence DDR controller"
	depends on DM
	help
	  Enable support for Cadence DDR controller, as found on
	  the Renesas RZ/N1 SoC. This controller has a large number
	  of registers which need to be programmed, mostly using values
	  obtained from Denali SOMA files via a TCL script.

endif
```

## release/src-rt-5.04behnd.4916/bootloaders/u-boot-2024.04/drivers/ram/octeon/Kconfig
```kconfig
config RAM_OCTEON
	bool "Ram drivers for Octeon SoCs"
	depends on RAM && ARCH_OCTEON
	help
	 This enables support for RAM drivers for Octeon SoCs.

if RAM_OCTEON

config RAM_OCTEON_DDR4
	bool "Octeon III DDR4 RAM support"
	help
	 This enables support for DDR4 RAM suppoort for Octeon III.  This does
	 not include support for Octeon CN70XX.

endif # RAM_OCTEON
```

## release/src-rt-5.04behnd.4916/bootloaders/u-boot-2024.04/drivers/ram/rockchip/Kconfig
```kconfig
config RAM_ROCKCHIP
	bool "Ram drivers support for Rockchip SoCs"
	depends on RAM && ARCH_ROCKCHIP
	default y
	help
	  This enables support for ram drivers Rockchip SoCs.

config ROCKCHIP_SDRAM_COMMON
	bool "Enable rockchip sdram common driver"
	depends on TPL_RAM || SPL_RAM
	help
	  This enable sdram common driver

if RAM_ROCKCHIP

config RAM_ROCKCHIP_DEBUG
	bool "Rockchip ram drivers debugging"
	default y
	help
	  This enables debugging ram driver API's for the platforms
	  based on Rockchip SoCs.

	  This is an option for developers to understand the ram drivers
	  initialization, configurations and etc.

config RAM_ROCKCHIP_DDR4
	bool "DDR4 support for Rockchip SoCs"
	help
	  This enables DDR4 sdram support instead of the default DDR3 support
	  on Rockchip SoCs.

config RAM_ROCKCHIP_LPDDR2
	bool "LPDDR2 support for Rockchip SoCs"
	help
	  This enables LPDDR2 sdram support instead of the default DDR3 support
	  on Rockchip SoCs.

config RAM_ROCKCHIP_LPDDR3
	bool "LPDDR3 support for Rockchip SoCs"
	help
	  This enables LPDDR3 sdram support instead of the default DDR3 support
	  on Rockchip SoCs.

config RAM_ROCKCHIP_LPDDR4
	bool "LPDDR4 support for Rockchip SoCs"
	help
	  This enables LPDDR4 sdram code support for the platforms based
	  on Rockchip SoCs.

endif # RAM_ROCKCHIP
```

## release/src-rt-5.04behnd.4916/bootloaders/u-boot-2024.04/drivers/ram/sifive/Kconfig
```kconfig
config RAM_SIFIVE
	bool "Ram drivers support for SiFive SoCs"
	depends on RAM && RISCV
	default y
	help
	  This enables support for ram drivers of SiFive SoCs.

config SIFIVE_DDR
	bool "SiFive DDR driver"
	depends on RAM_SIFIVE
	default y if TARGET_SIFIVE_UNLEASHED || TARGET_SIFIVE_UNMATCHED
	help
	  This enables DDR support for the platforms based on SiFive SoC.
```

## release/src-rt-5.04behnd.4916/bootloaders/u-boot-2024.04/drivers/ram/starfive/Kconfig
```kconfig
config SPL_STARFIVE_DDR
	bool "StarFive DDR driver in SPL"
	depends on SPL_RAM && STARFIVE_JH7110
	help
	  This enables DDR support for the platforms based on StarFive JH7110 SoC.
```

## release/src-rt-5.04behnd.4916/bootloaders/u-boot-2024.04/drivers/ram/stm32mp1/Kconfig
```kconfig
config STM32MP1_DDR
	bool "STM32MP1 DDR driver"
	depends on DM && OF_CONTROL && ARCH_STM32MP
	select RAM
	select SPL_RAM if SPL
	default y
	help
		activate STM32MP1 DDR controller driver for STM32MP1 soc
		family:	support for LPDDR2, LPDDR3 and DDR3
		the SDRAM parameters for controleur and phy need to be provided
		in device tree (computed by DDR tuning tools)

config STM32MP1_DDR_INTERACTIVE
	bool "STM32MP1 DDR driver : interactive support"
	depends on STM32MP1_DDR
	help
		activate interactive support in STM32MP1 DDR controller driver
		used for DDR tuning tools
		to enter in intercative mode type 'd' during SPL DDR driver
		initialisation

config STM32MP1_DDR_INTERACTIVE_FORCE
	bool "STM32MP1 DDR driver : force interactive mode"
	depends on STM32MP1_DDR_INTERACTIVE
	help
		force interactive mode in STM32MP1 DDR controller driver
		skip the polling of character 'd' in console
		useful when SPL is loaded in sysram
		directly by programmer

config STM32MP1_DDR_TESTS
	bool "STM32MP1 DDR driver : tests support"
	depends on STM32MP1_DDR_INTERACTIVE
	default y
	help
		activate test support for interactive support in
		STM32MP1 DDR controller driver: command test

config STM32MP1_DDR_TUNING
	bool "STM32MP1 DDR driver : support of tuning"
	depends on STM32MP1_DDR_INTERACTIVE
	default y
	help
		activate tuning command in STM32MP1 DDR interactive mode
		used for DDR tuning tools
		- DQ Deskew algorithm
		- DQS Trimming
```

## release/src-rt-5.04behnd.4916/bootloaders/u-boot-2024.04/drivers/ram/sunxi/Kconfig
```kconfig
config DRAM_SUN20I_D1
	bool
	depends on ARCH_SUNXI
	help
	  This enables support for the DRAM controller driver covering
	  the Allwinner D1/R528/T113s SoCs.

if DRAM_SUN20I_D1

config DRAM_SUNXI_ODT_EN
	hex "DRAM ODT EN parameter"
	help
	  ODT EN value from vendor DRAM settings.

config DRAM_SUNXI_TPR0
	hex "DRAM TPR0 parameter"
	help
	  TPR0 value from vendor DRAM settings.

config DRAM_SUNXI_TPR11
	hex "DRAM TPR11 parameter"
	help
	  TPR11 value from vendor DRAM settings.

config DRAM_SUNXI_TPR12
	hex "DRAM TPR12 parameter"
	help
	  TPR12 value from vendor DRAM settings.

config DRAM_SUNXI_TPR13
	hex "DRAM TPR13 parameter"
	help
	  TPR13 value from vendor DRAM settings. It tells which features
	  should be configured.

choice
	prompt "DRAM chip type"
	default SUNXI_DRAM_TYPE_DDR3 if DRAM_SUN20I_D1

config SUNXI_DRAM_TYPE_DDR2
	bool "DDR2 chips"

config SUNXI_DRAM_TYPE_DDR3
	bool "DDR3 chips"

config SUNXI_DRAM_TYPE_LPDDR2
	bool "LPDDR2 chips"

config SUNXI_DRAM_TYPE_LPDDR3
	bool "LPDDR3 chips"
endchoice

config SUNXI_DRAM_TYPE
	int
	default 2 if SUNXI_DRAM_TYPE_DDR2
	default 3 if SUNXI_DRAM_TYPE_DDR3
	default 6 if SUNXI_DRAM_TYPE_LPDDR2
	default 7 if SUNXI_DRAM_TYPE_LPDDR3

endif
```

## release/src-rt-5.04behnd.4916/bootloaders/u-boot-2024.04/drivers/reboot-mode/Kconfig
```kconfig
#
# SPDX-License-Identifier: GPL-2.0+
#
# Copyright (c), Vaisala Oyj
#

menu "Reboot Mode Support"

config DM_REBOOT_MODE
	bool "Enable reboot mode using Driver Model"
	depends on DM
	help
		Enable support for reboot mode control. This will allow users to
		adjust the boot process based on reboot mode parameter
		passed to U-Boot.

config DM_REBOOT_MODE_GPIO
	bool "Use GPIOs as reboot mode backend"
	depends on DM_REBOOT_MODE
	help
		Use GPIOs to control the reboot mode. This will allow users to boot
		a device in a specific mode by using a GPIO that can be controlled
		outside U-Boot.

config DM_REBOOT_MODE_RTC
	bool "Use RTC as reboot mode backend"
	depends on DM_REBOOT_MODE
	help
		Use RTC non volatile memory to control the reboot mode. This will allow users to boot
		a device in a specific mode by using a register(s) that can be controlled
		outside U-Boot (e.g. Kernel).

config REBOOT_MODE_NVMEM
	bool "Use NVMEM reboot mode"
	depends on DM_REBOOT_MODE && NVMEM
	help
	  Use any kind of non-volatile memory (EEPROM, RTC, etc) to control the
	  reboot mode.

endmenu
```
