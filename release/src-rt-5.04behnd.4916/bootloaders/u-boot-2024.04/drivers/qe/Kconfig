## release/src-rt-5.04behnd.4916/bootloaders/u-boot-2024.04/drivers/sound/Kconfig
```kconfig
menu "Sound support"

config SOUND
	bool "Enable sound support"
	help
	  Support making sounds through an audio codec. This is normally a
	  beep at a chosen frequency for a selected length of time. However
	  the drivers support playing arbitrary sound samples using a
	  PCM interface.

	  Note: At present the sound setup is somewhat tangled up in that the
	  audio codecs are called from the sound-i2s code. This could be
	  converted to driver model.

config I2S
	bool "Enable I2S support"
	depends on SOUND
	help
	  I2S is a serial bus often used to transmit audio data from the
	  SoC to the audio codec. This option enables sound support using
	  I2S. It calls either of the two supported codecs (no use is made
	  of driver model at present).

config I2S_ROCKCHIP
	bool "Enable I2S support for Rockchip SoCs"
	depends on I2S
	help
	  Rockchip SoCs support an I2S interface for sending audio data to an
	  audio codec. This option enables support for this, using one of the
	  available audio codec drivers. This driver does not make use of
	  DMA, but writes each word directly to the hardware.

config I2S_SAMSUNG
	bool "Enable I2C support for Samsung SoCs"
	depends on I2S
	help
	  Samsung Exynos SoCs support an I2S interface for sending audio
	  data to an audio codec. This option enables support for this,
	  using one of the available audio codec drivers. Enabling this
	  option provides an implementation for sound_init() and
	  sound_play().

config SOUND_DA7219
	bool "Dialog Semiconductor audio codec"
	depends on SOUND
	help
	  The DA7219 is an ultra-low-power audio codec with Advanced Accessory
	  Detection (AAD). This driver only supports generation of ACPI tables.
	  It does not support sound output or any of the other codec
	  features.

config SOUND_I8254
	bool "Intel i8254 timer / beeper"
	depends on SOUND
	help
	  This enables support for a beeper that uses the i8254 timer chip.
	  This can emit beeps at a fixed frequency. It is possible to control
	  the length of the beeps, by turning a beep on, waiting for a period
	  of time, then turning it off.

	  This is quite an old feature, called PIT (Programmable Interval
	  Timer), but is nonetheless still available on modern x86 machines.

config SOUND_INTEL_HDA
	bool "Intel HDA audio codec"
	depends on SOUND
	help
	  Most Intel chips have an HDA (High-definition audio) codec which can
	  be used by U-Boot to play simple beeps. This is also sometimes called
	  Azalia which was the development code-name. It requires setup
	  information in the device tree (see intel-hda.txt).

config SOUND_IVYBRIDGE
	bool "Intel Ivybridge sound support"
	depends on SOUND
	select SOUND_INTEL_HDA
	help
	  Enable sound output on supported Intel Ivybridge-based boards. This
	  driver uses Intel's High-definition Audio (HDA) architecture,
	  sometimes called Azalia. The audio codec is detected using a
	  semi-automatic mechanism.

config I2S_TEGRA
	bool "Enable I2S support for Nvidia Tegra SoCs"
	depends on I2S
	select TEGRA124_DMA
	help
	  Nvidia Tegra SoCs support several I2S interfaces for sending audio
	  data to an audio codec. This option enables support for this,
	  using one of the available audio codec drivers.

config SOUND_MAX98088
	bool "Support Maxim max98088 audio codec"
	depends on I2S
	help
	  Enable the max98088 audio codec. This is connected via I2S for
	  audio data and I2C for codec control. At present it only works
	  with the Samsung I2S driver.

config SOUND_MAX98090
	bool "Support Maxim max98090 audio codec"
	depends on I2S
	help
	  Enable the max98090 audio codec. This is connected via I2S for
	  audio data and I2C for codec control. At present it only works
	  with the Samsung I2S driver.

config SOUND_MAX98095
	bool "Support Maxim max98095 audio codec"
	depends on I2S
	help
	  Enable the max98095 audio codec. This is connected via I2S for
	  audio data and I2C for codec control. At present it only works
	  with the Samsung I2S driver.

config SOUND_MAX98357A
	bool "Support Maxim max98357a audio codec"
	depends on PCI
	help
	  Enable the max98357a audio codec. This is connected on PCI for
	  audio data codec control. This is currently only capable of providing
	  ACPI information. A full driver (with sound in U-Boot) is currently
	  not available.

config SOUND_RT5677
	bool "Support Realtek RT5677 audio codec"
	depends on SOUND
	help
	  Enable the Realtek RT5677 audio codec. This is an I2S device used on
	  some Chromebooks from around 2015 ('auron'). It is configured using
	  an I2C interface and supports multiple sound inputs and outputs,
	  including digital microphones.

config SOUND_SANDBOX
	bool "Support sandbox emulated audio codec"
	depends on SANDBOX && SOUND
	help
	  U-Boot sandbox can emulate a sound device using SDL, playing the
	  sound on the host machine. This option implements the sound_init()
	  and sound_play() functions for sandbox. Note that you must install
	  the SDL libraries for this to work.

config SOUND_WM8994
	bool "Support Wolfson Micro wm8994 audio codec"
	depends on I2S_SAMSUNG
	help
	  Enable the wm8994 audio codec. This is connected via I2S for
	  audio data and I2C for codec control. At present it only works
	  with the Samsung I2S driver.

endmenu
```

## release/src-rt-5.04behnd.4916/bootloaders/u-boot-2024.04/drivers/spmi/Kconfig
```kconfig
menu "SPMI support"

config SPMI
	bool "Enable SPMI bus support"
	depends on DM
	---help---
	  Select this to enable to support SPMI bus.
	  SPMI (System Power Management Interface) bus is used
	  to connect PMIC devices on various SoCs.

config SPMI_MSM
	bool "Support Qualcomm SPMI bus"
	depends on SPMI
	---help---
	  Support SPMI bus implementation found on Qualcomm Snapdragon SoCs.

config SPMI_SANDBOX
	bool "Support for Sandbox SPMI bus"
	depends on SPMI
	---help---
	  Demo SPMI bus implementation. Emulates part of PM8916 as single
          slave (0) on bus. It has 4 GPIO peripherals, pid 0xC0-0xC3.
endmenu
```

## release/src-rt-5.04behnd.4916/bootloaders/u-boot-2024.04/drivers/sysinfo/Kconfig
```kconfig
menuconfig SYSINFO
	bool "Device System Information"
	help
	  Support methods to query hardware configurations from internal
	  mechanisms (e.g. reading GPIO values, determining the presence of
	  devices on busses, etc.). This enables the usage of U-Boot with
	  modular board architectures.

if SYSINFO

config SYSINFO_EXTRA
	bool "Show extra information on startup"
	help
	  Enable this to see extra information on startup. Normally only the
	  model is shown, but with this option the vendor and any prior-stage
	  firmware's version and date are shown as well.

config SPL_SYSINFO
	depends on SPL_DM
	bool "Enable board driver support in SPL"

config SYSINFO_GAZERBEAM
	bool "Enable sysinfo driver for the Gazerbeam board"
	help
	  Support querying device information for the gdsys Gazerbeam board.

config SYSINFO_RCAR3
	bool "Enable sysinfo driver for the Renesas R-Car Gen3"
	depends on RCAR_GEN3 && I2C_EEPROM
	default y if RCAR_GEN3
	help
	  Support querying SoC version information for Renesas R-Car Gen3.

config SYSINFO_SANDBOX
	bool "Enable sysinfo driver for the Sandbox board"
	help
	  Support querying device information for the Sandbox boards.

config SYSINFO_SMBIOS
	bool "Provide a default sysinfo driver for SMBIOS information"
	help
	  Some boards want to specify the manufacturer or product name but do
	  not need to have their own sysinfo driver. This includes a default
	  one which provides a way to specify this SMBIOS information in the
	  devicetree, without needing any board-specific functionality.

config SYSINFO_GPIO
	bool "Enable gpio sysinfo driver"
	help
	  Support querying gpios to determine board revision. This uses gpios to
	  form a ternary number (when they are pulled-up, -down, or floating).
	  This ternary number is then mapped to a board revision name using
	  device tree properties.

endif
```

## release/src-rt-5.04behnd.4916/bootloaders/u-boot-2024.04/drivers/sysreset/Kconfig
```kconfig
#
# System reset devices
#

menu "System reset device drivers"

config SYSRESET
	bool "Enable support for system reset drivers"
	depends on DM
	help
	  Enable system reset drivers which can be used to reset the CPU or
	  board. Each driver can provide a reset method which will be called
	  to effect a reset. The uclass will try all available drivers when
	  reset_walk() is called.

config SPL_SYSRESET
	bool "Enable support for system reset drivers in SPL mode"
	depends on SYSRESET && SPL_DM
	help
	  Enable system reset drivers which can be used to reset the CPU or
	  board. Each driver can provide a reset method which will be called
	  to effect a reset. The uclass will try all available drivers when
	  reset_walk() is called.

config TPL_SYSRESET
	bool "Enable support for system reset drivers in TPL mode"
	depends on SYSRESET && TPL_DM
	help
	  Enable system reset drivers which can be used to reset the CPU or
	  board. Each driver can provide a reset method which will be called
	  to effect a reset. The uclass will try all available drivers when
	  reset_walk() is called.

config VPL_SYSRESET
	bool "Enable support for system reset drivers in VPL mode"
	depends on SYSRESET && VPL_DM
	default y if TPL_SYSRESET
	help
	  Enable system reset drivers which can be used to reset the CPU or
	  board. Each driver can provide a reset method which will be called
	  to effect a reset. The uclass will try all available drivers when
	  reset_walk() is called.

if SYSRESET

config SYSRESET_CMD_RESET
	bool "sysreset implementation of the reset command"
	default y
	help
	  Enable sysreset implementation of the reset command.

if CMD_POWEROFF

config SYSRESET_CMD_POWEROFF
	bool "sysreset implementation of the poweroff command"
	help
	  This should be selected by the appropriate PMIC driver if
	  the poweroff command is enabled.

endif

config POWEROFF_GPIO
	bool "Enable support for GPIO poweroff driver"
	depends on DM_GPIO
	help
	  Support for system poweroff using a GPIO pin. This can be used
	  for systems having a single GPIO to trigger a system poweroff.

config SYSRESET_GPIO
	bool "Enable support for GPIO reset driver"
	depends on DM_GPIO
	help
	  Reset support via GPIO pin connected reset logic. This is used for
	  example on Microblaze where reset logic can be controlled via GPIO
	  pin which triggers cpu reset.

config SYSRESET_MAX77663
	bool "Enable support for MAX77663 PMIC System Reset"
	depends on DM_PMIC_MAX77663
	select SYSRESET_CMD_POWEROFF if CMD_POWEROFF
	help
	  Enable system power management functions found in MAX77663 PMIC.

config SYSRESET_MICROBLAZE
	bool "Enable support for Microblaze soft reset"
	depends on MICROBLAZE
	help
	  This is soft reset on Microblaze which does jump to 0x0 address.

config SYSRESET_OCTEON
	bool "Enable support for Marvell Octeon SoC family"
	depends on ARCH_OCTEON
	help
	  This enables the system reset driver support for Marvell Octeon
	  SoCs.

config SYSRESET_AT91
	bool "Enable support for Microchip/Atmel reset driver"
	depends on ARCH_AT91
	select SYSRESET_SPL_AT91 if SPL && SPL_SYSRESET
	help
	  This enables the system reset driver support for Microchip/Atmel
	  SoCs.

config SYSRESET_SPL_AT91
	bool "Enable support for Microchip/Atmel reset driver in SPL"
	depends on ARCH_AT91
	help
	  This enables the system reset driver support for Microchip/Atmel
	  SoCs in SPL.

config SYSRESET_PALMAS
	bool "Enable support for PALMAS System Reset"
	depends on PMIC_PALMAS
	select SYSRESET_CMD_POWEROFF if CMD_POWEROFF
	help
	  Enable system power management functions found in PLAMAS PMIC family.

config SYSRESET_PSCI
	bool "Enable support for PSCI System Reset"
	depends on ARM_PSCI_FW
	select SPL_ARM_PSCI_FW if SPL
	help
	  Enable PSCI SYSTEM_RESET function call.  To use this, PSCI firmware
	  must be running on your system.

config SYSRESET_SBI
	bool "Enable support for SBI System Reset"
	depends on RISCV_SMODE && SBI_V02
	default y
	select SYSRESET_CMD_POWEROFF if CMD_POWEROFF
	help
	  Enable system reset and poweroff via the SBI system reset extension.
	  The extension was introduced in version 0.3 of the SBI specification.

	  If the SBI implementation provides the extension, is board specific.
	  The RISC-V platform specification mandates the extension for rich
	  operating system platforms.

config SYSRESET_SOCFPGA
	bool "Enable support for Intel SOCFPGA family"
	depends on ARCH_SOCFPGA && (TARGET_SOCFPGA_GEN5 || TARGET_SOCFPGA_ARRIA10)
	help
	  This enables the system reset driver support for Intel SOCFPGA SoCs
	  (Cyclone 5, Arria 5 and Arria 10).

config SYSRESET_SOCFPGA_SOC64
	bool "Enable support for Intel SOCFPGA SoC64 family (Stratix10/Agilex)"
	depends on ARCH_SOCFPGA && TARGET_SOCFPGA_SOC64
	help
	  This enables the system reset driver support for Intel SOCFPGA
	  SoC64 SoCs.

config SYSRESET_TEGRA
	bool "Tegra PMC system reset driver"
	depends on ARCH_TEGRA
	help
	  This enables the system reset ability of PMC used in Tegra SoCs.

config SYSRESET_TI_SCI
	bool "TI System Control Interface (TI SCI) system reset driver"
	depends on TI_SCI_PROTOCOL
	help
	  This enables the system reset driver support over TI System Control
	  Interface available on some new TI's SoCs.

config SYSRESET_TPS65910
	bool "Enable support for TPS65910/TPS65911 PMIC System Reset"
	depends on DM_PMIC_TPS65910
	select SYSRESET_CMD_POWEROFF if CMD_POWEROFF
	help
	  Enable system power management functions found in TPS65910/TPS65911
	  PMICs.

config SYSRESET_TPS80031
	bool "Enable support for TPS80031/TPS80032 PMIC System Reset"
	depends on DM_PMIC_TPS80031
	select SYSRESET_CMD_POWEROFF if CMD_POWEROFF
	help
	  Enable system power management functions found in TPS80031/TPS80032
	  PMICs.

config SYSRESET_SYSCON
	bool "Enable support for mfd syscon reboot driver"
	select REGMAP
	select SYSCON
	help
	  Reboot support for generic SYSCON mapped register reset.

config SYSRESET_WATCHDOG
	bool "Enable support for watchdog reboot driver"
	select WDT
	help
	  Reboot support for generic watchdog reset.

config SYSRESET_WATCHDOG_AUTO
	bool "Automatically register first watchdog with sysreset"
	depends on SYSRESET_WATCHDOG
	help
	  If enabled, the first watchdog (as selected by the watchdog uclass)
	  will automatically be registered with the watchdog reboot driver.

config SYSRESET_RESETCTL
	bool "Enable support for reset controller reboot driver"
	select DM_RESET
	help
	  Reboot support using generic reset controller.

config SYSRESET_X86
	bool "Enable support for x86 processor reboot driver"
	depends on X86
	help
	  Reboot support for generic x86 processor reset.

config SYSRESET_SPL_X86
	bool "Enable support for x86 processor reboot driver in SPL"
	depends on X86
	help
	  Reboot support for generic x86 processor reset in SPL.

config SYSRESET_TPL_X86
	bool "Enable support for x86 processor reboot driver in TPL"
	depends on X86
	help
	  Reboot support for generic x86 processor reset in TPL.

config SYSRESET_MPC83XX
	bool "Enable support MPC83xx SoC family reboot driver"
	help
	  Reboot support for NXP MPC83xx SoCs.

config SYSRESET_RAA215300
	bool "Support sysreset via Renesas RAA215300 PMIC"
	depends on PMIC_RAA215300
	help
	  Add support for the system reboot via the Renesas RAA215300 PMIC.

endif

endmenu
```
