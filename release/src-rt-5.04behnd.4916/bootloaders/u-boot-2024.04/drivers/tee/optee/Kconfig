## release/src-rt-5.04behnd.4916/bootloaders/u-boot-2024.04/drivers/usb/musb-new/Kconfig
```kconfig
#
# MUSB Controller Driver
#
comment "MUSB Controller Driver"

config USB_MUSB_HOST
	bool "MUSB host mode support"
	depends on DM && OF_CONTROL
	select SPL_SPRINTF if SPL
	select TPL_SPRINTF if TPL
	select USB_HOST
	help
	  Enables the MUSB USB dual-role controller in host mode.

config USB_MUSB_GADGET
	bool "MUSB gadget mode support"
	depends on USB_GADGET
	select USB_GADGET_DUALSPEED
	select SPL_SPRINTF if SPL
	select TPL_SPRINTF if TPL
	help
	  Enables the MUSB USB dual-role controller in gadget mode.

if USB_MUSB_HOST || USB_MUSB_GADGET
config USB_MUSB_DA8XX
	bool "Enable DA8xx MUSB Controller"
	depends on ARCH_DAVINCI
	help
	  Say y here to enable support for the dual role high
	  speed USB controller based on the Mentor Graphics
	  silicon IP.

config USB_MUSB_TI
	bool "Enable TI OTG USB controller"
	depends on AM33XX
	select USB_MUSB_DSPS
	help
	  Say y here to enable support for the dual role high
	  speed USB controller based on the Mentor Graphics
	  silicon IP.

config USB_MUSB_OMAP2PLUS
	tristate "OMAP2430 and onwards"
	depends on ARCH_OMAP2PLUS

config USB_MUSB_AM35X
	bool "AM35x"

config USB_MUSB_DSPS
	bool "TI DSPS platforms"

config USB_MUSB_MT85XX
	bool "Enable Mediatek MT85XX DRC USB controller"
	depends on ARCH_MEDIATEK
	help
	  Say y to enable Mediatek MT85XX USB DRC controller support
	  if it is available on your Mediatek MUSB IP based platform.
	  DMA controllers are ignored. This driver follow musb-new
	  driver and usb gadget framework.

config USB_MUSB_PIC32
	bool "Enable Microchip PIC32 DRC USB controller"
	depends on MACH_PIC32
	help
	  Say y to enable PIC32 USB DRC controller support
	  if it is available on your Microchip PIC32 platform.

config USB_MUSB_SUNXI
	bool "Enable sunxi OTG / DRC USB controller"
	depends on ARCH_SUNXI
	depends on PHY_SUN4I_USB
	select USB_MUSB_PIO_ONLY
	default y
	---help---
	Say y here to enable support for the sunxi OTG / DRC USB controller
	used on almost all sunxi boards.

config USB_MUSB_UX500
	bool "Enable ST-Ericsson Ux500 USB controller"
	depends on DM_USB && DM_USB_GADGET && ARCH_U8500
	default y
	help
	  Say y to enable support for the MUSB OTG USB controller used in
	  ST-Ericsson Ux500. The driver supports either gadget or host mode
	  based on the selection of CONFIG_USB_MUSB_HOST.

config USB_MUSB_DISABLE_BULK_COMBINE_SPLIT
	bool "Disable MUSB bulk split/combine"
	default y
	help
	  On TI AM335x devices, MUSB has bulk split/combine feature enabled
	  in the ConfigData register, but the current MUSB driver does not
	  support it yet. Select this option to disable the feature until the
	  driver adds the support.

endif

config USB_MUSB_PIO_ONLY
	bool "Disable DMA (always use PIO)"
	default y if USB_MUSB_AM35X || USB_MUSB_PIC32 || USB_MUSB_OMAP2PLUS || USB_MUSB_DSPS || USB_MUSB_SUNXI || USB_MUSB_MT85XX || USB_MUSB_UX500
	help
	  All data is copied between memory and FIFO by the CPU.
	  DMA controllers are ignored.

config USB_MUSB_FIXED_CONFIGDATA
	bool "Hardcode MUSB CONFIGDATA register"
	depends on USB_MUSB_SUNXI
	default n if MACH_SUN4I || MACH_SUN5I || MACH_SUN6I || MACH_SUN7I || MACH_SUN8I_A23
	default y
	help
	  Newer Allwinner SoCs do not implement the MUSB_CONFIGDATA register,
	  so it always reads 0. Select this option to override this and
	  return a hardcoded value instead.
```

## release/src-rt-5.04behnd.4916/bootloaders/u-boot-2024.04/drivers/usb/musb/Kconfig
```kconfig
# SPDX-License-Identifier: GPL-2.0+
#
# (C) Copyright 2017
# Adam Ford, Logic PD, aford173@gmail.com

comment "Legacy MUSB Support"

config USB_MUSB_HCD
	bool "Legacy MUSB Host Controller"

config USB_MUSB_UDC
	bool "Legacy USB Device Controller"

config USB_OMAP3
	bool "Legacy MUSB OMAP3 / OMAP4"
	depends on ARCH_OMAP2PLUS

config USB_AM35X
	bool"Legacy MUSB AM35x"
	depends on ARCH_OMAP2PLUS && !USB_OMAP3
```

## release/src-rt-5.04behnd.4916/bootloaders/u-boot-2024.04/drivers/usb/phy/Kconfig
```kconfig
# SPDX-License-Identifier: GPL-2.0+
#
# (C) Copyright 2017
# Adam Ford, Logic PD, aford173@gmail.com

comment "USB Phy"

config TWL4030_USB
	bool "TWL4030 PHY"

config ROCKCHIP_USB2_PHY
	bool "Rockchip USB2 PHY"
```

## release/src-rt-5.04behnd.4916/bootloaders/u-boot-2024.04/drivers/video/exynos/Kconfig
```kconfig
menuconfig VIDEO_EXYNOS
	bool "Enable Exynos video support"
	depends on VIDEO
	help
	  Enable support for various video output options on Exynos SoCs.

if VIDEO_EXYNOS

config EXYNOS_DP
	bool "Exynos Display Port support"

config EXYNOS_FB
	bool "Exynos FIMD support"

config EXYNOS_MIPI_DSIM
	bool "Exynos MIPI DSI support"
	depends on EXYNOS_FB

endif
```

## release/src-rt-5.04behnd.4916/bootloaders/u-boot-2024.04/drivers/video/fonts/Kconfig
```kconfig
#
# Video fonts
#

menu "TrueType Fonts"

config CONSOLE_TRUETYPE_NIMBUS
	bool "Nimbus Sans Regular"
	depends on CONSOLE_TRUETYPE
	default y
	help
	  Nimbus Sans L is a version of Nimbus Sans using Adobe font sources.
	  It was designed in 1987. A subset of Nimbus Sans L were released
	  under the GPL. Although the characters are not exactly the same,
	  Nimbus Sans L has metrics almost identical to Helvetica and Arial.
	  (From Wikipedia, the free encyclopedia)
	  From: https://fontlibrary.org/en/font/nimbus-sans-l
	  License: GNU GPL v3
	  http://www.gnu.org/copyleft/gpl.html

config CONSOLE_TRUETYPE_ANKACODER
	bool "Anka Coder Narrow"
	depends on CONSOLE_TRUETYPE
	help
	  The Anka/Coder family is a monospaced, courier-width font for source
	  code and terminals, in two styles and weights. Anka/Coder Narrow was
	  developed for printing source code.
	  https://code.google.com/p/anka-coder-fonts/
	  From: https://fontlibrary.org/en/font/anka-coder-narrow
	  License: SIL Open Font Licence
	  http://scripts.sil.org/cms/scripts/page.php?site_id=nrsi&id=OFL

config CONSOLE_TRUETYPE_RUFSCRIPT
	bool "Ruf Script"
	depends on CONSOLE_TRUETYPE
	help
	  A laid-back handwritten font.
	  Font: https://fontlibrary.org/en/font/rufscript
	  License: GPL with font exception
	  http://www.gnu.org/copyleft/gpl.html

config CONSOLE_TRUETYPE_CANTORAONE
	bool "Cantoraone"
	depends on CONSOLE_TRUETYPE
	help
	  Cantora is a friendly semi formal, semi condensed, semi sans-serif
	  with a hint of handwriting. Perfect for headlines.
	  From https://fontlibrary.org/en/font/cantora
	  License: SIL Open Font Licence
	  http://scripts.sil.org/cms/scripts/page.php?site_id=nrsi&id=OFL

endmenu
```

## release/src-rt-5.04behnd.4916/bootloaders/u-boot-2024.04/drivers/video/imx/Kconfig
```kconfig
config VIDEO_IPUV3
	bool "i.MX IPUv3 Core video support"
	depends on VIDEO && (MX5 || MX6)
	help
	  This enables framebuffer driver for i.MX processors working
	  on the IPUv3(Image Processing Unit) internal graphic processor.

config IMX_VIDEO_SKIP
	bool "Enable calling board_video_skip function"
	depends on VIDEO_IPUV3

config IMX_HDMI
	bool "Enable HDMI support in IPUv3"
	depends on VIDEO_IPUV3
```

## release/src-rt-5.04behnd.4916/bootloaders/u-boot-2024.04/drivers/video/nexell/Kconfig
```kconfig
if VIDEO_NX

menu "LCD select"

config VIDEO_NX_RGB
	bool "RGB LCD"
	help
	  Support for RGB lcd output.

config VIDEO_NX_LVDS
	bool "LVDS LCD"
	help
	  Support for LVDS lcd output.

config VIDEO_NX_MIPI
	bool "MiPi"
	help
	  Support for MiPi lcd output.

config VIDEO_NX_HDMI
	bool "HDMI"
	help
	  Support for hdmi output.

endmenu

endif
```

## release/src-rt-5.04behnd.4916/bootloaders/u-boot-2024.04/drivers/video/stm32/Kconfig
```kconfig
# SPDX-License-Identifier: GPL-2.0+
#
# Copyright (C) STMicroelectronics SA 2017
#
# Authors: Philippe Cornu <philippe.cornu@st.com>
#          Yannick Fertre <yannick.fertre@st.com>

menuconfig VIDEO_STM32
	bool "Enable STM32 video support"
	depends on VIDEO
	help
	  STM32 supports many video output options including RGB and
	  DSI. This option enables these supports which can be used on
	  devices which have RGB TFT or DSI display connected.

config VIDEO_STM32_DSI
	bool "Enable STM32 DSI video support"
	depends on VIDEO_STM32
	select VIDEO_BRIDGE
	select VIDEO_DW_MIPI_DSI
	help
	  This option enables support DSI internal bridge which can be used on
	  devices which have DSI devices connected.

config VIDEO_STM32_MAX_XRES
	int "Maximum horizontal resolution (for memory allocation purposes)"
	depends on VIDEO_STM32
	default 640
	help
	  The maximum horizontal resolution to support for the framebuffer.
	  This configuration is used for reserving/allocating memory for the
	  framebuffer during device-model binding/probing.

config VIDEO_STM32_MAX_YRES
	int "Maximum vertical resolution (for memory allocation purposes)"
	depends on VIDEO_STM32
	default 480
	help
	  The maximum vertical resolution to support for the framebuffer.
	  This configuration is used for reserving/allocating memory for the
	  framebuffer during device-model binding/probing.

config VIDEO_STM32_MAX_BPP
	int "Maximum bits per pixel (for memory allocation purposes)"
	depends on VIDEO_STM32
	default 16
	help
	  The maximum bits per pixel to support for the framebuffer.
	  This configuration is used for reserving/allocating memory for the
	  framebuffer during device-model binding/probing.
```

## release/src-rt-5.04behnd.4916/bootloaders/u-boot-2024.04/drivers/video/tegra20/Kconfig
```kconfig
config VIDEO_TEGRA20
	bool "Enable Display Controller support on Tegra20 and Tegra 30"
	depends on OF_CONTROL
	help
	   T20/T30 support video output to an attached LCD panel as well as
	   other options such as HDMI. Only the LCD is supported in U-Boot.
	   This option enables this support which can be used on devices which
	   have an LCD display connected.

config VIDEO_DSI_TEGRA30
	bool "Enable Tegra 30 DSI support"
	depends on PANEL && DM_GPIO
	select VIDEO_TEGRA20
	select VIDEO_MIPI_DSI
	help
	   T30 has native support for DSI panels. This option enables support
	   for such panels which can be used on endeavoru and tf600t.

config TEGRA_BACKLIGHT_PWM
	bool "Enable Tegra DC PWM backlight support"
	depends on BACKLIGHT
	select VIDEO_TEGRA20
	help
	   Tegra DC dependent backlight.
```

## release/src-rt-5.04behnd.4916/bootloaders/u-boot-2024.04/drivers/video/ti/Kconfig
```kconfig
# SPDX-License-Identifier: GPL-2.0+
#
# Copyright (C) 2020 Dario Binacchi <dariobin@libero.it>
#
config AM335X_LCD
	bool "Enable AM335x video support"
	help
	   Supports video output to an attached LCD panel.
```

## release/src-rt-5.04behnd.4916/bootloaders/u-boot-2024.04/drivers/video/tidss/Kconfig
```kconfig
# SPDX-License-Identifier: GPL-2.0+
#
# (C) Copyright 2023 Texas Instruments Incorporated - https://www.ti.com/
# Nikhil M Jain, n-jain1@ti.com
#
# based on the linux tidss driver, which is
#
# (C) Copyright 2018 Texas Instruments Incorporated - https://www.ti.com/
# Author: Tomi Valkeinen <tomi.valkeinen@ti.com>

menuconfig VIDEO_TIDSS
	bool "Enable TIDSS video support"
	depends on VIDEO
	help
	  TIDSS supports  video output options LVDS and
	  DPI . This option enables these supports which can be used on
	  devices which have OLDI or HDMI display connected.

config SPL_VIDEO_TIDSS
	bool "Enable TIDSS video support in SPL Stage"
	depends on SPL_VIDEO
	help
	  This options enables tidss driver in SPL stage. If
	  you need to use tidss at SPL stage use this config.
```

## release/src-rt-5.04behnd.4916/bootloaders/u-boot-2024.04/drivers/video/zynqmp/Kconfig
```kconfig
config VIDEO_ZYNQMP_DPSUB
	bool "Enable video support for ZynqMP Display Port"
	depends on ZYNQMP_POWER_DOMAIN
	help
	Enable support for Xilinx ZynqMP Display Port. Currently this file
	is used as placeholder for driver. The main reason is to record
	compatible string and calling power domain driver.
```

## release/src-rt-5.04behnd.4916/bootloaders/u-boot-2024.04/drivers/w1-eeprom/Kconfig
```kconfig
#
# EEPROM subsystem configuration
#

menu "1-wire EEPROM support"

config W1_EEPROM
	bool "Enable support for EEPROMs on 1wire interface"
	depends on DM
	help
	  Support for the EEPROMs connected on 1-wire Dallas protocol interface

if W1_EEPROM

config W1_EEPROM_DS24XXX
	bool "Enable Maxim DS24 families EEPROM support"
	depends on W1
	help
	  Maxim DS24 EEPROMs 1-Wire EEPROM support

config W1_EEPROM_DS2502
	bool "Enable Maxim DS2502 Add-Only Memory support"
	depends on W1
	help
	  Maxim DS2502 1-Wire add-only memory support.
	  This device has 128 bytes of data memory, organized as 4 pages of
	  32 bytes and 8 out of band status bytes that may be used to redirect
	  pages, allowing data to be modified up to 4 times (by external
	  programming).

	  The device may be seen as a 32 byte memory, using the page redirection
	  or as a 128 byte memory, ignoring the page redirection.

config W1_EEPROM_SANDBOX
	bool "Enable sandbox onewire EEPROM driver"
	depends on W1
	help
	  Sandbox driver for a onewire EEPROM memory

endif

endmenu
```

## release/src-rt-5.04behnd.4916/bootloaders/u-boot-2024.04/drivers/w1/Kconfig
```kconfig
#
# W1 subsystem configuration
#

menu "1-Wire support"

config W1
	bool "Enable 1-wire controllers support"
	depends on DM
	help
	  Support for the Dallas 1-Wire bus.

if W1

config W1_GPIO
	bool "Enable 1-wire GPIO bitbanging"
	depends on DM_GPIO
	help
	  Emulate a 1-wire bus using a GPIO.

config W1_MXC
	bool "Enable 1-wire controller on i.MX processors"
	depends on ARCH_MX31 || ARCH_MX5
	help
	  Support the one wire controller found in some members of the NXP
	  i.MX SoC family.
	  There are currently two silicon variants:
	  V1: i.MX21, i.MX27, i.MX31, i.MX51
	  V2: i.MX25, i.MX35, i.MX50, i.MX53
	  Newer i.MX SoCs such as the i.MX6 do not have one wire controllers.

	  The driver supports both silicon variants.

endif

endmenu
```

## release/src-rt-5.04behnd.4916/bootloaders/u-boot-2024.04/drivers/xen/Kconfig
```kconfig
config PVBLOCK
	bool "Xen para-virtualized block device"
	depends on DM && XEN
	select BLK
	help
	  This driver implements the front-end of the Xen virtual
	  block device driver. It communicates with a back-end driver
	  in another domain which drives the actual block device.
```
