## release/src-rt-5.04behnd.4916/bootloaders/u-boot-2024.04/fs/Kconfig
```kconfig
#
# File system configuration
#

menu "File systems"

source "fs/btrfs/Kconfig"

source "fs/cbfs/Kconfig"

source "fs/ext4/Kconfig"

source "fs/reiserfs/Kconfig"

source "fs/fat/Kconfig"

source "fs/jffs2/Kconfig"

source "fs/sandbox/Kconfig"

source "fs/ubifs/Kconfig"

source "fs/cramfs/Kconfig"

source "fs/yaffs2/Kconfig"

source "fs/squashfs/Kconfig"

source "fs/erofs/Kconfig"

endmenu
```
