## release/src-rt-5.04behnd.4916/bootloaders/u-boot-2024.04/test/image/Kconfig
```kconfig
# SPDX-License-Identifier: GPL-2.0+
# Copyright (C) 2023 Sean Anderson <seanga2@gmail.com>

config SPL_UT_LOAD
	bool "Unit tests for SPL load methods"
	depends on SPL_UNIT_TEST
	default y if SANDBOX
	help
	  Test various SPL load methods.

if SPL_UT_LOAD

config SPL_UT_LOAD_FS
	bool "Unit tests for filesystems"
	depends on SANDBOX && SPL_OF_REAL
	depends on FS_LOADER
	depends on SPL_BLK_FS
	depends on SPL_FS_FAT
	depends on SPL_FS_EXT4
	depends on SPL_MMC_WRITE
	depends on SYS_MMCSD_RAW_MODE_U_BOOT_USE_SECTOR
	default y
	help
	  Test filesystems and the various load methods which use them.

config SPL_UT_LOAD_NAND
	bool "Test loading from NAND flash"
	depends on SANDBOX && SPL_OF_REAL
	depends on SPL_NAND_SUPPORT
	depends on SPL_MTD
	default y
	help
	  Test the NAND flash load method.

config SPL_UT_LOAD_NET
	bool "Test loading over TFTP"
	depends on SANDBOX && SPL_OF_REAL
	depends on SPL_ETH
	depends on USE_BOOTFILE
	default y
	help
	  Test loading images over TFTP using the NET image load method.

config SPL_UT_LOAD_SPI
	bool "Test loading from SPI Flash"
	depends on SANDBOX && SPL_OF_REAL
	depends on SPL_SPI_LOAD
	default y
	help
	  Test the SPI flash image load metod.

config SPL_UT_LOAD_OS
	bool "Test loading from the host OS"
	depends on SANDBOX && SPL_LOAD_FIT
	select SPL_LOAD_BLOCK
	default y
	help
	  Smoke test to ensure that loading U-boot works in sandbox.

endif
```

## release/src-rt-5.04behnd.4916/bootloaders/u-boot-2024.04/test/lib/Kconfig
```kconfig
# SPDX-License-Identifier: GPL-2.0+
# Copyright 2022 Google LLC

config TEST_KCONFIG
	bool "Enable detection of Kconfig macro errors"
	depends on SANDBOX
	help
	  This is used to test that the IF_ENABLED_INT() macro causes a build error
	  if the value is used when the CONFIG is not enabled.

if TEST_KCONFIG

config TEST_KCONFIG_ENABLE
	bool "Provide a value for the Kconfig test"
	help
	  This is the option that controls whether the value is present.

config TEST_KCONFIG_VALUE
	int "Value used in Kconfig test"
	depends on TEST_KCONFIG_ENABLE
	help
	  This is the value which is present if TEST_KCONFIG_ENABLE is enabled.

endif # TEST_KCONFIG
```

## release/src-rt-5.04behnd.4916/bootloaders/u-boot-2024.04/test/optee/Kconfig
```kconfig
config UT_OPTEE
	bool "Enable OP-TEE Unit Tests"
	depends on UNIT_TEST && OF_CONTROL && OPTEE
	default y
	help
	  This enables the 'ut optee' command which runs a series of unit
	  tests on the optee library code..
```

## release/src-rt-5.04behnd.4916/bootloaders/u-boot-2024.04/test/py/tests/source.its
```
/dts-v1/;

/ {
    description = "FIT image to test the source command";
    #address-cells = <1>;

    images {
        default = "script-1";

        script-1 {
            data = "echo 1";
            type = "script";
            arch = "sandbox";
            compression = "none";
        };

        script-2 {
            data = "echo 2";
            type = "script";
            arch = "sandbox";
            compression = "none";
        };

        not-a-script {
            data = "echo 3";
            type = "kernel";
            arch = "sandbox";
            compression = "none";
        };
    };

    configurations {
        default = "conf-2";

        conf-1 {
            script = "script-1";
        };

        conf-2 {
            script = "script-2";
        };
    };
};
```

## release/src-rt-5.04behnd.4916/bootloaders/u-boot-2024.04/test/py/tests/vboot/hash-images.its
```
/dts-v1/;

/ {
	description = "Chrome OS kernel image with one or more FDT blobs";
	#address-cells = <1>;

	images {
		kernel {
			data = /incbin/("test-kernel.bin");
			type = "kernel_noload";
			arch = "sandbox";
			os = "linux";
			compression = "none";
			load = <0x4>;
			entry = <0x8>;
			kernel-version = <1>;
			hash-0 {
                                algo = "crc16-ccitt";
                        };
                        hash-1 {
                                algo = "crc32";
                        };
                        hash-2 {
                                algo = "md5";
                        };
                        hash-3 {
                                algo = "sha1";
                        };
                        hash-4 {
                                algo = "sha256";
                        };
                        hash-5 {
                                algo = "sha384";
                        };
                        hash-6 {
                                algo = "sha512";
                        };
		};
		fdt-1 {
			description = "snow";
			data = /incbin/("sandbox-kernel.dtb");
			type = "flat_dt";
			arch = "sandbox";
			compression = "none";
			fdt-version = <1>;
			hash-0 {
                                algo = "crc16-ccitt";
                        };
                        hash-1 {
                                algo = "crc32";
                        };
                        hash-2 {
                                algo = "md5";
                        };
                        hash-3 {
                                algo = "sha1";
                        };
                        hash-4 {
                                algo = "sha256";
                        };
                        hash-5 {
                                algo = "sha384";
                        };
                        hash-6 {
                                algo = "sha512";
                        };
		};
	};
	configurations {
		default = "conf-1";
		conf-1 {
			kernel = "kernel";
			fdt = "fdt-1";
		};
	};
};
```

## release/src-rt-5.04behnd.4916/bootloaders/u-boot-2024.04/test/py/tests/vboot/sign-images-sha1-pss.its
```
/dts-v1/;

/ {
	description = "Chrome OS kernel image with one or more FDT blobs";
	#address-cells = <1>;

	images {
		kernel {
			data = /incbin/("test-kernel.bin");
			type = "kernel_noload";
			arch = "sandbox";
			os = "linux";
			compression = "none";
			load = <0x4>;
			entry = <0x8>;
			kernel-version = <1>;
			signature {
				algo = "sha1,rsa2048";
				padding = "pss";
				key-name-hint = "dev";
			};
		};
		fdt-1 {
			description = "snow";
			data = /incbin/("sandbox-kernel.dtb");
			type = "flat_dt";
			arch = "sandbox";
			compression = "none";
			fdt-version = <1>;
			signature {
				algo = "sha1,rsa2048";
				padding = "pss";
				key-name-hint = "dev";
			};
		};
	};
	configurations {
		default = "conf-1";
		conf-1 {
			kernel = "kernel";
			fdt = "fdt-1";
		};
	};
};
```

## release/src-rt-5.04behnd.4916/bootloaders/u-boot-2024.04/tools/Kconfig
```kconfig
menu "Tools options"

config MKIMAGE_DTC_PATH
	string "Path to dtc binary for use within mkimage"
	default "dtc"
	help
	  The mkimage host tool will, in order to generate FIT images make
	  calls to the dtc application in order to create the output.  In
	  some cases the system dtc may not support all required features
	  and the path to a different version should be given here.

config TOOLS_CRC32
	def_bool y
	help
	  Enable CRC32 support in the tools builds

config TOOLS_LIBCRYPTO
	bool "Use OpenSSL's libcrypto library for host tools"
	default y
	help
	  Cryptographic signature, verification, and encryption of images is
	  provided by host tools using OpenSSL's libcrypto. Select 'n' here if
	  you wish to build host tools without OpenSSL. mkimage will not have
	  the ability to sign images.
	  This selection does not affect target features, such as runtime FIT
	  signature verification.

config TOOLS_KWBIMAGE
	bool "Enable kwbimage support in host tools"
	default y
	select TOOLS_LIBCRYPTO

config TOOLS_FIT
	def_bool y
	help
	  Enable FIT support in the tools builds.

config TOOLS_FIT_FULL_CHECK
	def_bool y
	help
	  Do a full check of the FIT before using it in the tools builds

config TOOLS_FIT_PRINT
	def_bool y
	help
	  Print the content of the FIT verbosely in the tools builds

config TOOLS_FIT_RSASSA_PSS
	def_bool y
	help
	  Support the rsassa-pss signature scheme in the tools builds

config TOOLS_FIT_SIGNATURE
	depends on TOOLS_LIBCRYPTO
	def_bool y
	help
	  Enable signature verification of FIT uImages in the tools builds

config TOOLS_FIT_SIGNATURE_MAX_SIZE
	hex
	depends on TOOLS_FIT_SIGNATURE
	default 0x10000000

config TOOLS_FIT_VERBOSE
	def_bool y
	help
	  Support verbose FIT output in the tools builds

config TOOLS_MD5
	def_bool y
	help
	  Enable MD5 support in the tools builds

config TOOLS_OF_LIBFDT
	def_bool y
	help
	  Enable libfdt support in the tools builds

config TOOLS_SHA1
	def_bool y
	help
	  Enable SHA1 support in the tools builds

config TOOLS_SHA256
	def_bool y
	help
	  Enable SHA256 support in the tools builds

config TOOLS_SHA384
	def_bool y
	help
	  Enable SHA384 support in the tools builds

config TOOLS_SHA512
	def_bool y
	help
	  Enable SHA512 support in the tools builds

config TOOLS_MKEFICAPSULE
	bool "Build efimkcapsule command"
	default y if EFI_CAPSULE_ON_DISK
	help
	  This command allows users to create a UEFI capsule file and,
	  optionally sign that file. If you want to enable UEFI capsule
	  update feature on your target, you certainly need this.

menuconfig FSPI_CONF_HEADER
	bool "FlexSPI Header Configuration"
	help
	  FSPI Header Configuration

config FSPI_CONF_FILE
	string "FlexSPI Header File"
	depends on FSPI_CONF_HEADER
	help
	  FlexSPI Header File name

config READ_CLK_SOURCE
	hex "Sampling Clock Source"
	default 0x00
	depends on FSPI_CONF_HEADER
	help
	  Sample Clock source for Flash, default is internal loopback clock

config DEVICE_TYPE
	hex "Flash Type"
	default 0x01
	depends on FSPI_CONF_HEADER
	help
	  Flash type: Serial NOR (0X01) and Serial NAND (0x02)

config FLASH_PAD_TYPE
	hex "Flash Pad Type"
	default 0x01
	depends on FSPI_CONF_HEADER
	help
	  Flash Pad type :
	  Single Pad 0x01
	  Dual Pads  0x02
	  Quad Pad   0x04
	  Octal Pad  0x08

config SERIAL_CLK_FREQUENCY
	hex "Serial Clock Frequency"
	default 0x02
	depends on FSPI_CONF_HEADER
	help
	  Chip specific frequency: other value 30MHz
	  1-30MHz  2-50MHz 3-60MHz 4-75MHz 5-80MHz 6-100MHz 7-133MHz 8-166MHz

config FSPI_COL_ADDR_W
	hex "Column Address With"
	default 0x00
	depends on FSPI_CONF_HEADER
	help
	  Default 0. For HyperBus protocol, it is fixed to 3

config FSPI_CONTROLLER_MISC
	hex "FSPI miscellaneous control"
	default 0x00000000
	depends on FSPI_CONF_HEADER
	help
	  Default 0. [0x40] Controller Misc Options

config FSPI_FLASH_A1_SIZE
	hex "Size in bytes of Flash A1"
	default 0x10000000
	depends on FSPI_CONF_HEADER
	help
	  Size of Flash connected to A1 in bytes

config LUT_CUSTOM_SEQUENCE
	hex "Enable Custom Look Up Table(LUT) Sequence"
	default 0x00
	depends on FSPI_CONF_HEADER
	help
	  0 - Use predefined LUT Sequence
	  1 - Use LUT Sequence provided

config LUT_SEQUENCE
	string "Look Up Table Sequence"
	default "0x0b, 0x04, 0x18, 0x08, 0x08, 0x30, 0x04, 0x24"
	depends on FSPI_CONF_HEADER
	help
	  Look Up Table Sequence

config TOOLS_MKFWUMDATA
	bool "Build mkfwumdata command"
	default y if FWU_MULTI_BANK_UPDATE
	help
	  This command allows users to create a raw image of the FWU
	  metadata for initial installation of the FWU multi bank
	  update on the board. The installation method depends on
	  the platform.

endmenu
```
