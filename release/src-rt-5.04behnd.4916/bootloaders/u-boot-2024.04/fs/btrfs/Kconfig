## release/src-rt-5.04behnd.4916/bootloaders/u-boot-2024.04/fs/btrfs/Kconfig
```kconfig
config FS_BTRFS
	bool "Enable BTRFS filesystem support"
	select CRC32C
	select LIB_UUID
	select LZO
	select ZSTD
	select RBTREE
	select SHA256
	select BLAKE2
	help
	  This provides a single-device read-only BTRFS support. BTRFS is a
	  next-generation Linux file system based on the copy-on-write
	  principle.
```

## release/src-rt-5.04behnd.4916/bootloaders/u-boot-2024.04/fs/cbfs/Kconfig
```kconfig
config FS_CBFS
	bool "Enable CBFS (Coreboot Filesystem)"
	help
	  Define this to enable support for reading from a Coreboot
	  filesystem. This is a ROM-based filesystem used for accessing files
	  on systems that use coreboot as the first boot-loader and then load
	  U-Boot to actually boot the Operating System. You can also enable
	  CMD_CBFS to get command-line access.

config SPL_FS_CBFS
	bool "Enable CBFS (Coreboot Filesystem) in SPL"
	depends on SPL
	help
	  Define this to enable support for reading from a Coreboot
	  filesystem. This is a ROM-based filesystem used for accessing files
	  on systems that use coreboot as the first boot-loader and then load
	  U-Boot to actually boot the Operating System.

	  Note that most functions in the CBFS API do not work with SPL. Only
	  those which accept a cbfs_priv * can be used, since BSS is not
	  available.
```

## release/src-rt-5.04behnd.4916/bootloaders/u-boot-2024.04/fs/erofs/Kconfig
```kconfig
config FS_EROFS
	bool "Enable EROFS filesystem support"
	help
	  This provides support for reading images from EROFS filesystem.
	  EROFS (Enhanced Read-Only File System) is a lightweight read-only
	  file system for scenarios which need high-performance read-only
	  requirements.

	  It also provides fixed-sized output compression support, which
	  improves storage density, keeps relatively higher compression
	  ratios, which is more useful to achieve high performance for
	  embedded devices with limited memory.

config FS_EROFS_ZIP
	bool "EROFS Data Compression Support"
	depends on FS_EROFS
	select LZ4
	default y
	help
	  Enable fixed-sized output compression for EROFS.
	  If you don't want to enable compression feature, say N.
```

## release/src-rt-5.04behnd.4916/bootloaders/u-boot-2024.04/fs/jffs2/Kconfig
```kconfig
config FS_JFFS2
	bool "Enable JFFS2 filesystem support"
	help
	  This provides support for reading images from JFFS2 (Journalling
	  Flash File System version 2). JFFS2 is a log-structured file system
	  for use with flash memory devices. It supports raw NAND devices,
	  hard links and compression.

config JFFS2_LZO
	bool "Enable LZO compression in JFFS2"
	depends on FS_JFFS2
	help
	  Enable LZO compression in the JFFS2 filesystem

config JFFS2_NAND
	bool "Enable JFFS2 support for NAND flash"
	depends on FS_JFFS2
	help
	  Enable support for NAND flash as the backing store for JFFS2.

config SYS_JFFS2_SORT_FRAGMENTS
	bool "Enable JFFS2 sorting of filesystem fragments (SLOW!)"
	depends on FS_JFFS2
	help
	  If you boot from a partition which is mounted writable, and you
	  update your boot environment by replacing single files on that
	  partition, you should also define CONFIG_SYS_JFFS2_SORT_FRAGMENTS.
	  Scanning the JFFS2 filesystem takes *much* longer with this feature,
	  though.  Sorting is done while inserting into the fragment list,
	  which is more or less a bubble sort. That algorithm is known to be
	  O(n^2), thus you should really consider if you can avoid it!
```

## release/src-rt-5.04behnd.4916/bootloaders/u-boot-2024.04/fs/squashfs/Kconfig
```kconfig
config FS_SQUASHFS
	bool "Enable SquashFS filesystem support"
	select ZLIB_UNCOMPRESS
	help
	  This provides support for reading images from SquashFS filesystem.
	  Squashfs is a compressed read-only filesystem for Linux.
	  It uses zlib, lz4, lzo, or xz compression to compress files, inodes
	  and directories. Squashfs is intended for general read-only
	  filesystem use, for archival use (i.e. in cases where a .tar.gz file
	  may be used), and in constrained block device/memory systems (e.g.
	  embedded systems) where low overhead is needed.
```

## release/src-rt-5.04behnd.4916/bootloaders/u-boot-2024.04/fs/ubifs/Kconfig
```kconfig
config UBIFS_SILENCE_MSG
	bool "UBIFS silence verbose messages"
	default ENV_IS_IN_UBI
	help
	  Make the verbose messages from UBIFS stop printing. This leaves
	  warnings and errors enabled.

config UBIFS_SILENCE_DEBUG_DUMP
	bool "UBIFS silence debug dumps"
	default y if UBIFS_SILENCE_MSG
	help
	  Make the debug dumps from UBIFS stop printing.
	  This decreases size of U-Boot binary.
```

## release/src-rt-5.04behnd.4916/bootloaders/u-boot-2024.04/fs/yaffs2/Kconfig
```kconfig
config YAFFS_DIRECT
	bool

config YAFFS_PROVIDE_DEFS
	bool

config YAFFSFS_PROVIDE_VALUES
	bool

config YAFFS2
	bool "YAFFS2 filesystem support"
	select YAFFS_DIRECT
	select YAFFS_PROVIDE_DEFS
	select YAFFSFS_PROVIDE_VALUES
	help
	  This provides access to YAFFS2 filesystems. Yet Another Flash
	  Filesystem 2 is a filesystem designed specifically for NAND flash.
	  It incorporates bad-block management and ensures that device
	  writes are sequential regardless of filesystem activity.
```

## release/src-rt-5.04behnd.4916/bootloaders/u-boot-2024.04/lib/crypt/Kconfig
```kconfig
menuconfig CRYPT_PW
	bool "Add crypt support for password-based unlock"
	depends on AUTOBOOT_KEYED && AUTOBOOT_ENCRYPTION
	help
	  Enable support for crypt-style hashed passphrases.
	  This will then be used as the mechanism of choice to
	  verify whether the entered password to unlock the
	  console is correct or not.

if CRYPT_PW

config CRYPT_PW_SHA256
	bool "Provide sha256crypt"
	select SHA256
	help
	  Enables support for the sha256crypt password-hashing algorithm.
	  The prefix is "$5$".

config CRYPT_PW_SHA512
	bool "Provide sha512crypt"
	select SHA512
	help
	  Enables support for the sha512crypt password-hashing algorithm.
	  The prefix is "$6$".

endif
```

## release/src-rt-5.04behnd.4916/bootloaders/u-boot-2024.04/lib/crypto/Kconfig
```kconfig
menuconfig ASYMMETRIC_KEY_TYPE
	bool "Asymmetric (public-key cryptographic) key Support"
	depends on FIT_SIGNATURE
	help
	  This option provides support for a key type that holds the data for
	  the asymmetric keys used for public key cryptographic operations such
	  as encryption, decryption, signature generation and signature
	  verification.

if ASYMMETRIC_KEY_TYPE

config SPL_ASYMMETRIC_KEY_TYPE
	bool "Asymmetric (public-key cryptographic) key Support within SPL"
	depends on SPL
	help
	  This option provides support for a key type that holds the data for
	  the asymmetric keys used for public key cryptographic operations such
	  as encryption, decryption, signature generation and signature
	  verification in the SPL.

config ASYMMETRIC_PUBLIC_KEY_SUBTYPE
	bool "Asymmetric public-key crypto algorithm subtype"
	help
	  This option provides support for asymmetric public key type handling.
	  If signature generation and/or verification are to be used,
	  appropriate hash algorithms (such as SHA-1) must be available.
	  ENOPKG will be reported if the requisite algorithm is unavailable.

config SPL_ASYMMETRIC_PUBLIC_KEY_SUBTYPE
	bool "Asymmetric public-key crypto algorithm subtype within SPL"
	depends on ASYMMETRIC_PUBLIC_KEY_SUBTYPE && SPL
	help
	  This option provides support for asymmetric public key type handling in the SPL.
	  If signature generation and/or verification are to be used,
	  appropriate hash algorithms (such as SHA-1) must be available.
	  ENOPKG will be reported if the requisite algorithm is unavailable.

config RSA_PUBLIC_KEY_PARSER
	bool "RSA public key parser"
	depends on ASYMMETRIC_PUBLIC_KEY_SUBTYPE
	select ASN1_DECODER
	select ASN1_COMPILER
	select OID_REGISTRY
	help
	  This option provides support for parsing a blob containing RSA
	  public key data and provides the ability to instantiate a public
	  key.

config SPL_RSA_PUBLIC_KEY_PARSER
	bool "RSA public key parser within SPL"
	depends on ASYMMETRIC_PUBLIC_KEY_SUBTYPE && SPL
	select SPL_ASN1_DECODER
	select ASN1_COMPILER
	select SPL_OID_REGISTRY
	help
	  This option provides support for parsing a blob containing RSA
	  public key data and provides the ability to instantiate a public
	  key in the SPL.

config X509_CERTIFICATE_PARSER
	bool "X.509 certificate parser"
	depends on ASYMMETRIC_PUBLIC_KEY_SUBTYPE
	select ASN1_DECODER
	select ASN1_COMPILER
	select OID_REGISTRY
	select LIB_DATE
	help
	  This option provides support for parsing X.509 format blobs for key
	  data and provides the ability to instantiate a crypto key from a
	  public key packet found inside the certificate.

config PKCS7_MESSAGE_PARSER
	bool "PKCS#7 message parser"
	depends on X509_CERTIFICATE_PARSER
	select ASN1_DECODER
	select ASN1_COMPILER
	select OID_REGISTRY
	help
	  This option provides support for parsing PKCS#7 format messages for
	  signature data and provides the ability to verify the signature.

config PKCS7_VERIFY
	bool

config MSCODE_PARSER
	bool "MS authenticode parser"
	select ASN1_DECODER
	select ASN1_COMPILER
	select OID_REGISTRY
	help
	  This option provides support for parsing MicroSoft's Authenticode
	  in pkcs7 message.

endif # ASYMMETRIC_KEY_TYPE
```

## release/src-rt-5.04behnd.4916/bootloaders/u-boot-2024.04/lib/ecdsa/Kconfig
```kconfig
config ECDSA
	bool "Enable ECDSA support"
	depends on DM
	help
	  This enables the ECDSA (elliptic curve signature) algorithm for FIT
	  image verification in U-Boot. The ECDSA algorithm is implemented
	  using the driver model, so CONFIG_DM is required by this library.
	  See doc/uImage.FIT/signature.txt for more details.
	  ECDSA is enabled for mkimage regardless of this option.

if ECDSA

config ECDSA_VERIFY
	bool "Enable ECDSA verification support in U-Boot."
	help
	  Allow ECDSA signatures to be recognized and verified in U-Boot.

config SPL_ECDSA_VERIFY
	bool "Enable ECDSA verification support in SPL"
	depends on SPL
	help
	  Allow ECDSA signatures to be recognized and verified in SPL.

endif
```
