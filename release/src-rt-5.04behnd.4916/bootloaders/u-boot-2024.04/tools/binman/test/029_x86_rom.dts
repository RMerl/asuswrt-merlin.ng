/dts-v1/;

/ {
	#address-cells = <1>;
	#size-cells = <1>;

	binman {
		sort-by-offset;
		end-at-4gb;
		size = <36>;
		u-boot {
			offset = <0xffffffdc>;
		};

		u-boot-spl {
			offset = <0xffffffe3>;
		};
	};
};
