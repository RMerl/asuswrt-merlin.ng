// SPDX-License-Identifier: GPL-2.0+

/dts-v1/;

/ {
	#address-cells = <1>;
	#size-cells = <1>;

	binman {
		cbfs {
			size = <0xb0>;
			u-boot {
				cbfs-type = "raw";
				cbfs-compress = "invalid-algo";
			};
		};
	};
};
