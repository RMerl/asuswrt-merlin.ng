// SPDX-License-Identifier: GPL-2.0+
/*
 * Copyright 2018 NXP
 */

/dts-v1/;

/ {
	#address-cells = <1>;
	#size-cells = <1>;

	binman {
		section {
			skip-at-start = <16>;
			u-boot {
				pad-before = <8>;
				pad-after = <4>;
			};
		};
	};
};
