// SPDX-License-Identifier: GPL-2.0+

/dts-v1/;

/ {
	#address-cells = <1>;
	#size-cells = <1>;

	binman {
		pre-load {
			content = <&image>;
			 algo-name = "sha2560,rsa2048";
			 padding-name = "pkcs-1.5";
			 key-name = "dev.key";
			 header-size = <4096>;
			 version = <1>;
		};

		image: blob-ext {
			filename = "refcode.bin";
		};
	};
};
