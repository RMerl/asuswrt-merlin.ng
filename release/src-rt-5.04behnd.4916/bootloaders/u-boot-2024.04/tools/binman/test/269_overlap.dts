// SPDX-License-Identifier: GPL-2.0+

/dts-v1/;

/ {
	#address-cells = <1>;
	#size-cells = <1>;

	binman {
		u-boot {
		};

		inset {
			type = "fill";
			fill-byte = [61];
			offset = <1>;
			size = <2>;
			overlap;
		};
	};
};
