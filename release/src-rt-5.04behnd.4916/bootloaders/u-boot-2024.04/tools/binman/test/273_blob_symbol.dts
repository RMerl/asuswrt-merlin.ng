// SPDX-License-Identifier: GPL-2.0+

/dts-v1/;

/ {
	#address-cells = <1>;
	#size-cells = <1>;

	binman {
		blob {
			filename = "blob_syms.bin";
			write-symbols;
			elf-filename = "blob_syms";
			elf-base-sym = "__my_start_sym";
		};

		inset {
			type = "null";
			offset = <4>;
			size = <8>;
			overlap;
		};
	};
};
