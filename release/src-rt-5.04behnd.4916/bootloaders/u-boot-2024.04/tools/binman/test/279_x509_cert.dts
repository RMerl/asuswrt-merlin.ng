// SPDX-License-Identifier: GPL-2.0+

/dts-v1/;

/ {
	#address-cells = <1>;
	#size-cells = <1>;

	binman {
		x509-cert {
			cert-ca = "IOT2050 Firmware Signature";
			cert-revision-int = <0>;
			content = <&u_boot>;
		};

		u_boot: u-boot {
		};
	};
};
