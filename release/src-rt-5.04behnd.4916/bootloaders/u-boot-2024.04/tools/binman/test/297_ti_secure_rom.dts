// SPDX-License-Identifier: GPL-2.0+

/dts-v1/;

/ {
	#address-cells = <1>;
	#size-cells = <1>;

	binman {
		ti-secure-rom {
			content = <&unsecure_binary>;
			core-opts = <2>;
		};
		unsecure_binary: blob-ext {
			filename = "ti_unsecure.bin";
		};
	};
};
