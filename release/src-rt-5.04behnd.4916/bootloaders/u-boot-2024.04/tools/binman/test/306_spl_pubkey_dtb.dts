// SPDX-License-Identifier: GPL-2.0+

/dts-v1/;

/ {
	#address-cells = <1>;
	#size-cells = <1>;

	binman {
		u-boot-spl-pubkey-dtb {
			algo = "sha384,rsa4096";
			required = "conf";
			key-name-hint = "key";
		};
	};
};
