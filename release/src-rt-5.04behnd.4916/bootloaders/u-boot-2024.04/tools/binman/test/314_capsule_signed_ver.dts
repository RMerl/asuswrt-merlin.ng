// SPDX-License-Identifier: GPL-2.0+

/dts-v1/;

/ {
	binman {
		efi-capsule {
			image-index = <0x1>;
			fw-version = <0x2>;
			/* Image GUID for testing capsule update */
			image-guid = "binman-test";
			hardware-instance = <0x0>;
			private-key = "key.key";
			public-key-cert = "key.crt";

			blob {
				filename = "capsule_input.bin";
			};
		};
	};
};
