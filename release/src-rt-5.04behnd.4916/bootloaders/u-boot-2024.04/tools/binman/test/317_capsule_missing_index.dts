// SPDX-License-Identifier: GPL-2.0+

/dts-v1/;

/ {
	binman {
		efi-capsule {
			/* Image GUID for testing capsule update */
			image-guid = "binman-test";
			hardware-instance = <0x0>;

			blob {
				filename = "capsule_input.bin";
			};
		};
	};
};
