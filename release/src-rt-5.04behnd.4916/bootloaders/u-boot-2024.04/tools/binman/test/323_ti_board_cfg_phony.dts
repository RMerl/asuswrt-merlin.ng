// SPDX-License-Identifier: GPL-2.0+
/dts-v1/;

/ {
	#address-cells = <1>;
	#size-cells = <1>;

	binman {
		ti-board-config {
			config = "yaml/config_phony.yaml";
			schema = "yaml/schema.yaml";
		};
	};
};
