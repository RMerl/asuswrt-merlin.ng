## release/src-rt-5.04behnd.4916/bootloaders/u-boot-2024.04/tools/buildman/test/Kconfig
```kconfig
# Board properties
config SYS_ARCH
	string

config SYS_CPU
	string

config SYS_SOC
	string

config SYS_VENDOR
	string

config SYS_BOARD
	string

config SYS_CONFIG_NAME
	string


# Available targets
config TARGET_BOARD0
	bool "board 9"

config TARGET_BOARD2
	bool "board 2"


# Settings for each board
if TARGET_BOARD0

config SYS_ARCH
	default "arm"

config SYS_CPU
	default "armv7"

#config SYS_SOC
#	string

config SYS_VENDOR
	default "Tester"

config SYS_BOARD
	default "ARM Board 0"

config SYS_CONFIG_NAME
	default "config0"

endif

if TARGET_BOARD2

config SYS_ARCH
	default "powerpc"

config SYS_CPU
	default "ppc"

config SYS_SOC
	default "mpc85xx"

config SYS_VENDOR
	default "Tester"

config SYS_BOARD
	default "PowerPC board 1"

config SYS_CONFIG_NAME
	default "config2"

endif
```

## release/src-rt-5.04behnd.4916/kernel/linux-4.19/Documentation/devicetree/bindings/mmc/mmc-oops.txt
```
* Mmcoops oops/panic logger

Mmcoops is an oops/panic logger that write its logs to MMC before the system crashes.
Introduction and concept are similar to other oops logger.
(Refer to Documention/ramoops.txt)
- Disadvantage: if MMC is occurred an oops/panic, this logger can't work.

After reboot, you can get the last log with below command.
#dd if=/dev/mmcblk0 of=/tmp/dump.log skip=1536 count=512
#vi dump.log

Required Properties:

* compatible: should be "mmcoops"
* start-offset: block-offset for start.
* size: the number of block to write oopses and panics.

Example:
	mmcoops {
		compatible = "mmcoops";
		start-offset = <1536>;	/* 1536 * 512B = 768KiB offset */
		size = <512>;		/* 512 * 512B = 256KiB */
	};
```

## release/src-rt-5.04behnd.4916/kernel/linux-4.19/Kconfig.bcmconfig
```kconfig
if "$(BCM_KF)" = "y"
source "../bcmkernel/Kconfig.bcm_kf"
source "../bcmkernel/Kconfig.bcm"
endif
```

## release/src-rt-5.04behnd.4916/kernel/linux-5.15/Documentation/devicetree/bindings/soc/bcm/brcm,bcm6802.txt
```
* Broadcom 6802 driver bindings

The Broadcom 6802 driver provides access to the moca core and EPORT settings
on the 6802.  This driver controls the 6802 over a SPI link.  The device-tree
node must be a child of a SPI controller node.

Required properties:

 compatible        : should contain "brcm,bcm6802"
 reg               : SPI chip select
 hw-rev            : HW revision number (must be 0x2002 for 6802)
 enet-id           : phandle to the internal (local) ethernet port 
 rf-band           : rf band string, possible values "highrf, midrf, wanrf,
			ext_d, d_low, d_high, e, f, g"
 local-mac-address : MAC address assigned to the 6802
 interrupt-parent  : phandle of interrupt controller
 interrupts        : interrupt used by bcm6802 driver
 ethernet-ports    : node containing configuration information for the 6802's
			two RGMII ports

Optional properties:

 spi-max-frequency : SPI clock rate
 spi-cpol          : SPI clock polarity
 spi-cpha          : SPI clock phase
 chip-id           : override chip ID


The ethernet-ports node can contain the following sub-nodes:

 rgmii0            : Configuration of the 6802's RGMII0 port
 rgmii1            : Configuration of the 6802's RGMII0 port

These two rgmii nodes can contain the following properties:

 phy-mode: See Documentation/devicetree/bindings/net/ethernet.txt
 fixed-link: See Documentation/devicetree/bindings/net/fixed-link.txt
 
Example:

	 ext_moca@0 {
			compatible = "brcm,bcm6802";
			reg = <0x0>;
			spi-max-frequency = <12000000>;
			spi-cpol;
			spi-cpha;
			hw-rev = <0x2002>;
			enet-id = <0x75>;
			rf-band = "ext_d";
			local-mac-address = [ 00 10 18 03 25 d7 ];
			interrupt-parent = <0x76>;
			interrupts = <0x11 0x4>;
			ethernet-ports {
				rgmii0 {
					phy-mode = "rgmii-rxid";
					fixed-link {
						speed = <1000>;
						full-duplex;
					}
				}

				rgmii1 {
				}
			}
	 };
```

## release/src-rt-5.04behnd.4916/kernel/linux-5.15/Kconfig.asus
```kconfig
menu "ASUSWRT"

choice
	prompt "Choose Product"
	depends on ATM
	help
	   Choose product

config DSLAX82U
	bool "DSLAX82U"
	default n

endchoice

endmenu # "ASUSWRT"
```

## release/src-rt-5.04behnd.4916/router-sysdep.gt-be98_pro/wlan/rdk/meta-wifi/conf/layer.conf
```bitbake
require brcm-wifi-common.inc
#
# We have a conf and classes directory, add to BBPATH
BBPATH .= ":${LAYERDIR}"

# We have recipes-* directories, add to BBFILES
BBFILES += "${LAYERDIR}/recipes-*/*/*.bb \
            ${LAYERDIR}/recipes-*/*/*.bbappend \
"
BBFILE_COLLECTIONS += "wifi"
BBFILE_PATTERN_wifi = "^${LAYERDIR}/"
BBFILE_PRIORITY_wifi = "41"
LAYERVERSION_wifi = "1"

LAYERDEPENDS_wifi = "brcm-broadband"
#temporarily mask out this bbappend as it make do_fetch failure.
BBMASK += "${RDK_ROOT_PATH}/meta-cmf-broadband/recipes-ccsp/ccsp/ccsp-wifi-agent.bbappend"
```

## release/src-rt-5.04behnd.4916/router-sysdep.rt-be88u/wlan/rdk/meta-wifi/conf/layer.conf
```bitbake
require brcm-wifi-common.inc
#
# We have a conf and classes directory, add to BBPATH
BBPATH .= ":${LAYERDIR}"

# We have recipes-* directories, add to BBFILES
BBFILES += "${LAYERDIR}/recipes-*/*/*.bb \
            ${LAYERDIR}/recipes-*/*/*.bbappend \
"
BBFILE_COLLECTIONS += "wifi"
BBFILE_PATTERN_wifi = "^${LAYERDIR}/"
BBFILE_PRIORITY_wifi = "41"
LAYERVERSION_wifi = "1"

LAYERDEPENDS_wifi = "brcm-broadband"
```

## release/src/router/fltr/Kconfig
```kconfig
config NETFILTER_ASUS_FILTER
        tristate  'support ASUS network/conntrack filter'
		depends on NET && INET && NETFILTER
        help
          support ASUS network/conntrack filter.
```

## release/src/router/minidlna/buildroot/readymedia/Config.in
```kconfig
config BR2_PACKAGE_READYMEDIA
	bool "readymedia"
	depends on BR2_USE_WCHAR # flac
	depends on BR2_USE_MMU # fork
	depends on BR2_TOOLCHAIN_HAS_THREADS
	depends on BR2_PACKAGE_FFMPEG_ARCH_SUPPORTS
	select BR2_PACKAGE_FFMPEG
	select BR2_PACKAGE_FLAC
	select BR2_PACKAGE_LIBVORBIS # selects libogg
	select BR2_PACKAGE_LIBOGG
	select BR2_PACKAGE_LIBID3TAG # selects zlib
	select BR2_PACKAGE_LIBEXIF
	select BR2_PACKAGE_JPEG
	select BR2_PACKAGE_SQLITE
	help
	  MiniDLNA (aka ReadyDLNA) is server software with the aim of
	  being fully compliant with DLNA/UPnP-AV clients.

	  http://minidlna.sourceforge.net/

comment "readymedia needs a toolchain w/ threads, wchar"
	depends on BR2_USE_MMU
	depends on BR2_PACKAGE_FFMPEG_ARCH_SUPPORTS
	depends on !BR2_TOOLCHAIN_HAS_THREADS || !BR2_USE_WCHAR
```

## release/src/router/minidlna/buildroot/readymedia_defconfig
```kconfig
BR2_SHARED_STATIC_LIBS=y
BR2_TOOLCHAIN_BUILDROOT_VENDOR="readymedia"
BR2_TOOLCHAIN_BUILDROOT_MUSL=y
BR2_KERNEL_HEADERS_VERSION=y
BR2_DEFAULT_KERNEL_VERSION="2.6.32"
BR2_PACKAGE_HOST_LINUX_HEADERS_CUSTOM_REALLY_OLD=y
BR2_BINUTILS_VERSION_2_37_X=y
BR2_GCC_VERSION_11_X=y
BR2_GCC_ENABLE_LTO=y
BR2_TARGET_GENERIC_HOSTNAME="readymedia"
BR2_INIT_NONE=y
# BR2_TARGET_ENABLE_ROOT_LOGIN is not set
# BR2_TARGET_GENERIC_GETTY is not set
# BR2_TARGET_GENERIC_REMOUNT_ROOTFS_RW is not set
# BR2_PACKAGE_BUSYBOX is not set
BR2_PACKAGE_FFMPEG_ENCODERS=""
BR2_PACKAGE_FFMPEG_DECODERS="aac alac eac3 flac flv h264 mp3 mpeg2video mpeg4 pcm_s16be pcm_s16le vorbis wmalossless wmapro wmav1 wmav2"
BR2_PACKAGE_FFMPEG_MUXERS=""
BR2_PACKAGE_FFMPEG_DEMUXERS="aac ac3 aiff asf avi dts dv eac3 flac flv h261 h263 h264 matroska mjpeg mov m4v mp3 mpegps mpegts mpegtsraw mpegvideo ogg vc1 wav"
BR2_PACKAGE_FFMPEG_PARSERS="aac ac3 dvbsub dvdsub flac h261 h263 h264 mjpeg mlp mpeg4video mpegaudio mpegvideo vc1 vorbis vp3 vp8"
BR2_PACKAGE_FFMPEG_BSFS=""
BR2_PACKAGE_FFMPEG_PROTOCOLS="file"
BR2_PACKAGE_FFMPEG_FILTERS=""
# BR2_PACKAGE_FFMPEG_INDEVS is not set
# BR2_PACKAGE_FFMPEG_OUTDEVS is not set
BR2_PACKAGE_FFMPEG_EXTRACONF="--enable-small --disable-pic --disable-avfilter --disable-libvorbis --disable-network --disable-muxer=ogg"
# BR2_PACKAGE_IFUPDOWN_SCRIPTS is not set
BR2_PACKAGE_READYMEDIA=y
```

## release/src/router/sch_cake/Kconfig
```kconfig
config NET_SCH_CAKE
	tristate "Common Applications Kept Enhanced (CAKE)"
        depends on NET_SCHED
	help
	  Say Y here if you want to use the Common Applications Kept Enhanced
          (CAKE) queue management algorithm.

	  To compile this driver as a module, choose M here: the module
	  will be called sch_cake.

	  If unsure, say N.
```
