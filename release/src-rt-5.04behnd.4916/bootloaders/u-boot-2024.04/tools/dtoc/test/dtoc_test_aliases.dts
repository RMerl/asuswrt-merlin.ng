// SPDX-License-Identifier: GPL-2.0+
/*
 * Test device tree file for dtoc
 *
 * Copyright 2017 Google, Inc
 */

 /dts-v1/;

/ {
	spl-test {
		bootph-all;
		compatible = "compat1", "compat2.1-fred", "compat3";
		intval = <1>;
	};

	spl-test2 {
		bootph-all;
		compatible = "compat1", "simple_bus";
		intval = <1>;
	};
};
