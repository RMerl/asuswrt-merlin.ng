// SPDX-License-Identifier: GPL-2.0+
/*
 * Test device tree file for dtoc
 *
 * Copyright 2017 Google, Inc
 */

/dts-v1/;

/ {
	#address-cells = <1>;
	#size-cells = <1>;
	i2c@0 {
		compatible = "sandbox,i2c";
		bootph-pre-sram;
		#address-cells = <1>;
		#size-cells = <0>;
		spl-test {
			bootph-all;
			compatible = "sandbox,spl-test";
			#address-cells = <1>;
			#size-cells = <0>;
			status = "disabled";
			pmic@9 {
				compatible = "sandbox,pmic";
				bootph-all;
				reg = <9>;
				low-power;
			};
		};
	};
};
