// SPDX-License-Identifier: GPL-2.0+
/*
 * Test device tree file for dtoc
 *
 * Copyright 2018 Google, Inc
 */

/dts-v1/;

/ {
	phandle: phandle-target {
		bootph-all;
		compatible = "target";
		intval = <0>;
		#clock-cells = <0>;
	};

	phandle-source2 {
		bootph-all;
		compatible = "source";
		clocks = <&phandle>;
	};
};
