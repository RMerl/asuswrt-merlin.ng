#include "949408EAP_XPHY.dts"

&memc {
	memcfg = <(BP_DDR_SPEED_800_11_11_11 | \
				BP_DDR_TOTAL_SIZE_2048MB  | \
				BP_DDR_DEVICE_WIDTH_8     | \
				BP_DDR_TOTAL_WIDTH_32BIT  | \
				BP_DDR_SSC_CONFIG_1)>;
};
