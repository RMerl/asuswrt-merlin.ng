#include "949418EAP.dtsi"
&mdio {
    /* Port PHY mapping:
            port_xgphy <----> phy_serdes0   - phy_cascade0
            port_sgmii1 <---> phy_serdes1   - phy_cascade1
     */
	phy_cascade1 {
		reg = <0x1d>;
		enet-phy-lane-swap;
		phy-reset = <&gpioc 3 GPIO_ACTIVE_LOW>;
		status = "okay";
	};

};
