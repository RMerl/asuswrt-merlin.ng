#include "96756SV.dts"

&sdhci {
	/delete-property/ no-1-8-v;
	/delete-property/ mmc-ddr-3_3v;
	sd-uhs-sdr50;
	sd-uhs-sdr104;
	sd-uhs-ddr50;
	mmc-ddr-1_8v;
	mmc-hs200-1_8v;
	clock-frequency = <SDHCI_HS200_BASE_CLOCK_FREQ>;
	status = "okay";
};

