pincontroller-functions {
        spim_group_pins: spim_group_pinmux {
            pins = <40 41 42>;
            function = <1>;
        };

        usb0_pwr_pins: usb0_pwr_pinmux {
            pins = <66 67>;
            function = <1>;
        };

        usb1_pwr_pins: usb1_pwr_pinmux {
            pins = <68 69>;
            function = <1>;
        };

        nand_data_pins: nand_data_pinmux {
            pins = <48 49 50 51 52 53 54 55>;
            function = <1>;
        };

        nand_ctrl_pins: nand_ctrl_pinmux {
            pins = <45 46 47 56 57 58>;
            function = <1>;
        };

        emmc_ctrl_pins: emmc_ctrl_pinmux {
            pins = <60 61>;
            function = <1>;
        };

        a_eth_mdc_pin_62: a_eth_mdc_pinmux {
            pins = <62>;
            function = <1>;
        };

        a_eth_mdio_pin_63: a_eth_mdio_pinmux {
            pins = <63>;
            function = <1>;
        };

        a_i2c_2_scl_pin_8: a_i2c_2_scl_pinmux {
            pins = <8>;
            function = <3>;
        };

        a_i2c_2_sda_pin_9: a_i2c_2_sda_pinmux {
            pins = <9>;
            function = <3>;
        };

        a_i2c_scl_pin_36: a_i2c_scl_pinmux {
            pins = <36>;
            function = <3>;
        };

        a_i2c_sda_pin_37: a_i2c_sda_pinmux {
            pins = <37>;
            function = <3>;
        };

        a_i2s_rx_lrck_pin_28: a_i2s_rx_lrck_pinmux {
            pins = <28>;
            function = <3>;
        };

        a_i2s_rx_mclk_pin_27: a_i2s_rx_mclk_pinmux {
            pins = <27>;
            function = <3>;
        };

        a_i2s_rx_sclk_pin_31: a_i2s_rx_sclk_pinmux {
            pins = <31>;
            function = <3>;
        };

        a_i2s_sdata_in_pin_12: a_i2s_sdata_in_pinmux {
            pins = <12>;
            function = <3>;
        };

        a_i2s_sdata_out_pin_18: a_i2s_sdata_out_pinmux {
            pins = <18>;
            function = <3>;
        };

        a_i2s_tx_lrck_pin_38: a_i2s_tx_lrck_pinmux {
            pins = <38>;
            function = <3>;
        };

        a_i2s_tx_mclk_pin_10: a_i2s_tx_mclk_pinmux {
            pins = <10>;
            function = <3>;
        };

        a_i2s_tx_sclk_pin_39: a_i2s_tx_sclk_pinmux {
            pins = <39>;
            function = <3>;
        };

        a_pcm_clk_pin_0: a_pcm_clk_pinmux {
            pins = <0>;
            function = <3>;
        };

        a_pcm_fs_pin_20: a_pcm_fs_pinmux {
            pins = <20>;
            function = <3>;
        };

        a_pcm_sdin_pin_34: a_pcm_sdin_pinmux {
            pins = <34>;
            function = <3>;
        };

        a_pcm_sdout_pin_35: a_pcm_sdout_pinmux {
            pins = <35>;
            function = <3>;
        };

        a_per_led_00_pin_0: a_per_led_00_pinmux {
            pins = <0>;
            function = <5>;
            crossbar-output = <0>;
        };

        a_per_led_01_pin_1: a_per_led_01_pinmux {
            pins = <1>;
            function = <5>;
            crossbar-output = <1>;
        };

        a_per_led_02_pin_2: a_per_led_02_pinmux {
            pins = <2>;
            function = <5>;
            crossbar-output = <2>;
        };

        a_per_led_03_pin_3: a_per_led_03_pinmux {
            pins = <3>;
            function = <5>;
            crossbar-output = <3>;
        };

        a_per_led_04_pin_4: a_per_led_04_pinmux {
            pins = <4>;
            function = <5>;
            crossbar-output = <4>;
        };

        a_per_led_05_pin_5: a_per_led_05_pinmux {
            pins = <5>;
            function = <5>;
            crossbar-output = <5>;
        };

        a_per_led_06_pin_6: a_per_led_06_pinmux {
            pins = <6>;
            function = <5>;
            crossbar-output = <6>;
        };

        a_per_led_07_pin_7: a_per_led_07_pinmux {
            pins = <7>;
            function = <5>;
            crossbar-output = <7>;
        };

        a_per_led_08_pin_8: a_per_led_08_pinmux {
            pins = <8>;
            function = <5>;
            crossbar-output = <8>;
        };

        a_per_led_09_pin_9: a_per_led_09_pinmux {
            pins = <9>;
            function = <5>;
            crossbar-output = <9>;
        };

        a_per_led_10_pin_10: a_per_led_10_pinmux {
            pins = <10>;
            function = <5>;
            crossbar-output = <10>;
        };

        a_per_led_11_pin_11: a_per_led_11_pinmux {
            pins = <11>;
            function = <5>;
            crossbar-output = <11>;
        };

        a_per_led_12_pin_12: a_per_led_12_pinmux {
            pins = <12>;
            function = <5>;
            crossbar-output = <12>;
        };

        a_per_led_13_pin_13: a_per_led_13_pinmux {
            pins = <13>;
            function = <5>;
            crossbar-output = <13>;
        };

        a_per_led_14_pin_14: a_per_led_14_pinmux {
            pins = <14>;
            function = <5>;
            crossbar-output = <14>;
        };

        a_per_led_15_pin_15: a_per_led_15_pinmux {
            pins = <15>;
            function = <5>;
            crossbar-output = <15>;
        };

        a_per_led_16_pin_16: a_per_led_16_pinmux {
            pins = <16>;
            function = <5>;
            crossbar-output = <16>;
        };

        a_per_led_17_pin_17: a_per_led_17_pinmux {
            pins = <17>;
            function = <5>;
            crossbar-output = <17>;
        };

        a_per_led_18_pin_18: a_per_led_18_pinmux {
            pins = <18>;
            function = <5>;
            crossbar-output = <18>;
        };

        a_per_led_19_pin_19: a_per_led_19_pinmux {
            pins = <19>;
            function = <5>;
            crossbar-output = <19>;
        };

        a_per_led_20_pin_20: a_per_led_20_pinmux {
            pins = <20>;
            function = <5>;
            crossbar-output = <20>;
        };

        a_per_led_21_pin_21: a_per_led_21_pinmux {
            pins = <21>;
            function = <5>;
            crossbar-output = <21>;
        };

        a_per_led_22_pin_22: a_per_led_22_pinmux {
            pins = <22>;
            function = <5>;
            crossbar-output = <22>;
        };

        a_per_led_23_pin_23: a_per_led_23_pinmux {
            pins = <23>;
            function = <5>;
            crossbar-output = <23>;
        };

        a_per_led_24_pin_24: a_per_led_24_pinmux {
            pins = <24>;
            function = <5>;
            crossbar-output = <24>;
        };

        a_per_led_25_pin_25: a_per_led_25_pinmux {
            pins = <25>;
            function = <5>;
            crossbar-output = <25>;
        };

        a_per_led_26_pin_26: a_per_led_26_pinmux {
            pins = <26>;
            function = <5>;
            crossbar-output = <26>;
        };

        a_per_led_27_pin_27: a_per_led_27_pinmux {
            pins = <27>;
            function = <5>;
            crossbar-output = <27>;
        };

        a_per_led_28_pin_28: a_per_led_28_pinmux {
            pins = <28>;
            function = <5>;
            crossbar-output = <28>;
        };

        a_per_led_29_pin_29: a_per_led_29_pinmux {
            pins = <29>;
            function = <5>;
            crossbar-output = <29>;
        };

        a_per_led_30_pin_30: a_per_led_30_pinmux {
            pins = <30>;
            function = <5>;
            crossbar-output = <30>;
        };

        a_per_led_31_pin_31: a_per_led_31_pinmux {
            pins = <31>;
            function = <5>;
            crossbar-output = <31>;
        };

        a_ser_led_clk_pin_21: a_ser_led_clk_pinmux {
            pins = <21>;
            function = <3>;
        };

        a_ser_led_data_pin_1: a_ser_led_data_pinmux {
            pins = <1>;
            function = <3>;
        };

        a_ser_led_mask_pin_19: a_ser_led_mask_pinmux {
            pins = <19>;
            function = <3>;
        };

        a_slan_sd_rx_los_pin_4: a_slan_sd_rx_los_pinmux {
            pins = <4>;
            function = <3>;
        };

        a_spim_ss1_b_pin_15: a_spim_ss1_b_pinmux {
            pins = <15>;
            function = <2>;
        };

        a_uart1_sin_pin_32: a_uart1_sin_pinmux {
            pins = <32>;
            function = <3>;
        };

        a_uart1_sout_pin_2: a_uart1_sout_pinmux {
            pins = <2>;
            function = <3>;
        };

        a_uart2_cts_pin_14: a_uart2_cts_pinmux {
            pins = <14>;
            function = <3>;
        };

        a_uart2_rts_pin_26: a_uart2_rts_pinmux {
            pins = <26>;
            function = <3>;
        };

        a_uart2_sin_pin_11: a_uart2_sin_pinmux {
            pins = <11>;
            function = <3>;
        };

        a_uart2_sout_pin_13: a_uart2_sout_pinmux {
            pins = <13>;
            function = <3>;
        };

        a_vreg_sync_pin_44: a_vreg_sync_pinmux {
            pins = <44>;
            function = <1>;
        };

        b_i2c_2_scl_pin_15: b_i2c_2_scl_pinmux {
            pins = <15>;
            function = <1>;
        };

        b_i2c_2_sda_pin_24: b_i2c_2_sda_pinmux {
            pins = <24>;
            function = <1>;
        };

        b_i2c_scl_pin_6: b_i2c_scl_pinmux {
            pins = <6>;
            function = <2>;
        };

        b_i2c_sda_pin_7: b_i2c_sda_pinmux {
            pins = <7>;
            function = <2>;
        };

        b_per_led_00_pin_33: b_per_led_00_pinmux {
            pins = <33>;
            function = <5>;
            crossbar-output = <0>;
        };

        b_per_led_01_pin_34: b_per_led_01_pinmux {
            pins = <34>;
            function = <5>;
            crossbar-output = <1>;
        };

        b_per_led_02_pin_35: b_per_led_02_pinmux {
            pins = <35>;
            function = <5>;
            crossbar-output = <2>;
        };

        b_per_led_03_pin_36: b_per_led_03_pinmux {
            pins = <36>;
            function = <5>;
            crossbar-output = <3>;
        };

        b_per_led_04_pin_37: b_per_led_04_pinmux {
            pins = <37>;
            function = <5>;
            crossbar-output = <4>;
        };

        b_per_led_05_pin_38: b_per_led_05_pinmux {
            pins = <38>;
            function = <5>;
            crossbar-output = <5>;
        };

        b_per_led_06_pin_39: b_per_led_06_pinmux {
            pins = <39>;
            function = <5>;
            crossbar-output = <6>;
        };

        b_per_led_07_pin_40: b_per_led_07_pinmux {
            pins = <40>;
            function = <5>;
            crossbar-output = <7>;
        };

        b_per_led_08_pin_41: b_per_led_08_pinmux {
            pins = <41>;
            function = <5>;
            crossbar-output = <8>;
        };

        b_per_led_09_pin_42: b_per_led_09_pinmux {
            pins = <42>;
            function = <5>;
            crossbar-output = <9>;
        };

        b_per_led_10_pin_43: b_per_led_10_pinmux {
            pins = <43>;
            function = <5>;
            crossbar-output = <10>;
        };

        b_per_led_11_pin_44: b_per_led_11_pinmux {
            pins = <44>;
            function = <5>;
            crossbar-output = <11>;
        };

        b_per_led_12_pin_45: b_per_led_12_pinmux {
            pins = <45>;
            function = <5>;
            crossbar-output = <12>;
        };

        b_per_led_13_pin_46: b_per_led_13_pinmux {
            pins = <46>;
            function = <5>;
            crossbar-output = <13>;
        };

        b_per_led_14_pin_47: b_per_led_14_pinmux {
            pins = <47>;
            function = <5>;
            crossbar-output = <14>;
        };

        b_per_led_15_pin_48: b_per_led_15_pinmux {
            pins = <48>;
            function = <5>;
            crossbar-output = <15>;
        };

        b_per_led_16_pin_49: b_per_led_16_pinmux {
            pins = <49>;
            function = <5>;
            crossbar-output = <16>;
        };

        b_per_led_17_pin_50: b_per_led_17_pinmux {
            pins = <50>;
            function = <5>;
            crossbar-output = <17>;
        };

        b_per_led_18_pin_51: b_per_led_18_pinmux {
            pins = <51>;
            function = <5>;
            crossbar-output = <18>;
        };

        b_per_led_19_pin_52: b_per_led_19_pinmux {
            pins = <52>;
            function = <5>;
            crossbar-output = <19>;
        };

        b_per_led_20_pin_53: b_per_led_20_pinmux {
            pins = <53>;
            function = <5>;
            crossbar-output = <20>;
        };

        b_per_led_21_pin_54: b_per_led_21_pinmux {
            pins = <54>;
            function = <5>;
            crossbar-output = <21>;
        };

        b_per_led_22_pin_55: b_per_led_22_pinmux {
            pins = <55>;
            function = <5>;
            crossbar-output = <22>;
        };

        b_per_led_23_pin_56: b_per_led_23_pinmux {
            pins = <56>;
            function = <5>;
            crossbar-output = <23>;
        };

        b_per_led_24_pin_57: b_per_led_24_pinmux {
            pins = <57>;
            function = <5>;
            crossbar-output = <24>;
        };

        b_per_led_25_pin_58: b_per_led_25_pinmux {
            pins = <58>;
            function = <5>;
            crossbar-output = <25>;
        };

        b_per_led_26_pin_60: b_per_led_26_pinmux {
            pins = <60>;
            function = <5>;
            crossbar-output = <26>;
        };

        b_per_led_27_pin_61: b_per_led_27_pinmux {
            pins = <61>;
            function = <5>;
            crossbar-output = <27>;
        };

        b_per_led_28_pin_62: b_per_led_28_pinmux {
            pins = <62>;
            function = <5>;
            crossbar-output = <28>;
        };

        b_per_led_29_pin_63: b_per_led_29_pinmux {
            pins = <63>;
            function = <5>;
            crossbar-output = <29>;
        };

        b_per_led_30_pin_68: b_per_led_30_pinmux {
            pins = <68>;
            function = <5>;
            crossbar-output = <30>;
        };

        b_per_led_31_pin_69: b_per_led_31_pinmux {
            pins = <69>;
            function = <5>;
            crossbar-output = <31>;
        };

        b_ser_led_clk_pin_17: b_ser_led_clk_pinmux {
            pins = <17>;
            function = <1>;
        };

        b_ser_led_data_pin_5: b_ser_led_data_pinmux {
            pins = <5>;
            function = <1>;
        };

        b_ser_led_mask_pin_16: b_ser_led_mask_pinmux {
            pins = <16>;
            function = <1>;
        };

        b_slan_sd_rx_los_pin_68: b_slan_sd_rx_los_pinmux {
            pins = <68>;
            function = <3>;
        };

        b_spim_ss2_b_pin_20: b_spim_ss2_b_pinmux {
            pins = <20>;
            function = <2>;
        };

        b_spim_ss3_b_pin_0: b_spim_ss3_b_pinmux {
            pins = <0>;
            function = <2>;
        };

        b_spim_ss4_b_pin_35: b_spim_ss4_b_pinmux {
            pins = <35>;
            function = <2>;
        };

        b_spim_ss5_b_pin_34: b_spim_ss5_b_pinmux {
            pins = <34>;
            function = <2>;
        };

        b_vreg_sync_pin_33: b_vreg_sync_pinmux {
            pins = <33>;
            function = <1>;
        };

        b_wifi0_tx_active_pin_96: b_wifi0_tx_active_pinmux {
            pins = <96>;
            function = <3>;
        };

        b_wifi1_tx_active_pin_96: b_wifi1_tx_active_pinmux {
            pins = <96>;
            function = <0>;
        };

        c_i2c_scl_pin_62: c_i2c_scl_pinmux {
            pins = <62>;
            function = <3>;
        };

        c_i2c_sda_pin_63: c_i2c_sda_pinmux {
            pins = <63>;
            function = <3>;
        };

        c_slan_sd_rx_los_pin_40: c_slan_sd_rx_los_pinmux {
            pins = <40>;
            function = <0>;
        };

        c_wifi0_tx_active_pin_97: c_wifi0_tx_active_pinmux {
            pins = <97>;
            function = <3>;
        };

        c_wifi1_tx_active_pin_97: c_wifi1_tx_active_pinmux {
            pins = <97>;
            function = <0>;
        };

        ddr_uart_rx_pin_32: ddr_uart_rx_pinmux {
            pins = <32>;
            function = <2>;
        };

        ddr_uart_tx_pin_2: ddr_uart_tx_pinmux {
            pins = <2>;
            function = <2>;
        };

        nand_wp_b_pin_59: nand_wp_b_pinmux {
            pins = <59>;
            function = <1>;
        };

        pcie0_clkreq_b_pin_71: pcie0_clkreq_b_pinmux {
            pins = <71>;
            function = <1>;
        };

        pcie0_rst_b_pin_72: pcie0_rst_b_pinmux {
            pins = <72>;
            function = <1>;
        };

        pcie1_clkreq_b_pin_73: pcie1_clkreq_b_pinmux {
            pins = <73>;
            function = <1>;
        };

        pcie1_rst_b_pin_74: pcie1_rst_b_pinmux {
            pins = <74>;
            function = <1>;
        };

        pmc_gpi_00_pin_0: pmc_gpi_00_pinmux {
            pins = <0>;
            function = <10>;
        };

        pmc_gpi_01_pin_2: pmc_gpi_01_pinmux {
            pins = <2>;
            function = <10>;
        };

        pmc_gpi_02_pin_4: pmc_gpi_02_pinmux {
            pins = <4>;
            function = <10>;
        };

        pmc_gpi_03_pin_6: pmc_gpi_03_pinmux {
            pins = <6>;
            function = <10>;
        };

        pmc_gpi_04_pin_8: pmc_gpi_04_pinmux {
            pins = <8>;
            function = <10>;
        };

        pmc_gpi_05_pin_10: pmc_gpi_05_pinmux {
            pins = <10>;
            function = <10>;
        };

        pmc_gpi_06_pin_40: pmc_gpi_06_pinmux {
            pins = <40>;
            function = <10>;
        };

        pmc_gpi_07_pin_42: pmc_gpi_07_pinmux {
            pins = <42>;
            function = <10>;
        };

        pmc_gpo_00_pin_1: pmc_gpo_00_pinmux {
            pins = <1>;
            function = <10>;
        };

        pmc_gpo_01_pin_3: pmc_gpo_01_pinmux {
            pins = <3>;
            function = <10>;
        };

        pmc_gpo_02_pin_5: pmc_gpo_02_pinmux {
            pins = <5>;
            function = <10>;
        };

        pmc_gpo_03_pin_7: pmc_gpo_03_pinmux {
            pins = <7>;
            function = <10>;
        };

        pmc_gpo_04_pin_9: pmc_gpo_04_pinmux {
            pins = <9>;
            function = <10>;
        };

        pmc_gpo_05_pin_12: pmc_gpo_05_pinmux {
            pins = <12>;
            function = <10>;
        };

        pmc_gpo_06_pin_41: pmc_gpo_06_pinmux {
            pins = <41>;
            function = <10>;
        };

        pmc_gpo_07_pin_43: pmc_gpo_07_pinmux {
            pins = <43>;
            function = <10>;
        };

        reset_out_b_pin_70: reset_out_b_pinmux {
            pins = <70>;
            function = <1>;
        };

        spim_ss0_b_pin_43: spim_ss0_b_pinmux {
            pins = <43>;
            function = <1>;
        };

        spim_ss2_b_pin_44: spim_ss2_b_pinmux {
            pins = <44>;
            function = <2>;
        };

        spim_ss3_b_pin_16: spim_ss3_b_pinmux {
            pins = <16>;
            function = <2>;
        };

        spim_ss4_b_pin_17: spim_ss4_b_pinmux {
            pins = <17>;
            function = <2>;
        };

        spim_ss5_b_pin_23: spim_ss5_b_pinmux {
            pins = <23>;
            function = <3>;
        };

        spis_clk_pin_25: spis_clk_pinmux {
            pins = <25>;
            function = <2>;
        };

        spis_miso_pin_1: spis_miso_pinmux {
            pins = <1>;
            function = <2>;
        };

        spis_mosi_pin_19: spis_mosi_pinmux {
            pins = <19>;
            function = <2>;
        };

        spis_ss_b_pin_21: spis_ss_b_pinmux {
            pins = <21>;
            function = <2>;
        };

        sys_irq_out_b_pin_24: sys_irq_out_b_pinmux {
            pins = <24>;
            function = <3>;
        };

        tbus_clk_pin_71: tbus_clk_pinmux {
            pins = <71>;
            function = <11>;
        };

        tbus_data_0_pin_73: tbus_data_0_pinmux {
            pins = <73>;
            function = <11>;
        };

        tbus_data_1_pin_74: tbus_data_1_pinmux {
            pins = <74>;
            function = <11>;
        };

        tbus_data_2_pin_29: tbus_data_2_pinmux {
            pins = <29>;
            function = <11>;
        };

        tbus_data_3_pin_23: tbus_data_3_pinmux {
            pins = <23>;
            function = <11>;
        };

        tbus_req_pin_72: tbus_req_pinmux {
            pins = <72>;
            function = <11>;
        };

        tpiu_clk_pin_92: tpiu_clk_pinmux {
            pins = <92>;
            function = <0>;
        };

        tpiu_ctl_pin_91: tpiu_ctl_pinmux {
            pins = <91>;
            function = <0>;
        };

        tpiu_data_00_pin_75: tpiu_data_00_pinmux {
            pins = <75>;
            function = <0>;
        };

        tpiu_data_01_pin_76: tpiu_data_01_pinmux {
            pins = <76>;
            function = <0>;
        };

        tpiu_data_02_pin_77: tpiu_data_02_pinmux {
            pins = <77>;
            function = <0>;
        };

        tpiu_data_03_pin_78: tpiu_data_03_pinmux {
            pins = <78>;
            function = <0>;
        };

        tpiu_data_04_pin_79: tpiu_data_04_pinmux {
            pins = <79>;
            function = <0>;
        };

        tpiu_data_05_pin_80: tpiu_data_05_pinmux {
            pins = <80>;
            function = <0>;
        };

        tpiu_data_06_pin_81: tpiu_data_06_pinmux {
            pins = <81>;
            function = <0>;
        };

        tpiu_data_07_pin_82: tpiu_data_07_pinmux {
            pins = <82>;
            function = <0>;
        };

        tpiu_data_08_pin_83: tpiu_data_08_pinmux {
            pins = <83>;
            function = <0>;
        };

        tpiu_data_09_pin_84: tpiu_data_09_pinmux {
            pins = <84>;
            function = <0>;
        };

        tpiu_data_10_pin_85: tpiu_data_10_pinmux {
            pins = <85>;
            function = <0>;
        };

        tpiu_data_11_pin_86: tpiu_data_11_pinmux {
            pins = <86>;
            function = <0>;
        };

        tpiu_data_12_pin_87: tpiu_data_12_pinmux {
            pins = <87>;
            function = <0>;
        };

        tpiu_data_13_pin_88: tpiu_data_13_pinmux {
            pins = <88>;
            function = <0>;
        };

        tpiu_data_14_pin_89: tpiu_data_14_pinmux {
            pins = <89>;
            function = <0>;
        };

        tpiu_data_15_pin_90: tpiu_data_15_pinmux {
            pins = <90>;
            function = <0>;
        };

        tpiu_data_16_pin_50: tpiu_data_16_pinmux {
            pins = <50>;
            function = <9>;
        };

        tpiu_data_17_pin_51: tpiu_data_17_pinmux {
            pins = <51>;
            function = <9>;
        };

        tpiu_data_18_pin_52: tpiu_data_18_pinmux {
            pins = <52>;
            function = <9>;
        };

        tpiu_data_19_pin_60: tpiu_data_19_pinmux {
            pins = <60>;
            function = <9>;
        };

        tpiu_data_20_pin_61: tpiu_data_20_pinmux {
            pins = <61>;
            function = <9>;
        };

        tpiu_data_21_pin_28: tpiu_data_21_pinmux {
            pins = <28>;
            function = <9>;
        };

        tpiu_data_22_pin_29: tpiu_data_22_pinmux {
            pins = <29>;
            function = <9>;
        };

        tpiu_data_23_pin_39: tpiu_data_23_pinmux {
            pins = <39>;
            function = <9>;
        };

        tpiu_data_24_pin_31: tpiu_data_24_pinmux {
            pins = <31>;
            function = <9>;
        };

        tpiu_data_25_pin_32: tpiu_data_25_pinmux {
            pins = <32>;
            function = <9>;
        };

        tpiu_data_26_pin_33: tpiu_data_26_pinmux {
            pins = <33>;
            function = <9>;
        };

        tpiu_data_27_pin_34: tpiu_data_27_pinmux {
            pins = <34>;
            function = <9>;
        };

        tpiu_data_28_pin_35: tpiu_data_28_pinmux {
            pins = <35>;
            function = <9>;
        };

        tpiu_data_29_pin_36: tpiu_data_29_pinmux {
            pins = <36>;
            function = <9>;
        };

        tpiu_data_30_pin_37: tpiu_data_30_pinmux {
            pins = <37>;
            function = <9>;
        };

        tpiu_data_31_pin_38: tpiu_data_31_pinmux {
            pins = <38>;
            function = <9>;
        };

        trng_char_clk_pin_0: trng_char_clk_pinmux {
            pins = <0>;
            function = <11>;
        };

        trng_char_out_00_pin_3: trng_char_out_00_pinmux {
            pins = <3>;
            function = <11>;
        };

        trng_char_out_01_pin_4: trng_char_out_01_pinmux {
            pins = <4>;
            function = <11>;
        };

        trng_char_out_02_pin_5: trng_char_out_02_pinmux {
            pins = <5>;
            function = <11>;
        };

        trng_char_out_03_pin_6: trng_char_out_03_pinmux {
            pins = <6>;
            function = <11>;
        };

        trng_char_out_04_pin_1: trng_char_out_04_pinmux {
            pins = <1>;
            function = <11>;
        };

        trng_char_out_05_pin_12: trng_char_out_05_pinmux {
            pins = <12>;
            function = <11>;
        };

        trng_char_out_06_pin_20: trng_char_out_06_pinmux {
            pins = <20>;
            function = <11>;
        };

        trng_char_out_07_pin_21: trng_char_out_07_pinmux {
            pins = <21>;
            function = <11>;
        };

        trng_char_out_08_pin_15: trng_char_out_08_pinmux {
            pins = <15>;
            function = <11>;
        };

        trng_char_out_09_pin_16: trng_char_out_09_pinmux {
            pins = <16>;
            function = <11>;
        };

        trng_char_out_10_pin_17: trng_char_out_10_pinmux {
            pins = <17>;
            function = <11>;
        };

        trng_char_out_11_pin_18: trng_char_out_11_pinmux {
            pins = <18>;
            function = <11>;
        };

        trng_char_out_12_pin_19: trng_char_out_12_pinmux {
            pins = <19>;
            function = <11>;
        };

        trng_char_out_13_pin_25: trng_char_out_13_pinmux {
            pins = <25>;
            function = <11>;
        };

        trng_char_out_14_pin_27: trng_char_out_14_pinmux {
            pins = <27>;
            function = <11>;
        };

        trng_char_out_15_pin_28: trng_char_out_15_pinmux {
            pins = <28>;
            function = <11>;
        };

        trng_char_out_16_pin_31: trng_char_out_16_pinmux {
            pins = <31>;
            function = <11>;
        };

        trng_char_out_17_pin_32: trng_char_out_17_pinmux {
            pins = <32>;
            function = <11>;
        };

        trng_char_out_18_pin_45: trng_char_out_18_pinmux {
            pins = <45>;
            function = <11>;
        };

        trng_char_out_19_pin_46: trng_char_out_19_pinmux {
            pins = <46>;
            function = <11>;
        };

        trng_char_out_20_pin_47: trng_char_out_20_pinmux {
            pins = <47>;
            function = <11>;
        };

        trng_char_out_21_pin_48: trng_char_out_21_pinmux {
            pins = <48>;
            function = <11>;
        };

        trng_char_out_22_pin_49: trng_char_out_22_pinmux {
            pins = <49>;
            function = <11>;
        };

        trng_char_out_23_pin_50: trng_char_out_23_pinmux {
            pins = <50>;
            function = <11>;
        };

        trng_char_out_24_pin_51: trng_char_out_24_pinmux {
            pins = <51>;
            function = <11>;
        };

        trng_char_out_25_pin_52: trng_char_out_25_pinmux {
            pins = <52>;
            function = <11>;
        };

        trng_char_out_26_pin_53: trng_char_out_26_pinmux {
            pins = <53>;
            function = <11>;
        };

        trng_char_out_27_pin_54: trng_char_out_27_pinmux {
            pins = <54>;
            function = <11>;
        };

        trng_char_out_28_pin_55: trng_char_out_28_pinmux {
            pins = <55>;
            function = <11>;
        };

        trng_char_out_29_pin_56: trng_char_out_29_pinmux {
            pins = <56>;
            function = <11>;
        };

        trng_char_out_30_pin_57: trng_char_out_30_pinmux {
            pins = <57>;
            function = <11>;
        };

        trng_char_out_31_pin_58: trng_char_out_31_pinmux {
            pins = <58>;
            function = <11>;
        };

        uart0_sdin_pin_64: uart0_sdin_pinmux {
            pins = <64>;
            function = <1>;
        };

        uart0_sdout_pin_65: uart0_sdout_pinmux {
            pins = <65>;
            function = <1>;
        };

        usbd_vbus_present_pin_68: usbd_vbus_present_pinmux {
            pins = <68>;
            function = <2>;
        };

        wifi0_c0_femctrl_0_pin_75: wifi0_c0_femctrl_0_pinmux {
            pins = <75>;
            function = <1>;
        };

        wifi0_c0_femctrl_1_pin_76: wifi0_c0_femctrl_1_pinmux {
            pins = <76>;
            function = <1>;
        };

        wifi0_c0_femctrl_2_pin_77: wifi0_c0_femctrl_2_pinmux {
            pins = <77>;
            function = <1>;
        };

        wifi0_c0_femctrl_3_pin_78: wifi0_c0_femctrl_3_pinmux {
            pins = <78>;
            function = <1>;
        };

        wifi0_c1_femctrl_0_pin_81: wifi0_c1_femctrl_0_pinmux {
            pins = <81>;
            function = <1>;
        };

        wifi0_c1_femctrl_1_pin_82: wifi0_c1_femctrl_1_pinmux {
            pins = <82>;
            function = <1>;
        };

        wifi0_c1_femctrl_2_pin_83: wifi0_c1_femctrl_2_pinmux {
            pins = <83>;
            function = <1>;
        };

        wifi0_c1_femctrl_3_pin_84: wifi0_c1_femctrl_3_pinmux {
            pins = <84>;
            function = <1>;
        };

        wifi0_femctrl_en_pin_80: wifi0_femctrl_en_pinmux {
            pins = <80>;
            function = <1>;
        };

        wifi0_gci_gpio_0_pin_22: wifi0_gci_gpio_0_pinmux {
            pins = <22>;
            function = <7>;
        };

        wifi0_gci_gpio_1_pin_30: wifi0_gci_gpio_1_pinmux {
            pins = <30>;
            function = <7>;
        };

        wifi0_gci_gpio_2_pin_29: wifi0_gci_gpio_2_pinmux {
            pins = <29>;
            function = <6>;
        };

        wifi0_gci_gpio_3_pin_23: wifi0_gci_gpio_3_pinmux {
            pins = <23>;
            function = <6>;
        };

        wifi0_gci_gpio_4_pin_33: wifi0_gci_gpio_4_pinmux {
            pins = <33>;
            function = <6>;
        };

        wifi0_gpio_0_pin_0: wifi0_gpio_0_pinmux {
            pins = <0>;
            function = <6>;
        };

        wifi0_gpio_1_pin_1: wifi0_gpio_1_pinmux {
            pins = <1>;
            function = <6>;
        };

        wifi0_gpio_10_pin_31: wifi0_gpio_10_pinmux {
            pins = <31>;
            function = <6>;
        };

        wifi0_gpio_11_pin_44: wifi0_gpio_11_pinmux {
            pins = <44>;
            function = <6>;
        };

        wifi0_gpio_12_pin_66: wifi0_gpio_12_pinmux {
            pins = <66>;
            function = <6>;
        };

        wifi0_gpio_13_pin_67: wifi0_gpio_13_pinmux {
            pins = <67>;
            function = <6>;
        };

        wifi0_gpio_14_pin_68: wifi0_gpio_14_pinmux {
            pins = <68>;
            function = <6>;
        };

        wifi0_gpio_15_pin_69: wifi0_gpio_15_pinmux {
            pins = <69>;
            function = <6>;
        };

        wifi0_gpio_16_pin_7: wifi0_gpio_16_pinmux {
            pins = <7>;
            function = <6>;
        };

        wifi0_gpio_17_pin_8: wifi0_gpio_17_pinmux {
            pins = <8>;
            function = <6>;
        };

        wifi0_gpio_2_pin_2: wifi0_gpio_2_pinmux {
            pins = <2>;
            function = <6>;
        };

        wifi0_gpio_3_pin_3: wifi0_gpio_3_pinmux {
            pins = <3>;
            function = <6>;
        };

        wifi0_gpio_4_pin_4: wifi0_gpio_4_pinmux {
            pins = <4>;
            function = <6>;
        };

        wifi0_gpio_5_pin_5: wifi0_gpio_5_pinmux {
            pins = <5>;
            function = <6>;
        };

        wifi0_gpio_6_pin_6: wifi0_gpio_6_pinmux {
            pins = <6>;
            function = <6>;
        };

        wifi0_gpio_7_pin_21: wifi0_gpio_7_pinmux {
            pins = <21>;
            function = <6>;
        };

        wifi0_gpio_8_pin_51: wifi0_gpio_8_pinmux {
            pins = <51>;
            function = <6>;
        };

        wifi0_gpio_9_pin_52: wifi0_gpio_9_pinmux {
            pins = <52>;
            function = <6>;
        };

        wifi0_jtag_en_pin_79: wifi0_jtag_en_pinmux {
            pins = <79>;
            function = <1>;
        };

        wifi0_scl_pin_38: wifi0_scl_pinmux {
            pins = <38>;
            function = <6>;
        };

        wifi0_sda_pin_39: wifi0_sda_pinmux {
            pins = <39>;
            function = <6>;
        };

        wifi0_seci_in_pin_22: wifi0_seci_in_pinmux {
            pins = <22>;
            function = <6>;
        };

        wifi0_seci_out_pin_30: wifi0_seci_out_pinmux {
            pins = <30>;
            function = <6>;
        };

        wifi0_tbus_clk_pin_85: wifi0_tbus_clk_pinmux {
            pins = <85>;
            function = <11>;
        };

        wifi0_tbus_data_0_pin_87: wifi0_tbus_data_0_pinmux {
            pins = <87>;
            function = <11>;
        };

        wifi0_tbus_data_1_pin_88: wifi0_tbus_data_1_pinmux {
            pins = <88>;
            function = <11>;
        };

        wifi0_tbus_data_2_pin_89: wifi0_tbus_data_2_pinmux {
            pins = <89>;
            function = <11>;
        };

        wifi0_tbus_data_3_pin_90: wifi0_tbus_data_3_pinmux {
            pins = <90>;
            function = <11>;
        };

        wifi0_tbus_req_pin_86: wifi0_tbus_req_pinmux {
            pins = <86>;
            function = <11>;
        };

        wifi0_tx_active_pin_95: wifi0_tx_active_pinmux {
            pins = <95>;
            function = <3>;
        };

        wifi1_blanking_5g_pin_96: wifi1_blanking_5g_pinmux {
            pins = <96>;
            function = <2>;
        };

        wifi1_blanking_6g_pin_97: wifi1_blanking_6g_pinmux {
            pins = <97>;
            function = <2>;
        };

        wifi1_c0_femctrl_0_pin_85: wifi1_c0_femctrl_0_pinmux {
            pins = <85>;
            function = <1>;
        };

        wifi1_c0_femctrl_1_pin_86: wifi1_c0_femctrl_1_pinmux {
            pins = <86>;
            function = <1>;
        };

        wifi1_c0_femctrl_2_pin_87: wifi1_c0_femctrl_2_pinmux {
            pins = <87>;
            function = <1>;
        };

        wifi1_c0_femctrl_3_pin_88: wifi1_c0_femctrl_3_pinmux {
            pins = <88>;
            function = <1>;
        };

        wifi1_c1_femctrl_0_pin_91: wifi1_c1_femctrl_0_pinmux {
            pins = <91>;
            function = <1>;
        };

        wifi1_c1_femctrl_1_pin_92: wifi1_c1_femctrl_1_pinmux {
            pins = <92>;
            function = <1>;
        };

        wifi1_c1_femctrl_2_pin_93: wifi1_c1_femctrl_2_pinmux {
            pins = <93>;
            function = <1>;
        };

        wifi1_c1_femctrl_3_pin_94: wifi1_c1_femctrl_3_pinmux {
            pins = <94>;
            function = <1>;
        };

        wifi1_femctrl_en_pin_90: wifi1_femctrl_en_pinmux {
            pins = <90>;
            function = <1>;
        };

        wifi1_gci_gpio_0_pin_22: wifi1_gci_gpio_0_pinmux {
            pins = <22>;
            function = <0>;
        };

        wifi1_gci_gpio_1_pin_30: wifi1_gci_gpio_1_pinmux {
            pins = <30>;
            function = <1>;
        };

        wifi1_gci_gpio_2_pin_29: wifi1_gci_gpio_2_pinmux {
            pins = <29>;
            function = <0>;
        };

        wifi1_gci_gpio_3_pin_23: wifi1_gci_gpio_3_pinmux {
            pins = <23>;
            function = <0>;
        };

        wifi1_gci_gpio_4_pin_33: wifi1_gci_gpio_4_pinmux {
            pins = <33>;
            function = <0>;
        };

        wifi1_gpio_0_pin_48: wifi1_gpio_0_pinmux {
            pins = <48>;
            function = <6>;
        };

        wifi1_gpio_1_pin_12: wifi1_gpio_1_pinmux {
            pins = <12>;
            function = <6>;
        };

        wifi1_gpio_10_pin_32: wifi1_gpio_10_pinmux {
            pins = <32>;
            function = <6>;
        };

        wifi1_gpio_11_pin_53: wifi1_gpio_11_pinmux {
            pins = <53>;
            function = <6>;
        };

        wifi1_gpio_12_pin_35: wifi1_gpio_12_pinmux {
            pins = <35>;
            function = <6>;
        };

        wifi1_gpio_13_pin_37: wifi1_gpio_13_pinmux {
            pins = <37>;
            function = <6>;
        };

        wifi1_gpio_14_pin_60: wifi1_gpio_14_pinmux {
            pins = <60>;
            function = <6>;
        };

        wifi1_gpio_15_pin_61: wifi1_gpio_15_pinmux {
            pins = <61>;
            function = <6>;
        };

        wifi1_gpio_16_pin_9: wifi1_gpio_16_pinmux {
            pins = <9>;
            function = <6>;
        };

        wifi1_gpio_17_pin_10: wifi1_gpio_17_pinmux {
            pins = <10>;
            function = <6>;
        };

        wifi1_gpio_2_pin_49: wifi1_gpio_2_pinmux {
            pins = <49>;
            function = <6>;
        };

        wifi1_gpio_3_pin_50: wifi1_gpio_3_pinmux {
            pins = <50>;
            function = <6>;
        };

        wifi1_gpio_4_pin_15: wifi1_gpio_4_pinmux {
            pins = <15>;
            function = <6>;
        };

        wifi1_gpio_5_pin_36: wifi1_gpio_5_pinmux {
            pins = <36>;
            function = <6>;
        };

        wifi1_gpio_6_pin_34: wifi1_gpio_6_pinmux {
            pins = <34>;
            function = <6>;
        };

        wifi1_gpio_7_pin_18: wifi1_gpio_7_pinmux {
            pins = <18>;
            function = <6>;
        };

        wifi1_gpio_8_pin_19: wifi1_gpio_8_pinmux {
            pins = <19>;
            function = <6>;
        };

        wifi1_gpio_9_pin_20: wifi1_gpio_9_pinmux {
            pins = <20>;
            function = <6>;
        };

        wifi1_jtag_en_pin_89: wifi1_jtag_en_pinmux {
            pins = <89>;
            function = <1>;
        };

        wifi1_scl_pin_27: wifi1_scl_pinmux {
            pins = <27>;
            function = <6>;
        };

        wifi1_sda_pin_28: wifi1_sda_pinmux {
            pins = <28>;
            function = <6>;
        };

        wifi1_seci_in_pin_22: wifi1_seci_in_pinmux {
            pins = <22>;
            function = <1>;
        };

        wifi1_seci_out_pin_30: wifi1_seci_out_pinmux {
            pins = <30>;
            function = <0>;
        };

        wifi1_tbus_clk_pin_75: wifi1_tbus_clk_pinmux {
            pins = <75>;
            function = <11>;
        };

        wifi1_tbus_data_0_pin_77: wifi1_tbus_data_0_pinmux {
            pins = <77>;
            function = <11>;
        };

        wifi1_tbus_data_1_pin_78: wifi1_tbus_data_1_pinmux {
            pins = <78>;
            function = <11>;
        };

        wifi1_tbus_data_2_pin_79: wifi1_tbus_data_2_pinmux {
            pins = <79>;
            function = <11>;
        };

        wifi1_tbus_data_3_pin_80: wifi1_tbus_data_3_pinmux {
            pins = <80>;
            function = <11>;
        };

        wifi1_tbus_req_pin_76: wifi1_tbus_req_pinmux {
            pins = <76>;
            function = <11>;
        };

        wifi1_tx_active_pin_95: wifi1_tx_active_pinmux {
            pins = <95>;
            function = <0>;
        };

};
