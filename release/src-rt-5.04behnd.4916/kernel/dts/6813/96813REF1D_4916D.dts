#include "96813REF1D.dts"

/* BCM94916D Daughter board with re-work for GPIO regulators */
#if defined(CONFIG_BCM_PCIE_HCD) || defined(CONFIG_BCM_PCIE_HCD_MODULE)
/**********************************************************************/
/* GPIO: Add one define per GPIO (individual or shared) regulator     */
/*       - Skip if no GPIO regulators in use                          */
/**********************************************************************/
#define PCIE0_REG_GPIO   0	/* PWR_CTRL 3V3 5G */
#define PCIE1_REG_GPIO   1	/* PWR_CTRL 3V3 6G */
#define PCIE2_REG_GPIO   3	/* PWR_CTRL 3V3 2G */

#include "../bcm_wlan_regulator.dtsi"

/**********************************************************************/
/* Shared: Add brcm,supply-names = "vreg-pcieX" for shared PCIe nodes */
/*         - Skip if not using shared GPIO regulators                 */
/**********************************************************************/

/**********************************************************************/
/* PCIe: Add status = "okay" for each PCIe slots of this boiard       */
/*       - Skip if this is a derivative board (already done in base)  */
/**********************************************************************/

#endif //#if defined(CONFIG_BCM_PCIE_HCD) || defined(CONFIG_BCM_PCIE_HCD_MODULE)

