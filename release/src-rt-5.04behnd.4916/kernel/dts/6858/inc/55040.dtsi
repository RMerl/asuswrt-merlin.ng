#include "5504X.dtsi"

/ {
	/* pcie core 0 */
	pcie0: pcie@0 {
		#define PCIE_ID				0
		#define PCIE_SPI			60
		#define PCIE_ADDR			0x80040000
		#define PCIE_SIZE			0x0000A000
		#define PCIE_RANGE_ADDR		0xC0000000
		#define PCIE_RANGE_SIZE		0x10000000
		#include "../../ip/bcm_pcie_core.dtsi" 
	};
};
