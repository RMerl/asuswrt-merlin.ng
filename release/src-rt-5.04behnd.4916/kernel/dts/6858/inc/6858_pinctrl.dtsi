pincontroller-functions {
        spim_group_pins: spim_group_pinmux {
            pins = <102 103 104>;
            function = <1>;
        };

        usb0_pwr_pins: usb0_pwr_pinmux {
            pins = <113 114>;
            function = <1>;
        };

        usb1_pwr_pins: usb1_pwr_pinmux {
            pins = <115 116>;
            function = <1>;
        };

        rgmii1_pins: rgmii1_pinmux {
            pins = <62 63 64 65 66 67 68 69 70 71 72 73>;
            function = <1>;
        };

        rgmii2_pins: rgmii2_pinmux {
            pins = <74 75 76 77 78 79 80 81 82 83 84 85>;
            function = <1>;
        };

        rgmii3_pins: rgmii3_pinmux {
            pins = <86 87 88 89 90 91 92 93 94 95 96 97>;
            function = <1>;
        };

        data_pins: data_pinmux {
            pins = <33 34 35 44 45 46 47 48>;
            function = <1>;
        };

        nand_ctrl_pins: nand_ctrl_pinmux {
            pins = <36 37 38 41 42 43>;
            function = <1>;
        };

        emmc_ctrl_pins: emmc_ctrl_pinmux {
            pins = <39 40>;
            function = <1>;
        };

        a_ext_irq_0_pin_49: a_ext_irq_0_pinmux {
            pins = <49>;
            function = <1>;
        };

        a_ext_irq_1_pin_50: a_ext_irq_1_pinmux {
            pins = <50>;
            function = <1>;
        };

        a_ext_irq_2_pin_51: a_ext_irq_2_pinmux {
            pins = <51>;
            function = <1>;
        };

        a_ext_irq_3_pin_52: a_ext_irq_3_pinmux {
            pins = <52>;
            function = <1>;
        };

        a_ext_irq_4_pin_53: a_ext_irq_4_pinmux {
            pins = <53>;
            function = <1>;
        };

        a_ext_irq_5_pin_54: a_ext_irq_5_pinmux {
            pins = <54>;
            function = <1>;
        };

        a_ext_irq_6_pin_55: a_ext_irq_6_pinmux {
            pins = <55>;
            function = <1>;
        };

        a_ext_irq_7_pin_56: a_ext_irq_7_pinmux {
            pins = <56>;
            function = <1>;
        };

        a_i2c_scl_pin_26: a_i2c_scl_pinmux {
            pins = <26>;
            function = <1>;
        };

        a_i2c_sda_pin_25: a_i2c_sda_pinmux {
            pins = <25>;
            function = <1>;
        };

        a_i2s_lrck_pin_29: a_i2s_lrck_pinmux {
            pins = <29>;
            function = <1>;
        };

        a_i2s_sclk_pin_30: a_i2s_sclk_pinmux {
            pins = <30>;
            function = <1>;
        };

        a_i2s_sdata_pin_31: a_i2s_sdata_pinmux {
            pins = <31>;
            function = <1>;
        };

        a_one_sec_pls_pin_32: a_one_sec_pls_pinmux {
            pins = <32>;
            function = <2>;
        };

        a_pcm_clk_pin_2: a_pcm_clk_pinmux {
            pins = <2>;
            function = <2>;
        };

        a_pcm_fs_pin_3: a_pcm_fs_pinmux {
            pins = <3>;
            function = <2>;
        };

        a_pcm_sdin_pin_0: a_pcm_sdin_pinmux {
            pins = <0>;
            function = <2>;
        };

        a_pcm_sdout_pin_1: a_pcm_sdout_pinmux {
            pins = <1>;
            function = <2>;
        };

        a_per_led_00_pin_0: a_per_led_00_pinmux {
            pins = <0>;
            function = <4>;
            crossbar-output = <0>;
        };

        a_per_led_01_pin_1: a_per_led_01_pinmux {
            pins = <1>;
            function = <4>;
            crossbar-output = <1>;
        };

        a_per_led_02_pin_2: a_per_led_02_pinmux {
            pins = <2>;
            function = <4>;
            crossbar-output = <2>;
        };

        a_per_led_03_pin_3: a_per_led_03_pinmux {
            pins = <3>;
            function = <4>;
            crossbar-output = <3>;
        };

        a_per_led_04_pin_4: a_per_led_04_pinmux {
            pins = <4>;
            function = <4>;
            crossbar-output = <4>;
        };

        a_per_led_05_pin_5: a_per_led_05_pinmux {
            pins = <5>;
            function = <4>;
            crossbar-output = <5>;
        };

        a_per_led_06_pin_6: a_per_led_06_pinmux {
            pins = <6>;
            function = <4>;
            crossbar-output = <6>;
        };

        a_per_led_07_pin_7: a_per_led_07_pinmux {
            pins = <7>;
            function = <4>;
            crossbar-output = <7>;
        };

        a_per_led_08_pin_8: a_per_led_08_pinmux {
            pins = <8>;
            function = <4>;
            crossbar-output = <8>;
        };

        a_per_led_09_pin_9: a_per_led_09_pinmux {
            pins = <9>;
            function = <4>;
            crossbar-output = <9>;
        };

        a_per_led_10_pin_10: a_per_led_10_pinmux {
            pins = <10>;
            function = <4>;
            crossbar-output = <10>;
        };

        a_per_led_11_pin_11: a_per_led_11_pinmux {
            pins = <11>;
            function = <4>;
            crossbar-output = <11>;
        };

        a_per_led_12_pin_12: a_per_led_12_pinmux {
            pins = <12>;
            function = <4>;
            crossbar-output = <12>;
        };

        a_per_led_13_pin_13: a_per_led_13_pinmux {
            pins = <13>;
            function = <4>;
            crossbar-output = <13>;
        };

        a_per_led_14_pin_14: a_per_led_14_pinmux {
            pins = <14>;
            function = <4>;
            crossbar-output = <14>;
        };

        a_per_led_15_pin_15: a_per_led_15_pinmux {
            pins = <15>;
            function = <4>;
            crossbar-output = <15>;
        };

        a_per_led_16_pin_16: a_per_led_16_pinmux {
            pins = <16>;
            function = <4>;
            crossbar-output = <16>;
        };

        a_per_led_17_pin_17: a_per_led_17_pinmux {
            pins = <17>;
            function = <4>;
            crossbar-output = <17>;
        };

        a_per_led_18_pin_18: a_per_led_18_pinmux {
            pins = <18>;
            function = <4>;
            crossbar-output = <18>;
        };

        a_per_led_19_pin_19: a_per_led_19_pinmux {
            pins = <19>;
            function = <4>;
            crossbar-output = <19>;
        };

        a_per_led_20_pin_20: a_per_led_20_pinmux {
            pins = <20>;
            function = <4>;
            crossbar-output = <20>;
        };

        a_per_led_21_pin_21: a_per_led_21_pinmux {
            pins = <21>;
            function = <4>;
            crossbar-output = <21>;
        };

        a_per_led_22_pin_22: a_per_led_22_pinmux {
            pins = <22>;
            function = <4>;
            crossbar-output = <22>;
        };

        a_per_led_23_pin_23: a_per_led_23_pinmux {
            pins = <23>;
            function = <4>;
            crossbar-output = <23>;
        };

        a_per_led_24_pin_28: a_per_led_24_pinmux {
            pins = <28>;
            function = <4>;
            crossbar-output = <24>;
        };

        a_per_led_25_pin_29: a_per_led_25_pinmux {
            pins = <29>;
            function = <4>;
            crossbar-output = <25>;
        };

        a_per_led_26_pin_30: a_per_led_26_pinmux {
            pins = <30>;
            function = <4>;
            crossbar-output = <26>;
        };

        a_per_led_27_pin_31: a_per_led_27_pinmux {
            pins = <31>;
            function = <4>;
            crossbar-output = <27>;
        };

        a_per_led_28_pin_50: a_per_led_28_pinmux {
            pins = <50>;
            function = <4>;
            crossbar-output = <28>;
        };

        a_per_led_29_pin_51: a_per_led_29_pinmux {
            pins = <51>;
            function = <4>;
            crossbar-output = <29>;
        };

        a_per_led_30_pin_52: a_per_led_30_pinmux {
            pins = <52>;
            function = <4>;
            crossbar-output = <30>;
        };

        a_per_led_31_pin_53: a_per_led_31_pinmux {
            pins = <53>;
            function = <4>;
            crossbar-output = <31>;
        };

        a_rogue_onu_in_pin_56: a_rogue_onu_in_pinmux {
            pins = <56>;
            function = <2>;
        };

        a_ser_led_clk_pin_5: a_ser_led_clk_pinmux {
            pins = <5>;
            function = <1>;
        };

        a_ser_led_data_pin_4: a_ser_led_data_pinmux {
            pins = <4>;
            function = <1>;
        };

        a_ser_led_mask_pin_6: a_ser_led_mask_pinmux {
            pins = <6>;
            function = <1>;
        };

        a_sim_clk_pin_17: a_sim_clk_pinmux {
            pins = <17>;
            function = <1>;
        };

        a_sim_dat_pin_16: a_sim_dat_pinmux {
            pins = <16>;
            function = <1>;
        };

        a_sim_presence_pin_18: a_sim_presence_pinmux {
            pins = <18>;
            function = <1>;
        };

        a_sim_rst_pin_21: a_sim_rst_pinmux {
            pins = <21>;
            function = <1>;
        };

        a_sim_vcc_en_pin_19: a_sim_vcc_en_pinmux {
            pins = <19>;
            function = <1>;
        };

        a_sim_vcc_vol_sel_pin_20: a_sim_vcc_vol_sel_pinmux {
            pins = <20>;
            function = <1>;
        };

        a_sim_vpp_en_pin_22: a_sim_vpp_en_pinmux {
            pins = <22>;
            function = <1>;
        };

        a_spim_ss2_b_pin_14: a_spim_ss2_b_pinmux {
            pins = <14>;
            function = <1>;
        };

        a_spim_ss3_b_pin_13: a_spim_ss3_b_pinmux {
            pins = <13>;
            function = <1>;
        };

        a_spim_ss4_b_pin_12: a_spim_ss4_b_pinmux {
            pins = <12>;
            function = <1>;
        };

        a_spim_ss5_b_pin_11: a_spim_ss5_b_pinmux {
            pins = <11>;
            function = <1>;
        };

        a_uart1_sin_pin_27: a_uart1_sin_pinmux {
            pins = <27>;
            function = <1>;
        };

        a_uart1_sout_pin_28: a_uart1_sout_pinmux {
            pins = <28>;
            function = <1>;
        };

        a_uart2_cts_pin_2: a_uart2_cts_pinmux {
            pins = <2>;
            function = <1>;
        };

        a_uart2_rts_pin_3: a_uart2_rts_pinmux {
            pins = <3>;
            function = <1>;
        };

        a_uart2_sin_pin_0: a_uart2_sin_pinmux {
            pins = <0>;
            function = <1>;
        };

        a_uart2_sout_pin_1: a_uart2_sout_pinmux {
            pins = <1>;
            function = <1>;
        };

        a_vreg_clk_pin_15: a_vreg_clk_pinmux {
            pins = <15>;
            function = <1>;
        };

        a_wan_early_txen_pin_55: a_wan_early_txen_pinmux {
            pins = <55>;
            function = <6>;
        };

        a_wan_nco_1pps_sig_pin_32: a_wan_nco_1pps_sig_pinmux {
            pins = <32>;
            function = <1>;
        };

        a_wan_nco_8k_clk_pin_57: a_wan_nco_8k_clk_pinmux {
            pins = <57>;
            function = <1>;
        };

        b_ext_irq_0_pin_13: b_ext_irq_0_pinmux {
            pins = <13>;
            function = <2>;
        };

        b_ext_irq_1_pin_14: b_ext_irq_1_pinmux {
            pins = <14>;
            function = <2>;
        };

        b_ext_irq_2_pin_15: b_ext_irq_2_pinmux {
            pins = <15>;
            function = <2>;
        };

        b_ext_irq_3_pin_4: b_ext_irq_3_pinmux {
            pins = <4>;
            function = <2>;
        };

        b_ext_irq_4_pin_5: b_ext_irq_4_pinmux {
            pins = <5>;
            function = <2>;
        };

        b_ext_irq_5_pin_6: b_ext_irq_5_pinmux {
            pins = <6>;
            function = <2>;
        };

        b_ext_irq_6_pin_25: b_ext_irq_6_pinmux {
            pins = <25>;
            function = <2>;
        };

        b_ext_irq_7_pin_26: b_ext_irq_7_pinmux {
            pins = <26>;
            function = <2>;
        };

        b_i2c_scl_pin_40: b_i2c_scl_pinmux {
            pins = <40>;
            function = <2>;
        };

        b_i2c_sda_pin_39: b_i2c_sda_pinmux {
            pins = <39>;
            function = <2>;
        };

        b_i2s_lrck_pin_61: b_i2s_lrck_pinmux {
            pins = <61>;
            function = <2>;
        };

        b_i2s_sclk_pin_60: b_i2s_sclk_pinmux {
            pins = <60>;
            function = <2>;
        };

        b_i2s_sdata_pin_59: b_i2s_sdata_pinmux {
            pins = <59>;
            function = <2>;
        };

        b_nand_ce_b_pin_39: b_nand_ce_b_pinmux {
            pins = <39>;
            function = <6>;
        };

        b_one_sec_pls_pin_11: b_one_sec_pls_pinmux {
            pins = <11>;
            function = <3>;
        };

        b_pcm_clk_pin_60: b_pcm_clk_pinmux {
            pins = <60>;
            function = <1>;
        };

        b_pcm_fs_pin_61: b_pcm_fs_pinmux {
            pins = <61>;
            function = <1>;
        };

        b_pcm_sdin_pin_58: b_pcm_sdin_pinmux {
            pins = <58>;
            function = <1>;
        };

        b_pcm_sdout_pin_59: b_pcm_sdout_pinmux {
            pins = <59>;
            function = <1>;
        };

        b_per_led_00_pin_62: b_per_led_00_pinmux {
            pins = <62>;
            function = <6>;
            crossbar-output = <0>;
        };

        b_per_led_01_pin_63: b_per_led_01_pinmux {
            pins = <63>;
            function = <6>;
            crossbar-output = <1>;
        };

        b_per_led_02_pin_64: b_per_led_02_pinmux {
            pins = <64>;
            function = <6>;
            crossbar-output = <2>;
        };

        b_per_led_03_pin_65: b_per_led_03_pinmux {
            pins = <65>;
            function = <6>;
            crossbar-output = <3>;
        };

        b_per_led_04_pin_66: b_per_led_04_pinmux {
            pins = <66>;
            function = <6>;
            crossbar-output = <4>;
        };

        b_per_led_05_pin_67: b_per_led_05_pinmux {
            pins = <67>;
            function = <6>;
            crossbar-output = <5>;
        };

        b_per_led_06_pin_68: b_per_led_06_pinmux {
            pins = <68>;
            function = <6>;
            crossbar-output = <6>;
        };

        b_per_led_07_pin_69: b_per_led_07_pinmux {
            pins = <69>;
            function = <6>;
            crossbar-output = <7>;
        };

        b_per_led_08_pin_70: b_per_led_08_pinmux {
            pins = <70>;
            function = <6>;
            crossbar-output = <8>;
        };

        b_per_led_09_pin_71: b_per_led_09_pinmux {
            pins = <71>;
            function = <6>;
            crossbar-output = <9>;
        };

        b_per_led_10_pin_72: b_per_led_10_pinmux {
            pins = <72>;
            function = <6>;
            crossbar-output = <10>;
        };

        b_per_led_11_pin_73: b_per_led_11_pinmux {
            pins = <73>;
            function = <6>;
            crossbar-output = <11>;
        };

        b_per_led_12_pin_3: b_per_led_12_pinmux {
            pins = <3>;
            function = <6>;
            crossbar-output = <12>;
        };

        b_per_led_13_pin_4: b_per_led_13_pinmux {
            pins = <4>;
            function = <6>;
            crossbar-output = <13>;
        };

        b_per_led_14_pin_5: b_per_led_14_pinmux {
            pins = <5>;
            function = <6>;
            crossbar-output = <14>;
        };

        b_per_led_15_pin_6: b_per_led_15_pinmux {
            pins = <6>;
            function = <6>;
            crossbar-output = <15>;
        };

        b_per_led_16_pin_7: b_per_led_16_pinmux {
            pins = <7>;
            function = <6>;
            crossbar-output = <16>;
        };

        b_per_led_17_pin_8: b_per_led_17_pinmux {
            pins = <8>;
            function = <6>;
            crossbar-output = <17>;
        };

        b_per_led_18_pin_9: b_per_led_18_pinmux {
            pins = <9>;
            function = <6>;
            crossbar-output = <18>;
        };

        b_per_led_19_pin_10: b_per_led_19_pinmux {
            pins = <10>;
            function = <6>;
            crossbar-output = <19>;
        };

        b_per_led_20_pin_11: b_per_led_20_pinmux {
            pins = <11>;
            function = <6>;
            crossbar-output = <20>;
        };

        b_per_led_21_pin_32: b_per_led_21_pinmux {
            pins = <32>;
            function = <6>;
            crossbar-output = <21>;
        };

        b_per_led_22_pin_29: b_per_led_22_pinmux {
            pins = <29>;
            function = <6>;
            crossbar-output = <22>;
        };

        b_per_led_23_pin_30: b_per_led_23_pinmux {
            pins = <30>;
            function = <6>;
            crossbar-output = <23>;
        };

        b_per_led_24_pin_31: b_per_led_24_pinmux {
            pins = <31>;
            function = <6>;
            crossbar-output = <24>;
        };

        b_per_led_25_pin_22: b_per_led_25_pinmux {
            pins = <22>;
            function = <6>;
            crossbar-output = <25>;
        };

        b_per_led_26_pin_23: b_per_led_26_pinmux {
            pins = <23>;
            function = <6>;
            crossbar-output = <26>;
        };

        b_per_led_27_pin_28: b_per_led_27_pinmux {
            pins = <28>;
            function = <6>;
            crossbar-output = <27>;
        };

        b_per_led_28_pin_20: b_per_led_28_pinmux {
            pins = <20>;
            function = <6>;
            crossbar-output = <28>;
        };

        b_per_led_29_pin_21: b_per_led_29_pinmux {
            pins = <21>;
            function = <6>;
            crossbar-output = <29>;
        };

        b_rogue_onu_in_pin_32: b_rogue_onu_in_pinmux {
            pins = <32>;
            function = <3>;
        };

        b_ser_led_clk_pin_30: b_ser_led_clk_pinmux {
            pins = <30>;
            function = <2>;
        };

        b_ser_led_data_pin_29: b_ser_led_data_pinmux {
            pins = <29>;
            function = <2>;
        };

        b_ser_led_mask_pin_31: b_ser_led_mask_pinmux {
            pins = <31>;
            function = <2>;
        };

        b_sim_clk_pin_91: b_sim_clk_pinmux {
            pins = <91>;
            function = <3>;
        };

        b_sim_dat_pin_90: b_sim_dat_pinmux {
            pins = <90>;
            function = <3>;
        };

        b_sim_presence_pin_92: b_sim_presence_pinmux {
            pins = <92>;
            function = <3>;
        };

        b_sim_rst_pin_88: b_sim_rst_pinmux {
            pins = <88>;
            function = <3>;
        };

        b_sim_vcc_en_pin_86: b_sim_vcc_en_pinmux {
            pins = <86>;
            function = <3>;
        };

        b_sim_vcc_vol_sel_pin_87: b_sim_vcc_vol_sel_pinmux {
            pins = <87>;
            function = <3>;
        };

        b_sim_vpp_en_pin_89: b_sim_vpp_en_pinmux {
            pins = <89>;
            function = <3>;
        };

        b_spim_ss2_b_pin_0: b_spim_ss2_b_pinmux {
            pins = <0>;
            function = <3>;
        };

        b_spim_ss3_b_pin_1: b_spim_ss3_b_pinmux {
            pins = <1>;
            function = <3>;
        };

        b_spim_ss4_b_pin_2: b_spim_ss4_b_pinmux {
            pins = <2>;
            function = <3>;
        };

        b_spim_ss5_b_pin_3: b_spim_ss5_b_pinmux {
            pins = <3>;
            function = <3>;
        };

        b_uart1_sin_pin_55: b_uart1_sin_pinmux {
            pins = <55>;
            function = <3>;
        };

        b_uart1_sout_pin_56: b_uart1_sout_pinmux {
            pins = <56>;
            function = <3>;
        };

        b_uart2_cts_pin_18: b_uart2_cts_pinmux {
            pins = <18>;
            function = <2>;
        };

        b_uart2_rts_pin_19: b_uart2_rts_pinmux {
            pins = <19>;
            function = <2>;
        };

        b_uart2_sin_pin_16: b_uart2_sin_pinmux {
            pins = <16>;
            function = <2>;
        };

        b_uart2_sout_pin_17: b_uart2_sout_pinmux {
            pins = <17>;
            function = <2>;
        };

        b_vreg_clk_pin_53: b_vreg_clk_pinmux {
            pins = <53>;
            function = <3>;
        };

        b_wan_early_txen_pin_56: b_wan_early_txen_pinmux {
            pins = <56>;
            function = <6>;
        };

        b_wan_nco_1pps_sig_pin_11: b_wan_nco_1pps_sig_pinmux {
            pins = <11>;
            function = <2>;
        };

        b_wan_nco_8k_clk_pin_12: b_wan_nco_8k_clk_pinmux {
            pins = <12>;
            function = <2>;
        };

        c_i2c_scl_pin_42: c_i2c_scl_pinmux {
            pins = <42>;
            function = <2>;
        };

        c_i2c_sda_pin_41: c_i2c_sda_pinmux {
            pins = <41>;
            function = <2>;
        };

        c_nand_ce_b_pin_40: c_nand_ce_b_pinmux {
            pins = <40>;
            function = <6>;
        };

        c_spim_ss2_b_pin_51: c_spim_ss2_b_pinmux {
            pins = <51>;
            function = <2>;
        };

        c_spim_ss3_b_pin_52: c_spim_ss3_b_pinmux {
            pins = <52>;
            function = <2>;
        };

        c_spim_ss4_b_pin_53: c_spim_ss4_b_pinmux {
            pins = <53>;
            function = <2>;
        };

        c_spim_ss5_b_pin_54: c_spim_ss5_b_pinmux {
            pins = <54>;
            function = <2>;
        };

        c_uart2_cts_pin_25: c_uart2_cts_pinmux {
            pins = <25>;
            function = <3>;
        };

        c_uart2_rts_pin_26: c_uart2_rts_pinmux {
            pins = <26>;
            function = <3>;
        };

        c_uart2_sin_pin_27: c_uart2_sin_pinmux {
            pins = <27>;
            function = <3>;
        };

        c_uart2_sout_pin_28: c_uart2_sout_pinmux {
            pins = <28>;
            function = <3>;
        };

        ddr_uart_rx_pin_27: ddr_uart_rx_pinmux {
            pins = <27>;
            function = <2>;
        };

        ddr_uart_tx_pin_28: ddr_uart_tx_pinmux {
            pins = <28>;
            function = <2>;
        };

        func_clk_observe_0_pin_50: func_clk_observe_0_pinmux {
            pins = <50>;
            function = <6>;
        };

        a_func_clk_observe_1_pin_52: a_func_clk_observe_1_pinmux {
            pins = <52>;
            function = <6>;
        };

        b_func_clk_observe_1_pin_55: b_func_clk_observe_1_pinmux {
            pins = <55>;
            function = <7>;
        };

        c_func_clk_observe_1_pin_58: c_func_clk_observe_1_pinmux {
            pins = <58>;
            function = <7>;
        };

        i2c_2_scl_pin_23: i2c_2_scl_pinmux {
            pins = <23>;
            function = <1>;
        };

        i2c_2_sda_pin_24: i2c_2_sda_pinmux {
            pins = <24>;
            function = <1>;
        };

        lport_mdc_pin_98: lport_mdc_pinmux {
            pins = <98>;
            function = <6>;
        };

        lport_mdio_pin_99: lport_mdio_pinmux {
            pins = <99>;
            function = <6>;
        };

        lport_m_mdc_pin_98: lport_m_mdc_pinmux {
            pins = <98>;
            function = <7>;
        };

        lport_m_mdio_pin_99: lport_m_mdio_pinmux {
            pins = <99>;
            function = <7>;
        };

        lport_sled_clk_pin_49: lport_sled_clk_pinmux {
            pins = <49>;
            function = <2>;
        };

        lport_sled_data_pin_50: lport_sled_data_pinmux {
            pins = <50>;
            function = <2>;
        };

        lv_clk_observe_00_pin_41: lv_clk_observe_00_pinmux {
            pins = <41>;
            function = <6>;
        };

        lv_clk_observe_01_pin_42: lv_clk_observe_01_pinmux {
            pins = <42>;
            function = <6>;
        };

        lv_clk_observe_02_pin_43: lv_clk_observe_02_pinmux {
            pins = <43>;
            function = <6>;
        };

        lv_clk_observe_03_pin_44: lv_clk_observe_03_pinmux {
            pins = <44>;
            function = <6>;
        };

        lv_clk_observe_04_pin_45: lv_clk_observe_04_pinmux {
            pins = <45>;
            function = <6>;
        };

        lv_clk_observe_05_pin_46: lv_clk_observe_05_pinmux {
            pins = <46>;
            function = <6>;
        };

        mii_rxe_pin_52: mii_rxe_pinmux {
            pins = <52>;
            function = <7>;
        };

        mii_txe_pin_61: mii_txe_pinmux {
            pins = <61>;
            function = <7>;
        };

        nand_wp_b_pin_40: nand_wp_b_pinmux {
            pins = <40>;
            function = <3>;
        };

        pcie0_clkreq_b_pin_107: pcie0_clkreq_b_pinmux {
            pins = <107>;
            function = <0>;
        };

        pcie0_rst_b_pin_108: pcie0_rst_b_pinmux {
            pins = <108>;
            function = <0>;
        };

        pcie1_clkreq_b_pin_109: pcie1_clkreq_b_pinmux {
            pins = <109>;
            function = <0>;
        };

        pcie1_rst_b_pin_110: pcie1_rst_b_pinmux {
            pins = <110>;
            function = <0>;
        };

        pcie2_clkreq_b_pin_111: pcie2_clkreq_b_pinmux {
            pins = <111>;
            function = <0>;
        };

        pcie2_rst_b_pin_112: pcie2_rst_b_pinmux {
            pins = <112>;
            function = <0>;
        };

        periph_mdc_pin_98: periph_mdc_pinmux {
            pins = <98>;
            function = <4>;
        };

        periph_mdio_pin_99: periph_mdio_pinmux {
            pins = <99>;
            function = <4>;
        };

        pmd_ext_los_pin_49: pmd_ext_los_pinmux {
            pins = <49>;
            function = <6>;
        };

        reset_out_b_pin_117: reset_out_b_pinmux {
            pins = <117>;
            function = <0>;
        };

        rgmii0_rx_ok_pin_17: rgmii0_rx_ok_pinmux {
            pins = <17>;
            function = <6>;
        };

        rgmii0_start_stop_pin_16: rgmii0_start_stop_pinmux {
            pins = <16>;
            function = <6>;
        };

        rgmii1_rx_ok_pin_19: rgmii1_rx_ok_pinmux {
            pins = <19>;
            function = <6>;
        };

        rgmii1_start_stop_pin_18: rgmii1_start_stop_pinmux {
            pins = <18>;
            function = <6>;
        };

        rgmii2_rx_ok_pin_1: rgmii2_rx_ok_pinmux {
            pins = <1>;
            function = <6>;
        };

        rgmii2_start_stop_pin_0: rgmii2_start_stop_pinmux {
            pins = <0>;
            function = <6>;
        };

        sata_mdc_pin_98: sata_mdc_pinmux {
            pins = <98>;
            function = <2>;
        };

        sata_mdio_pin_99: sata_mdio_pinmux {
            pins = <99>;
            function = <2>;
        };

        sfp_dserdes0_mod_def_0_pin_24: sfp_dserdes0_mod_def_0_pinmux {
            pins = <24>;
            function = <7>;
        };

        sfp_dserdes0_mod_def_1_pin_25: sfp_dserdes0_mod_def_1_pinmux {
            pins = <25>;
            function = <7>;
        };

        sfp_dserdes0_sig_det_0_pin_57: sfp_dserdes0_sig_det_0_pinmux {
            pins = <57>;
            function = <6>;
        };

        sfp_dserdes0_sig_det_1_pin_58: sfp_dserdes0_sig_det_1_pinmux {
            pins = <58>;
            function = <6>;
        };

        sfp_dserdes1_mod_def_0_pin_26: sfp_dserdes1_mod_def_0_pinmux {
            pins = <26>;
            function = <7>;
        };

        sfp_dserdes1_mod_def_1_pin_27: sfp_dserdes1_mod_def_1_pinmux {
            pins = <27>;
            function = <7>;
        };

        sfp_dserdes1_sig_det_0_pin_59: sfp_dserdes1_sig_det_0_pinmux {
            pins = <59>;
            function = <6>;
        };

        sfp_dserdes1_sig_det_1_pin_60: sfp_dserdes1_sig_det_1_pinmux {
            pins = <60>;
            function = <6>;
        };

        spim_ss0_b_pin_105: spim_ss0_b_pinmux {
            pins = <105>;
            function = <1>;
        };

        spim_ss1_b_pin_106: spim_ss1_b_pinmux {
            pins = <106>;
            function = <1>;
        };

        spis_clk_pin_7: spis_clk_pinmux {
            pins = <7>;
            function = <1>;
        };

        spis_miso_pin_9: spis_miso_pinmux {
            pins = <9>;
            function = <1>;
        };

        spis_mosi_pin_8: spis_mosi_pinmux {
            pins = <8>;
            function = <1>;
        };

        spis_ss_b_pin_10: spis_ss_b_pinmux {
            pins = <10>;
            function = <1>;
        };

        svsso_pin_123: svsso_pinmux {
            pins = <123>;
            function = <0>;
        };

        swreg_sclk_pin_0: swreg_sclk_pinmux {
            pins = <0>;
            function = <7>;
        };

        swreg_sdi_pin_2: swreg_sdi_pinmux {
            pins = <2>;
            function = <7>;
        };

        swreg_sdo_pin_1: swreg_sdo_pinmux {
            pins = <1>;
            function = <7>;
        };

        sys_irq_out_pin_51: sys_irq_out_pinmux {
            pins = <51>;
            function = <3>;
        };

        tbus_clk_pin_4: tbus_clk_pinmux {
            pins = <4>;
            function = <3>;
        };

        tbus_io_0_pin_5: tbus_io_0_pinmux {
            pins = <5>;
            function = <3>;
        };

        tbus_io_1_pin_6: tbus_io_1_pinmux {
            pins = <6>;
            function = <3>;
        };

        tbus_io_2_pin_13: tbus_io_2_pinmux {
            pins = <13>;
            function = <3>;
        };

        tbus_io_3_pin_14: tbus_io_3_pinmux {
            pins = <14>;
            function = <3>;
        };

        tbus_req_pin_15: tbus_req_pinmux {
            pins = <15>;
            function = <3>;
        };

        tdi_pin_118: tdi_pinmux {
            pins = <118>;
            function = <0>;
        };

        tdo_pin_124: tdo_pinmux {
            pins = <124>;
            function = <0>;
        };

        test_mode_00_pin_45: test_mode_00_pinmux {
            pins = <45>;
            function = <0>;
        };

        test_mode_01_pin_47: test_mode_01_pinmux {
            pins = <47>;
            function = <0>;
        };

        test_mode_02_pin_48: test_mode_02_pinmux {
            pins = <48>;
            function = <0>;
        };

        test_mode_03_pin_33: test_mode_03_pinmux {
            pins = <33>;
            function = <0>;
        };

        test_mode_04_pin_34: test_mode_04_pinmux {
            pins = <34>;
            function = <0>;
        };

        test_mode_05_pin_60: test_mode_05_pinmux {
            pins = <60>;
            function = <0>;
        };

        test_mode_06_pin_61: test_mode_06_pinmux {
            pins = <61>;
            function = <0>;
        };

        test_mode_07_pin_113: test_mode_07_pinmux {
            pins = <113>;
            function = <0>;
        };

        test_mode_08_pin_114: test_mode_08_pinmux {
            pins = <114>;
            function = <0>;
        };

        tms_pin_119: tms_pinmux {
            pins = <119>;
            function = <0>;
        };

        trst_b_pin_120: trst_b_pinmux {
            pins = <120>;
            function = <0>;
        };

        tx_laser_on_out_n_pin_54: tx_laser_on_out_n_pinmux {
            pins = <54>;
            function = <6>;
        };

        tx_laser_on_out_p_pin_53: tx_laser_on_out_p_pinmux {
            pins = <53>;
            function = <6>;
        };

        uart0_sdin_pin_100: uart0_sdin_pinmux {
            pins = <100>;
            function = <1>;
        };

        uart0_sdout_pin_101: uart0_sdout_pinmux {
            pins = <101>;
            function = <1>;
        };

        usbd_id_pin_58: usbd_id_pinmux {
            pins = <58>;
            function = <2>;
        };

        usbd_vbus_present_pin_57: usbd_vbus_present_pinmux {
            pins = <57>;
            function = <2>;
        };

        wan_mdc_pin_98: wan_mdc_pinmux {
            pins = <98>;
            function = <3>;
        };

        wan_mdio_pin_99: wan_mdio_pinmux {
            pins = <99>;
            function = <3>;
        };

        wan_nco_10m_clk_pin_58: wan_nco_10m_clk_pinmux {
            pins = <58>;
            function = <3>;
        };

        a_wan_nco_prog_clk_pin_55: a_wan_nco_prog_clk_pinmux {
            pins = <55>;
            function = <2>;
        };

        b_wan_nco_prog_clk_pin_12: b_wan_nco_prog_clk_pinmux {
            pins = <12>;
            function = <3>;
        };

        c_wan_nco_prog_clk_pin_57: c_wan_nco_prog_clk_pinmux {
            pins = <57>;
            function = <3>;
        };

        d_wan_nco_prog_clk_pin_58: d_wan_nco_prog_clk_pinmux {
            pins = <58>;
            function = <4>;
        };

};
