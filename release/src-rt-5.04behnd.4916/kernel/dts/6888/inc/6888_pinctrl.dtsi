pincontroller-functions {
        spim_group_pins: spim_group_pinmux {
            pins = <22 23 24>;
            function = <1>;
        };

        usb0_pwr_pins: usb0_pwr_pinmux {
            pins = <63 64>;
            function = <1>;
        };

        usb1_pwr_pins: usb1_pwr_pinmux {
            pins = <65 66>;
            function = <1>;
        };

        rgmii_pins: rgmii_pinmux {
            pins = <47 48 49 50 51 52 53 54 55 56 57 58>;
            function = <1>;
        };

        nand_data_pins: nand_data_pinmux {
            pins = <34 35 36 37 38 39 40 41>;
            function = <1>;
        };

        nand_ctrl_pins: nand_ctrl_pinmux {
            pins = <31 32 33 42 43 44>;
            function = <1>;
        };

        emmc_ctrl_pins: emmc_ctrl_pinmux {
            pins = <45 46>;
            function = <1>;
        };

        a_early_txen_pin_13: a_early_txen_pinmux {
            pins = <13>;
            function = <2>;
        };

        a_eth_mdc_pin_59: a_eth_mdc_pinmux {
            pins = <59>;
            function = <1>;
        };

        a_eth_mdio_pin_60: a_eth_mdio_pinmux {
            pins = <60>;
            function = <1>;
        };

        a_i2c_2_scl_pin_11: a_i2c_2_scl_pinmux {
            pins = <11>;
            function = <2>;
        };

        a_i2c_2_sda_pin_12: a_i2c_2_sda_pinmux {
            pins = <12>;
            function = <2>;
        };

        a_i2s_rx_lrck_pin_9: a_i2s_rx_lrck_pinmux {
            pins = <9>;
            function = <2>;
        };

        a_i2s_rx_mclk_pin_10: a_i2s_rx_mclk_pinmux {
            pins = <10>;
            function = <2>;
        };

        a_i2s_rx_sclk_pin_8: a_i2s_rx_sclk_pinmux {
            pins = <8>;
            function = <2>;
        };

        a_i2s_sdata_in_pin_5: a_i2s_sdata_in_pinmux {
            pins = <5>;
            function = <2>;
        };

        a_i2s_sdata_out_pin_6: a_i2s_sdata_out_pinmux {
            pins = <6>;
            function = <2>;
        };

        a_i2s_tx_lrck_pin_4: a_i2s_tx_lrck_pinmux {
            pins = <4>;
            function = <2>;
        };

        a_i2s_tx_mclk_pin_7: a_i2s_tx_mclk_pinmux {
            pins = <7>;
            function = <2>;
        };

        a_i2s_tx_sclk_pin_3: a_i2s_tx_sclk_pinmux {
            pins = <3>;
            function = <2>;
        };

        a_one_sec_pls_pin_10: a_one_sec_pls_pinmux {
            pins = <10>;
            function = <6>;
        };

        a_pcm_clk_pin_16: a_pcm_clk_pinmux {
            pins = <16>;
            function = <1>;
        };

        a_pcm_fs_pin_17: a_pcm_fs_pinmux {
            pins = <17>;
            function = <1>;
        };

        a_pcm_sdin_pin_14: a_pcm_sdin_pinmux {
            pins = <14>;
            function = <1>;
        };

        a_pcm_sdout_pin_15: a_pcm_sdout_pinmux {
            pins = <15>;
            function = <1>;
        };

        a_per_led_00_pin_0: a_per_led_00_pinmux {
            pins = <0>;
            function = <5>;
            crossbar-output = <0>;
        };

        a_per_led_01_pin_1: a_per_led_01_pinmux {
            pins = <1>;
            function = <5>;
            crossbar-output = <1>;
        };

        a_per_led_02_pin_2: a_per_led_02_pinmux {
            pins = <2>;
            function = <5>;
            crossbar-output = <2>;
        };

        a_per_led_03_pin_3: a_per_led_03_pinmux {
            pins = <3>;
            function = <5>;
            crossbar-output = <3>;
        };

        a_per_led_04_pin_4: a_per_led_04_pinmux {
            pins = <4>;
            function = <5>;
            crossbar-output = <4>;
        };

        a_per_led_05_pin_5: a_per_led_05_pinmux {
            pins = <5>;
            function = <5>;
            crossbar-output = <5>;
        };

        a_per_led_06_pin_6: a_per_led_06_pinmux {
            pins = <6>;
            function = <5>;
            crossbar-output = <6>;
        };

        a_per_led_07_pin_7: a_per_led_07_pinmux {
            pins = <7>;
            function = <5>;
            crossbar-output = <7>;
        };

        a_per_led_08_pin_8: a_per_led_08_pinmux {
            pins = <8>;
            function = <5>;
            crossbar-output = <8>;
        };

        a_per_led_09_pin_9: a_per_led_09_pinmux {
            pins = <9>;
            function = <5>;
            crossbar-output = <9>;
        };

        a_per_led_10_pin_10: a_per_led_10_pinmux {
            pins = <10>;
            function = <5>;
            crossbar-output = <10>;
        };

        a_per_led_11_pin_11: a_per_led_11_pinmux {
            pins = <11>;
            function = <5>;
            crossbar-output = <11>;
        };

        a_per_led_12_pin_12: a_per_led_12_pinmux {
            pins = <12>;
            function = <5>;
            crossbar-output = <12>;
        };

        a_per_led_13_pin_13: a_per_led_13_pinmux {
            pins = <13>;
            function = <5>;
            crossbar-output = <13>;
        };

        a_per_led_14_pin_14: a_per_led_14_pinmux {
            pins = <14>;
            function = <5>;
            crossbar-output = <14>;
        };

        a_per_led_15_pin_15: a_per_led_15_pinmux {
            pins = <15>;
            function = <5>;
            crossbar-output = <15>;
        };

        a_per_led_16_pin_16: a_per_led_16_pinmux {
            pins = <16>;
            function = <5>;
            crossbar-output = <16>;
        };

        a_per_led_17_pin_17: a_per_led_17_pinmux {
            pins = <17>;
            function = <5>;
            crossbar-output = <17>;
        };

        a_per_led_18_pin_18: a_per_led_18_pinmux {
            pins = <18>;
            function = <5>;
            crossbar-output = <18>;
        };

        a_per_led_19_pin_19: a_per_led_19_pinmux {
            pins = <19>;
            function = <5>;
            crossbar-output = <19>;
        };

        a_per_led_20_pin_22: a_per_led_20_pinmux {
            pins = <22>;
            function = <5>;
            crossbar-output = <20>;
        };

        a_per_led_21_pin_21: a_per_led_21_pinmux {
            pins = <21>;
            function = <5>;
            crossbar-output = <21>;
        };

        a_per_led_22_pin_20: a_per_led_22_pinmux {
            pins = <20>;
            function = <5>;
            crossbar-output = <22>;
        };

        a_per_led_23_pin_49: a_per_led_23_pinmux {
            pins = <49>;
            function = <5>;
            crossbar-output = <23>;
        };

        a_per_led_24_pin_50: a_per_led_24_pinmux {
            pins = <50>;
            function = <5>;
            crossbar-output = <24>;
        };

        a_per_led_25_pin_51: a_per_led_25_pinmux {
            pins = <51>;
            function = <5>;
            crossbar-output = <25>;
        };

        a_per_led_26_pin_52: a_per_led_26_pinmux {
            pins = <52>;
            function = <5>;
            crossbar-output = <26>;
        };

        a_per_led_27_pin_54: a_per_led_27_pinmux {
            pins = <54>;
            function = <5>;
            crossbar-output = <27>;
        };

        a_per_led_28_pin_55: a_per_led_28_pinmux {
            pins = <55>;
            function = <5>;
            crossbar-output = <28>;
        };

        a_per_led_29_pin_56: a_per_led_29_pinmux {
            pins = <56>;
            function = <5>;
            crossbar-output = <29>;
        };

        a_per_led_30_pin_57: a_per_led_30_pinmux {
            pins = <57>;
            function = <5>;
            crossbar-output = <30>;
        };

        a_per_led_31_pin_58: a_per_led_31_pinmux {
            pins = <58>;
            function = <5>;
            crossbar-output = <31>;
        };

        a_qlan_sd0_mod_abs_pin_50: a_qlan_sd0_mod_abs_pinmux {
            pins = <50>;
            function = <0>;
        };

        a_qlan_sd0_rx_los_pin_49: a_qlan_sd0_rx_los_pinmux {
            pins = <49>;
            function = <0>;
        };

        a_qlan_sd1_mod_abs_pin_52: a_qlan_sd1_mod_abs_pinmux {
            pins = <52>;
            function = <0>;
        };

        a_qlan_sd1_rx_los_pin_51: a_qlan_sd1_rx_los_pinmux {
            pins = <51>;
            function = <0>;
        };

        a_qlan_sd2_mod_abs_pin_56: a_qlan_sd2_mod_abs_pinmux {
            pins = <56>;
            function = <0>;
        };

        a_qlan_sd2_rx_los_pin_55: a_qlan_sd2_rx_los_pinmux {
            pins = <55>;
            function = <0>;
        };

        a_qlan_sd3_mod_abs_pin_58: a_qlan_sd3_mod_abs_pinmux {
            pins = <58>;
            function = <0>;
        };

        a_qlan_sd3_rx_los_pin_57: a_qlan_sd3_rx_los_pinmux {
            pins = <57>;
            function = <0>;
        };

        a_ser_led_clk_pin_1: a_ser_led_clk_pinmux {
            pins = <1>;
            function = <1>;
        };

        a_ser_led_data_pin_0: a_ser_led_data_pinmux {
            pins = <0>;
            function = <1>;
        };

        a_ser_led_mask_pin_2: a_ser_led_mask_pinmux {
            pins = <2>;
            function = <1>;
        };

        a_slan_sd_mod_abs_pin_4: a_slan_sd_mod_abs_pinmux {
            pins = <4>;
            function = <0>;
        };

        a_slan_sd_rx_los_pin_3: a_slan_sd_rx_los_pinmux {
            pins = <3>;
            function = <0>;
        };

        a_spim_ss1_b_pin_13: a_spim_ss1_b_pinmux {
            pins = <13>;
            function = <1>;
        };

        a_uart1_sin_pin_11: a_uart1_sin_pinmux {
            pins = <11>;
            function = <1>;
        };

        a_uart1_sout_pin_12: a_uart1_sout_pinmux {
            pins = <12>;
            function = <1>;
        };

        a_uart2_cts_pin_18: a_uart2_cts_pinmux {
            pins = <18>;
            function = <1>;
        };

        a_uart2_rts_pin_19: a_uart2_rts_pinmux {
            pins = <19>;
            function = <1>;
        };

        a_uart2_sin_pin_20: a_uart2_sin_pinmux {
            pins = <20>;
            function = <1>;
        };

        a_uart2_sout_pin_21: a_uart2_sout_pinmux {
            pins = <21>;
            function = <1>;
        };

        a_wan_nco_10m_clk_pin_7: a_wan_nco_10m_clk_pinmux {
            pins = <7>;
            function = <3>;
        };

        a_wan_nco_1pps_sig_pin_13: a_wan_nco_1pps_sig_pinmux {
            pins = <13>;
            function = <0>;
        };

        a_wan_nco_8k_clk_pin_7: a_wan_nco_8k_clk_pinmux {
            pins = <7>;
            function = <6>;
        };

        a_wan_nco_prog_clk_pin_8: a_wan_nco_prog_clk_pinmux {
            pins = <8>;
            function = <3>;
        };

        b_early_txen_pin_75: b_early_txen_pinmux {
            pins = <75>;
            function = <2>;
        };

        b_eth_mdc_pin_3: b_eth_mdc_pinmux {
            pins = <3>;
            function = <3>;
        };

        b_eth_mdio_pin_4: b_eth_mdio_pinmux {
            pins = <4>;
            function = <3>;
        };

        b_i2c_2_scl_pin_57: b_i2c_2_scl_pinmux {
            pins = <57>;
            function = <2>;
        };

        b_i2c_2_sda_pin_58: b_i2c_2_sda_pinmux {
            pins = <58>;
            function = <2>;
        };

        b_i2s_rx_lrck_pin_57: b_i2s_rx_lrck_pinmux {
            pins = <57>;
            function = <3>;
        };

        b_i2s_rx_mclk_pin_58: b_i2s_rx_mclk_pinmux {
            pins = <58>;
            function = <3>;
        };

        b_i2s_rx_sclk_pin_56: b_i2s_rx_sclk_pinmux {
            pins = <56>;
            function = <3>;
        };

        b_i2s_sdata_in_pin_51: b_i2s_sdata_in_pinmux {
            pins = <51>;
            function = <3>;
        };

        b_i2s_sdata_out_pin_52: b_i2s_sdata_out_pinmux {
            pins = <52>;
            function = <3>;
        };

        b_i2s_tx_lrck_pin_50: b_i2s_tx_lrck_pinmux {
            pins = <50>;
            function = <3>;
        };

        b_i2s_tx_mclk_pin_55: b_i2s_tx_mclk_pinmux {
            pins = <55>;
            function = <3>;
        };

        b_i2s_tx_sclk_pin_49: b_i2s_tx_sclk_pinmux {
            pins = <49>;
            function = <3>;
        };

        b_one_sec_pls_pin_13: b_one_sec_pls_pinmux {
            pins = <13>;
            function = <6>;
        };

        b_pcm_clk_pin_20: b_pcm_clk_pinmux {
            pins = <20>;
            function = <2>;
        };

        b_pcm_fs_pin_21: b_pcm_fs_pinmux {
            pins = <21>;
            function = <2>;
        };

        b_pcm_sdin_pin_18: b_pcm_sdin_pinmux {
            pins = <18>;
            function = <2>;
        };

        b_pcm_sdout_pin_19: b_pcm_sdout_pinmux {
            pins = <19>;
            function = <2>;
        };

        b_per_led_00_pin_23: b_per_led_00_pinmux {
            pins = <23>;
            function = <5>;
            crossbar-output = <0>;
        };

        b_per_led_01_pin_24: b_per_led_01_pinmux {
            pins = <24>;
            function = <5>;
            crossbar-output = <1>;
        };

        b_per_led_02_pin_25: b_per_led_02_pinmux {
            pins = <25>;
            function = <5>;
            crossbar-output = <2>;
        };

        b_per_led_03_pin_26: b_per_led_03_pinmux {
            pins = <26>;
            function = <5>;
            crossbar-output = <3>;
        };

        b_per_led_04_pin_27: b_per_led_04_pinmux {
            pins = <27>;
            function = <5>;
            crossbar-output = <4>;
        };

        b_per_led_05_pin_28: b_per_led_05_pinmux {
            pins = <28>;
            function = <5>;
            crossbar-output = <5>;
        };

        b_per_led_06_pin_29: b_per_led_06_pinmux {
            pins = <29>;
            function = <5>;
            crossbar-output = <6>;
        };

        b_per_led_07_pin_31: b_per_led_07_pinmux {
            pins = <31>;
            function = <5>;
            crossbar-output = <7>;
        };

        b_per_led_08_pin_32: b_per_led_08_pinmux {
            pins = <32>;
            function = <5>;
            crossbar-output = <8>;
        };

        b_per_led_09_pin_33: b_per_led_09_pinmux {
            pins = <33>;
            function = <5>;
            crossbar-output = <9>;
        };

        b_per_led_10_pin_34: b_per_led_10_pinmux {
            pins = <34>;
            function = <5>;
            crossbar-output = <10>;
        };

        b_per_led_11_pin_35: b_per_led_11_pinmux {
            pins = <35>;
            function = <5>;
            crossbar-output = <11>;
        };

        b_per_led_12_pin_36: b_per_led_12_pinmux {
            pins = <36>;
            function = <5>;
            crossbar-output = <12>;
        };

        b_per_led_13_pin_37: b_per_led_13_pinmux {
            pins = <37>;
            function = <5>;
            crossbar-output = <13>;
        };

        b_per_led_14_pin_38: b_per_led_14_pinmux {
            pins = <38>;
            function = <5>;
            crossbar-output = <14>;
        };

        b_per_led_15_pin_39: b_per_led_15_pinmux {
            pins = <39>;
            function = <5>;
            crossbar-output = <15>;
        };

        b_per_led_16_pin_40: b_per_led_16_pinmux {
            pins = <40>;
            function = <5>;
            crossbar-output = <16>;
        };

        b_per_led_17_pin_41: b_per_led_17_pinmux {
            pins = <41>;
            function = <5>;
            crossbar-output = <17>;
        };

        b_per_led_18_pin_42: b_per_led_18_pinmux {
            pins = <42>;
            function = <5>;
            crossbar-output = <18>;
        };

        b_per_led_19_pin_43: b_per_led_19_pinmux {
            pins = <43>;
            function = <5>;
            crossbar-output = <19>;
        };

        b_per_led_20_pin_44: b_per_led_20_pinmux {
            pins = <44>;
            function = <5>;
            crossbar-output = <20>;
        };

        b_per_led_21_pin_45: b_per_led_21_pinmux {
            pins = <45>;
            function = <5>;
            crossbar-output = <21>;
        };

        b_per_led_22_pin_46: b_per_led_22_pinmux {
            pins = <46>;
            function = <5>;
            crossbar-output = <22>;
        };

        b_per_led_23_pin_75: b_per_led_23_pinmux {
            pins = <75>;
            function = <5>;
            crossbar-output = <23>;
        };

        b_per_led_24_pin_74: b_per_led_24_pinmux {
            pins = <74>;
            function = <5>;
            crossbar-output = <24>;
        };

        b_per_led_25_pin_73: b_per_led_25_pinmux {
            pins = <73>;
            function = <5>;
            crossbar-output = <25>;
        };

        b_per_led_26_pin_72: b_per_led_26_pinmux {
            pins = <72>;
            function = <5>;
            crossbar-output = <26>;
        };

        b_per_led_27_pin_71: b_per_led_27_pinmux {
            pins = <71>;
            function = <5>;
            crossbar-output = <27>;
        };

        b_per_led_28_pin_70: b_per_led_28_pinmux {
            pins = <70>;
            function = <5>;
            crossbar-output = <28>;
        };

        b_per_led_29_pin_69: b_per_led_29_pinmux {
            pins = <69>;
            function = <5>;
            crossbar-output = <29>;
        };

        b_per_led_30_pin_68: b_per_led_30_pinmux {
            pins = <68>;
            function = <5>;
            crossbar-output = <30>;
        };

        b_per_led_31_pin_67: b_per_led_31_pinmux {
            pins = <67>;
            function = <5>;
            crossbar-output = <31>;
        };

        b_qlan_sd0_mod_abs_pin_4: b_qlan_sd0_mod_abs_pinmux {
            pins = <4>;
            function = <7>;
        };

        b_qlan_sd0_rx_los_pin_3: b_qlan_sd0_rx_los_pinmux {
            pins = <3>;
            function = <7>;
        };

        b_qlan_sd1_mod_abs_pin_6: b_qlan_sd1_mod_abs_pinmux {
            pins = <6>;
            function = <7>;
        };

        b_qlan_sd1_rx_los_pin_5: b_qlan_sd1_rx_los_pinmux {
            pins = <5>;
            function = <7>;
        };

        b_qlan_sd2_mod_abs_pin_8: b_qlan_sd2_mod_abs_pinmux {
            pins = <8>;
            function = <7>;
        };

        b_qlan_sd2_rx_los_pin_7: b_qlan_sd2_rx_los_pinmux {
            pins = <7>;
            function = <7>;
        };

        b_qlan_sd3_mod_abs_pin_10: b_qlan_sd3_mod_abs_pinmux {
            pins = <10>;
            function = <7>;
        };

        b_qlan_sd3_rx_los_pin_9: b_qlan_sd3_rx_los_pinmux {
            pins = <9>;
            function = <7>;
        };

        b_ser_led_clk_pin_6: b_ser_led_clk_pinmux {
            pins = <6>;
            function = <3>;
        };

        b_ser_led_data_pin_14: b_ser_led_data_pinmux {
            pins = <14>;
            function = <3>;
        };

        b_ser_led_mask_pin_15: b_ser_led_mask_pinmux {
            pins = <15>;
            function = <3>;
        };

        b_slan_sd_mod_abs_pin_8: b_slan_sd_mod_abs_pinmux {
            pins = <8>;
            function = <0>;
        };

        b_slan_sd_rx_los_pin_7: b_slan_sd_rx_los_pinmux {
            pins = <7>;
            function = <0>;
        };

        b_spim_ss1_b_pin_74: b_spim_ss1_b_pinmux {
            pins = <74>;
            function = <2>;
        };

        b_uart1_sin_pin_45: b_uart1_sin_pinmux {
            pins = <45>;
            function = <2>;
        };

        b_uart1_sout_pin_46: b_uart1_sout_pinmux {
            pins = <46>;
            function = <2>;
        };

        b_uart2_cts_pin_14: b_uart2_cts_pinmux {
            pins = <14>;
            function = <2>;
        };

        b_uart2_rts_pin_15: b_uart2_rts_pinmux {
            pins = <15>;
            function = <2>;
        };

        b_uart2_sin_pin_16: b_uart2_sin_pinmux {
            pins = <16>;
            function = <2>;
        };

        b_uart2_sout_pin_17: b_uart2_sout_pinmux {
            pins = <17>;
            function = <2>;
        };

        b_wan_nco_10m_clk_pin_8: b_wan_nco_10m_clk_pinmux {
            pins = <8>;
            function = <6>;
        };

        b_wan_nco_1pps_sig_pin_10: b_wan_nco_1pps_sig_pinmux {
            pins = <10>;
            function = <3>;
        };

        b_wan_nco_8k_clk_pin_9: b_wan_nco_8k_clk_pinmux {
            pins = <9>;
            function = <6>;
        };

        b_wan_nco_prog_clk_pin_47: b_wan_nco_prog_clk_pinmux {
            pins = <47>;
            function = <2>;
        };

        c_early_txen_pin_55: c_early_txen_pinmux {
            pins = <55>;
            function = <2>;
        };

        c_eth_mdc_pin_11: c_eth_mdc_pinmux {
            pins = <11>;
            function = <6>;
        };

        c_eth_mdio_pin_12: c_eth_mdio_pinmux {
            pins = <12>;
            function = <6>;
        };

        c_i2s_tx_mclk_pin_5: c_i2s_tx_mclk_pinmux {
            pins = <5>;
            function = <3>;
        };

        c_per_led_14_pin_47: c_per_led_14_pinmux {
            pins = <47>;
            function = <5>;
            crossbar-output = <14>;
        };

        c_per_led_15_pin_48: c_per_led_15_pinmux {
            pins = <48>;
            function = <5>;
            crossbar-output = <15>;
        };

        c_per_led_16_pin_53: c_per_led_16_pinmux {
            pins = <53>;
            function = <5>;
            crossbar-output = <16>;
        };

        c_per_led_17_pin_76: c_per_led_17_pinmux {
            pins = <76>;
            function = <5>;
            crossbar-output = <17>;
        };

        c_ser_led_clk_pin_56: c_ser_led_clk_pinmux {
            pins = <56>;
            function = <6>;
        };

        c_ser_led_data_pin_55: c_ser_led_data_pinmux {
            pins = <55>;
            function = <6>;
        };

        c_ser_led_mask_pin_57: c_ser_led_mask_pinmux {
            pins = <57>;
            function = <6>;
        };

        c_slan_sd_mod_abs_pin_23: c_slan_sd_mod_abs_pinmux {
            pins = <23>;
            function = <0>;
        };

        c_slan_sd_rx_los_pin_22: c_slan_sd_rx_los_pinmux {
            pins = <22>;
            function = <0>;
        };

        c_spim_ss1_b_pin_58: c_spim_ss1_b_pinmux {
            pins = <58>;
            function = <6>;
        };

        c_uart1_sin_pin_51: c_uart1_sin_pinmux {
            pins = <51>;
            function = <2>;
        };

        c_uart1_sout_pin_56: c_uart1_sout_pinmux {
            pins = <56>;
            function = <2>;
        };

        c_wan_nco_10m_clk_pin_53: c_wan_nco_10m_clk_pinmux {
            pins = <53>;
            function = <2>;
        };

        c_wan_nco_1pps_sig_pin_54: c_wan_nco_1pps_sig_pinmux {
            pins = <54>;
            function = <2>;
        };

        c_wan_nco_8k_clk_pin_48: c_wan_nco_8k_clk_pinmux {
            pins = <48>;
            function = <2>;
        };

        c_wan_nco_prog_clk_pin_76: c_wan_nco_prog_clk_pinmux {
            pins = <76>;
            function = <2>;
        };

        ddr_uart_rx_pin_20: ddr_uart_rx_pinmux {
            pins = <20>;
            function = <11>;
        };

        ddr_uart_tx_pin_21: ddr_uart_tx_pinmux {
            pins = <21>;
            function = <11>;
        };

        d_slan_sd_mod_abs_pin_12: d_slan_sd_mod_abs_pinmux {
            pins = <12>;
            function = <3>;
        };

        d_slan_sd_rx_los_pin_11: d_slan_sd_rx_los_pinmux {
            pins = <11>;
            function = <3>;
        };

        i2c_scl_pin_28: i2c_scl_pinmux {
            pins = <28>;
            function = <1>;
        };

        i2c_sda_pin_29: i2c_sda_pinmux {
            pins = <29>;
            function = <1>;
        };

        nand_wp_b_pin_13: nand_wp_b_pinmux {
            pins = <13>;
            function = <7>;
        };

        pcie0_clkreq_b_pin_68: pcie0_clkreq_b_pinmux {
            pins = <68>;
            function = <1>;
        };

        pcie0_rst_b_pin_69: pcie0_rst_b_pinmux {
            pins = <69>;
            function = <1>;
        };

        pcie1_clkreq_b_pin_70: pcie1_clkreq_b_pinmux {
            pins = <70>;
            function = <1>;
        };

        pcie1_rst_b_pin_71: pcie1_rst_b_pinmux {
            pins = <71>;
            function = <1>;
        };

        pcie2_clkreq_b_pin_72: pcie2_clkreq_b_pinmux {
            pins = <72>;
            function = <1>;
        };

        pcie2_rst_b_pin_73: pcie2_rst_b_pinmux {
            pins = <73>;
            function = <1>;
        };

        pcie3_clkreq_b_pin_74: pcie3_clkreq_b_pinmux {
            pins = <74>;
            function = <1>;
        };

        pcie3_rst_b_pin_75: pcie3_rst_b_pinmux {
            pins = <75>;
            function = <1>;
        };

        pon_lbe_n_pin_13: pon_lbe_n_pinmux {
            pins = <13>;
            function = <3>;
        };

        pon_lbe_p_pin_30: pon_lbe_p_pinmux {
            pins = <30>;
            function = <1>;
        };

        pon_mod_abs_pin_76: pon_mod_abs_pinmux {
            pins = <76>;
            function = <1>;
        };

        reset_out_b_pin_67: reset_out_b_pinmux {
            pins = <67>;
            function = <1>;
        };

        rogue_onu_in_pin_27: rogue_onu_in_pinmux {
            pins = <27>;
            function = <1>;
        };

        signal_detect_pin_26: signal_detect_pinmux {
            pins = <26>;
            function = <1>;
        };

        spim_ss0_b_pin_25: spim_ss0_b_pinmux {
            pins = <25>;
            function = <1>;
        };

        spim_ss2_b_pin_6: spim_ss2_b_pinmux {
            pins = <6>;
            function = <1>;
        };

        spim_ss3_b_pin_5: spim_ss3_b_pinmux {
            pins = <5>;
            function = <1>;
        };

        spim_ss4_b_pin_4: spim_ss4_b_pinmux {
            pins = <4>;
            function = <1>;
        };

        spim_ss5_b_pin_3: spim_ss5_b_pinmux {
            pins = <3>;
            function = <1>;
        };

        spis_clk_pin_7: spis_clk_pinmux {
            pins = <7>;
            function = <1>;
        };

        spis_miso_pin_9: spis_miso_pinmux {
            pins = <9>;
            function = <1>;
        };

        spis_mosi_pin_10: spis_mosi_pinmux {
            pins = <10>;
            function = <1>;
        };

        spis_ss_b_pin_8: spis_ss_b_pinmux {
            pins = <8>;
            function = <1>;
        };

        sys_irq_out_b_pin_9: sys_irq_out_b_pinmux {
            pins = <9>;
            function = <3>;
        };

        uart0_sdin_pin_61: uart0_sdin_pinmux {
            pins = <61>;
            function = <1>;
        };

        uart0_sdout_pin_62: uart0_sdout_pinmux {
            pins = <62>;
            function = <1>;
        };

        usbd_vbus_present_pin_47: usbd_vbus_present_pinmux {
            pins = <47>;
            function = <7>;
        };

};
