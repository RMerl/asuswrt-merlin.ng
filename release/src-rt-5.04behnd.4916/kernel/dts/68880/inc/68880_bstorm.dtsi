
accelerator@84800000 {
    interrupt-names = "bstm";
    interrupts = <GIC_SPI 215  IRQ_TYPE_LEVEL_HIGH>;
    reg =  <0x0 0x84800000 0x0 0x4800C3>;
    compatible = "brcm,bstm-v1.0.0.3";
};

gpu@83D00000 { 
    compatible = "brcm,bcm68880-gpu", "brcm,gpu-v7.1.6.4"; 
    reg = <0x0 0x83D00000 0x0 0x40000>; 
    reg-names = "v3d"; 
    interrupts = <GIC_SPI 217 IRQ_TYPE_LEVEL_HIGH GIC_SPI 216 
IRQ_TYPE_LEVEL_HIGH>; 
    interrupt-names = "v3d", "v3d_hub"; 
}; 
 
gpu-mmu@83D01000 { 
    compatible = "brcm,bcm68880-v3d", "brcm,v3d-v7.1.6.4"; 
};
