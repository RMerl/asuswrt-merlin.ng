#include "../../../bcmdrivers/opensource/include/bcm963xx/bcm_bca_extintr_dt_bindings.h"

compatible = "brcm,bca-extintr";
num_ext_intr = <MAX_EXT_INTR>;
reg = <EXTINTR_OFFSET EXTINTR_SIZE>
#if defined(INTSET0_OFFSET) 
      ,<INTSET0_OFFSET INTSET0_SIZE>
#if defined(INTSET1_OFFSET) 
      ,<INTSET1_OFFSET INTSET1_SIZE>
#if defined(INTSET2_OFFSET) 
      ,<INTSET2_OFFSET INTSET2_SIZE>
#if defined(INTSET3_OFFSET) 
      ,<INTSET3_OFFSET INTSET3_SIZE>
#endif
#endif
#endif
#endif
      ;
/* external_interrupts = <List of external interrups id (SPI)> */
/* clear_workarround; *//* add for 6858 */
/* skip_opeational; *//* add for 63146 */
/* reserved_ext_ids = <List of reserved external interrupts id [0..num_ext_intr]>;*/ /* 6756 A0 */
